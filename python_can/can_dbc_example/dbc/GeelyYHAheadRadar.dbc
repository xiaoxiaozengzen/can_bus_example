// *************************************************************************** *
// *                                                                           *
// * Description:         CANDB File                                           *
// * Generated at:        2023-03-15 15:03                                     *
// * System:              SDB23100                                             *
// * Variant:             E171_VCU_ADCU3                                       *
// * Network:             SafetyCANFD2                                         *
// *                                                                           *
// *************************************************************************** *
VERSION "SafetyCANFD2"

NS_ :

BS_ :

BU_ :  ASDM ETC FLR4

BO_ 898 FLRSafetyCANFD2Frame83 : 64 FLR4
 SG_ FourDRadarObjSts35_UB : 280|1@0+ (1,0) [0|1] "" ASDM
 SG_ FourDRadarObjSts35Chks : 7|8@0+ (1.0,0.0) [0.0|255.0] "Unitless" ASDM
 SG_ FourDRadarObjSts35Classification : 15|4@0+ (1,0) [0|15] "" ASDM
 SG_ FourDRadarObjSts35Cntr : 11|4@0+ (1.0,0.0) [0.0|15.0] "Unitless" ASDM
 SG_ FourDRadarObjSts35DistX : 23|16@0+ (0.015625,-512.0) [-512.0|511.984375] "m" ASDM
 SG_ FourDRadarObjSts35DistXStd : 39|7@0+ (0.1,0.0) [0.0|12.700000000000001] "m" ASDM
 SG_ FourDRadarObjSts35DistY : 47|13@0+ (0.015625,-64.0) [-64.0|63.984375] "m" ASDM
 SG_ FourDRadarObjSts35DistYStd : 71|7@0+ (0.1,0.0) [0.0|12.700000000000001] "m" ASDM
 SG_ FourDRadarObjSts35DistZ : 79|13@0+ (0.015625,-64.0) [-64.0|63.984375] "m" ASDM
 SG_ FourDRadarObjSts35DistZStd : 103|7@0+ (0.1,0.0) [0.0|12.700000000000001] "m" ASDM
 SG_ FourDRadarObjSts35DynamicProperty : 111|4@0+ (1,0) [0|15] "" ASDM
 SG_ FourDRadarObjSts35HeadingAngle : 107|12@0+ (0.0879,-180.0) [-180.0|179.95050000000003] "Deg" ASDM
 SG_ FourDRadarObjSts35ID : 127|8@0+ (1.0,0.0) [0.0|255.0] "Unitless" ASDM
 SG_ FourDRadarObjSts35LifeCycles : 135|4@0+ (1.0,0.0) [0.0|15.0] "Unitless" ASDM
 SG_ FourDRadarObjSts35ObjBoundingBoxHeight : 50|11@0+ (0.01,0.0) [0.0|20.0] "m" ASDM
 SG_ FourDRadarObjSts35ObjBoundingBoxLength : 131|12@0+ (0.01,0.0) [0.0|40.95] "m" ASDM
 SG_ FourDRadarObjSts35ObjBoundingBoxWidth : 82|11@0+ (0.01,0.0) [0.0|20.0] "m" ASDM
 SG_ FourDRadarObjSts35ObjNearestPtX : 151|16@0+ (0.015625,-512.0) [-512.0|511.984375] "m" ASDM
 SG_ FourDRadarObjSts35ObjNearestPtY : 167|13@0+ (0.015625,-64.0) [-64.0|63.984375] "m" ASDM
 SG_ FourDRadarObjSts35ObjNearestPtZ : 191|13@0+ (0.015625,-64.0) [-64.0|63.984375] "m" ASDM
 SG_ FourDRadarObjSts35ObjSNR : 169|10@0+ (0.1,0.0) [0.0|102.30000000000001] "dB" ASDM
 SG_ FourDRadarObjSts35ObjXAccRel : 193|10@0+ (0.125,-44.5) [-44.5|44.5] "m/s^2" ASDM
 SG_ FourDRadarObjSts35ObjYAccRel : 215|10@0+ (0.125,-44.5) [-44.5|44.5] "m/s^2" ASDM
 SG_ FourDRadarObjSts35ObstacleProbability : 236|5@0+ (3.2258,0.0) [0.0|99.9998] "%" ASDM
 SG_ FourDRadarObjSts35ProbabilityOfExistence : 247|8@0+ (1.0,0.0) [0.0|100.0] "%" ASDM
 SG_ FourDRadarObjSts35RCS : 231|11@0+ (0.1,-100.0) [-100.0|100.0] "dBm" ASDM
 SG_ FourDRadarObjSts35TargetClassificationConfidence : 221|6@0+ (1.5873,0.0) [0.0|99.9999] "%" ASDM
 SG_ FourDRadarObjSts35UpdateFlag : 32|1@0+ (1,0) [0|1] "" ASDM
 SG_ FourDRadarObjSts35VabsX : 263|11@0+ (0.1,-102.4) [-102.4|102.30000000000001] "m/s" ASDM
 SG_ FourDRadarObjSts35VabsXStd : 255|7@0+ (0.05,0.0) [0.0|6.3500000000000005] "m/s" ASDM
 SG_ FourDRadarObjSts35VabsY : 266|11@0+ (0.1,-102.4) [-102.4|102.30000000000001] "m/s" ASDM
 SG_ FourDRadarObjSts35VabsYStd : 287|7@0+ (0.05,0.0) [0.0|6.3500000000000005] "m/s" ASDM
 SG_ FourDRadarObjSts35ValidFlag : 64|1@0+ (1,0) [0|1] "" ASDM

BO_ 899 FLRSafetyCANFD2Frame84 : 64 FLR4
 SG_ FourDRadarObjSts37_UB : 280|1@0+ (1,0) [0|1] "" ASDM
 SG_ FourDRadarObjSts37Chks : 7|8@0+ (1.0,0.0) [0.0|255.0] "Unitless" ASDM
 SG_ FourDRadarObjSts37Classification : 15|4@0+ (1,0) [0|15] "" ASDM
 SG_ FourDRadarObjSts37Cntr : 11|4@0+ (1.0,0.0) [0.0|15.0] "Unitless" ASDM
 SG_ FourDRadarObjSts37DistX : 23|16@0+ (0.015625,-512.0) [-512.0|511.984375] "m" ASDM
 SG_ FourDRadarObjSts37DistXStd : 39|7@0+ (0.1,0.0) [0.0|12.700000000000001] "m" ASDM
 SG_ FourDRadarObjSts37DistY : 47|13@0+ (0.015625,-64.0) [-64.0|63.984375] "m" ASDM
 SG_ FourDRadarObjSts37DistYStd : 71|7@0+ (0.1,0.0) [0.0|12.700000000000001] "m" ASDM
 SG_ FourDRadarObjSts37DistZ : 79|13@0+ (0.015625,-64.0) [-64.0|63.984375] "m" ASDM
 SG_ FourDRadarObjSts37DistZStd : 103|7@0+ (0.1,0.0) [0.0|12.700000000000001] "m" ASDM
 SG_ FourDRadarObjSts37DynamicProperty : 111|4@0+ (1,0) [0|15] "" ASDM
 SG_ FourDRadarObjSts37HeadingAngle : 107|12@0+ (0.0879,-180.0) [-180.0|179.95050000000003] "Deg" ASDM
 SG_ FourDRadarObjSts37ID : 127|8@0+ (1.0,0.0) [0.0|255.0] "Unitless" ASDM
 SG_ FourDRadarObjSts37LifeCycles : 135|4@0+ (1.0,0.0) [0.0|15.0] "Unitless" ASDM
 SG_ FourDRadarObjSts37ObjBoundingBoxHeight : 50|11@0+ (0.01,0.0) [0.0|20.0] "m" ASDM
 SG_ FourDRadarObjSts37ObjBoundingBoxLength : 131|12@0+ (0.01,0.0) [0.0|40.95] "m" ASDM
 SG_ FourDRadarObjSts37ObjBoundingBoxWidth : 82|11@0+ (0.01,0.0) [0.0|20.0] "m" ASDM
 SG_ FourDRadarObjSts37ObjNearestPtX : 151|16@0+ (0.015625,-512.0) [-512.0|511.984375] "m" ASDM
 SG_ FourDRadarObjSts37ObjNearestPtY : 167|13@0+ (0.015625,-64.0) [-64.0|63.984375] "m" ASDM
 SG_ FourDRadarObjSts37ObjNearestPtZ : 191|13@0+ (0.015625,-64.0) [-64.0|63.984375] "m" ASDM
 SG_ FourDRadarObjSts37ObjSNR : 169|10@0+ (0.1,0.0) [0.0|102.30000000000001] "dB" ASDM
 SG_ FourDRadarObjSts37ObjXAccRel : 193|10@0+ (0.125,-44.5) [-44.5|44.5] "m/s^2" ASDM
 SG_ FourDRadarObjSts37ObjYAccRel : 215|10@0+ (0.125,-44.5) [-44.5|44.5] "m/s^2" ASDM
 SG_ FourDRadarObjSts37ObstacleProbability : 236|5@0+ (3.2258,0.0) [0.0|99.9998] "%" ASDM
 SG_ FourDRadarObjSts37ProbabilityOfExistence : 247|8@0+ (1.0,0.0) [0.0|100.0] "%" ASDM
 SG_ FourDRadarObjSts37RCS : 231|11@0+ (0.1,-100.0) [-100.0|100.0] "dBm" ASDM
 SG_ FourDRadarObjSts37TargetClassificationConfidence : 221|6@0+ (1.5873,0.0) [0.0|99.9999] "%" ASDM
 SG_ FourDRadarObjSts37UpdateFlag : 32|1@0+ (1,0) [0|1] "" ASDM
 SG_ FourDRadarObjSts37VabsX : 263|11@0+ (0.1,-102.4) [-102.4|102.30000000000001] "m/s" ASDM
 SG_ FourDRadarObjSts37VabsXStd : 255|7@0+ (0.05,0.0) [0.0|6.3500000000000005] "m/s" ASDM
 SG_ FourDRadarObjSts37VabsY : 266|11@0+ (0.1,-102.4) [-102.4|102.30000000000001] "m/s" ASDM
 SG_ FourDRadarObjSts37VabsYStd : 287|7@0+ (0.05,0.0) [0.0|6.3500000000000005] "m/s" ASDM
 SG_ FourDRadarObjSts37ValidFlag : 64|1@0+ (1,0) [0|1] "" ASDM

BO_ 900 FLRSafetyCANFD2Frame85 : 64 FLR4
 SG_ FourDRadarObjSts39_UB : 280|1@0+ (1,0) [0|1] "" ASDM
 SG_ FourDRadarObjSts39Chks : 7|8@0+ (1.0,0.0) [0.0|255.0] "Unitless" ASDM
 SG_ FourDRadarObjSts39Classification : 15|4@0+ (1,0) [0|15] "" ASDM
 SG_ FourDRadarObjSts39Cntr : 11|4@0+ (1.0,0.0) [0.0|15.0] "Unitless" ASDM
 SG_ FourDRadarObjSts39DistX : 23|16@0+ (0.015625,-512.0) [-512.0|511.984375] "m" ASDM
 SG_ FourDRadarObjSts39DistXStd : 39|7@0+ (0.1,0.0) [0.0|12.700000000000001] "m" ASDM
 SG_ FourDRadarObjSts39DistY : 47|13@0+ (0.015625,-64.0) [-64.0|63.984375] "m" ASDM
 SG_ FourDRadarObjSts39DistYStd : 71|7@0+ (0.1,0.0) [0.0|12.700000000000001] "m" ASDM
 SG_ FourDRadarObjSts39DistZ : 79|13@0+ (0.015625,-64.0) [-64.0|63.984375] "m" ASDM
 SG_ FourDRadarObjSts39DistZStd : 103|7@0+ (0.1,0.0) [0.0|12.700000000000001] "m" ASDM
 SG_ FourDRadarObjSts39DynamicProperty : 111|4@0+ (1,0) [0|15] "" ASDM
 SG_ FourDRadarObjSts39HeadingAngle : 107|12@0+ (0.0879,-180.0) [-180.0|179.95050000000003] "Deg" ASDM
 SG_ FourDRadarObjSts39ID : 127|8@0+ (1.0,0.0) [0.0|255.0] "Unitless" ASDM
 SG_ FourDRadarObjSts39LifeCycles : 135|4@0+ (1.0,0.0) [0.0|15.0] "Unitless" ASDM
 SG_ FourDRadarObjSts39ObjBoundingBoxHeight : 50|11@0+ (0.01,0.0) [0.0|20.0] "m" ASDM
 SG_ FourDRadarObjSts39ObjBoundingBoxLength : 131|12@0+ (0.01,0.0) [0.0|40.95] "m" ASDM
 SG_ FourDRadarObjSts39ObjBoundingBoxWidth : 82|11@0+ (0.01,0.0) [0.0|20.0] "m" ASDM
 SG_ FourDRadarObjSts39ObjNearestPtX : 151|16@0+ (0.015625,-512.0) [-512.0|511.984375] "m" ASDM
 SG_ FourDRadarObjSts39ObjNearestPtY : 167|13@0+ (0.015625,-64.0) [-64.0|63.984375] "m" ASDM
 SG_ FourDRadarObjSts39ObjNearestPtZ : 191|13@0+ (0.015625,-64.0) [-64.0|63.984375] "m" ASDM
 SG_ FourDRadarObjSts39ObjSNR : 169|10@0+ (0.1,0.0) [0.0|102.30000000000001] "dB" ASDM
 SG_ FourDRadarObjSts39ObjXAccRel : 193|10@0+ (0.125,-44.5) [-44.5|44.5] "m/s^2" ASDM
 SG_ FourDRadarObjSts39ObjYAccRel : 215|10@0+ (0.125,-44.5) [-44.5|44.5] "m/s^2" ASDM
 SG_ FourDRadarObjSts39ObstacleProbability : 236|5@0+ (3.2258,0.0) [0.0|99.9998] "%" ASDM
 SG_ FourDRadarObjSts39ProbabilityOfExistence : 247|8@0+ (1.0,0.0) [0.0|100.0] "%" ASDM
 SG_ FourDRadarObjSts39RCS : 231|11@0+ (0.1,-100.0) [-100.0|100.0] "dBm" ASDM
 SG_ FourDRadarObjSts39TargetClassificationConfidence : 221|6@0+ (1.5873,0.0) [0.0|99.9999] "%" ASDM
 SG_ FourDRadarObjSts39UpdateFlag : 32|1@0+ (1,0) [0|1] "" ASDM
 SG_ FourDRadarObjSts39VabsX : 263|11@0+ (0.1,-102.4) [-102.4|102.30000000000001] "m/s" ASDM
 SG_ FourDRadarObjSts39VabsXStd : 255|7@0+ (0.05,0.0) [0.0|6.3500000000000005] "m/s" ASDM
 SG_ FourDRadarObjSts39VabsY : 266|11@0+ (0.1,-102.4) [-102.4|102.30000000000001] "m/s" ASDM
 SG_ FourDRadarObjSts39VabsYStd : 287|7@0+ (0.05,0.0) [0.0|6.3500000000000005] "m/s" ASDM
 SG_ FourDRadarObjSts39ValidFlag : 64|1@0+ (1,0) [0|1] "" ASDM

BO_ 901 FLRSafetyCANFD2Frame86 : 64 FLR4
 SG_ FourDRadarObjSts41_UB : 280|1@0+ (1,0) [0|1] "" ASDM
 SG_ FourDRadarObjSts41Chks : 7|8@0+ (1.0,0.0) [0.0|255.0] "Unitless" ASDM
 SG_ FourDRadarObjSts41Classification : 15|4@0+ (1,0) [0|15] "" ASDM
 SG_ FourDRadarObjSts41Cntr : 11|4@0+ (1.0,0.0) [0.0|15.0] "Unitless" ASDM
 SG_ FourDRadarObjSts41DistX : 23|16@0+ (0.015625,-512.0) [-512.0|511.984375] "m" ASDM
 SG_ FourDRadarObjSts41DistXStd : 39|7@0+ (0.1,0.0) [0.0|12.700000000000001] "m" ASDM
 SG_ FourDRadarObjSts41DistY : 47|13@0+ (0.015625,-64.0) [-64.0|63.984375] "m" ASDM
 SG_ FourDRadarObjSts41DistYStd : 71|7@0+ (0.1,0.0) [0.0|12.700000000000001] "m" ASDM
 SG_ FourDRadarObjSts41DistZ : 79|13@0+ (0.015625,-64.0) [-64.0|63.984375] "m" ASDM
 SG_ FourDRadarObjSts41DistZStd : 103|7@0+ (0.1,0.0) [0.0|12.700000000000001] "m" ASDM
 SG_ FourDRadarObjSts41DynamicProperty : 111|4@0+ (1,0) [0|15] "" ASDM
 SG_ FourDRadarObjSts41HeadingAngle : 107|12@0+ (0.0879,-180.0) [-180.0|179.95050000000003] "Deg" ASDM
 SG_ FourDRadarObjSts41ID : 127|8@0+ (1.0,0.0) [0.0|255.0] "Unitless" ASDM
 SG_ FourDRadarObjSts41LifeCycles : 135|4@0+ (1.0,0.0) [0.0|15.0] "Unitless" ASDM
 SG_ FourDRadarObjSts41ObjBoundingBoxHeight : 50|11@0+ (0.01,0.0) [0.0|20.0] "m" ASDM
 SG_ FourDRadarObjSts41ObjBoundingBoxLength : 131|12@0+ (0.01,0.0) [0.0|40.95] "m" ASDM
 SG_ FourDRadarObjSts41ObjBoundingBoxWidth : 82|11@0+ (0.01,0.0) [0.0|20.0] "m" ASDM
 SG_ FourDRadarObjSts41ObjNearestPtX : 151|16@0+ (0.015625,-512.0) [-512.0|511.984375] "m" ASDM
 SG_ FourDRadarObjSts41ObjNearestPtY : 167|13@0+ (0.015625,-64.0) [-64.0|63.984375] "m" ASDM
 SG_ FourDRadarObjSts41ObjNearestPtZ : 191|13@0+ (0.015625,-64.0) [-64.0|63.984375] "m" ASDM
 SG_ FourDRadarObjSts41ObjSNR : 169|10@0+ (0.1,0.0) [0.0|102.30000000000001] "dB" ASDM
 SG_ FourDRadarObjSts41ObjXAccRel : 193|10@0+ (0.125,-44.5) [-44.5|44.5] "m/s^2" ASDM
 SG_ FourDRadarObjSts41ObjYAccRel : 215|10@0+ (0.125,-44.5) [-44.5|44.5] "m/s^2" ASDM
 SG_ FourDRadarObjSts41ObstacleProbability : 236|5@0+ (3.2258,0.0) [0.0|99.9998] "%" ASDM
 SG_ FourDRadarObjSts41ProbabilityOfExistence : 247|8@0+ (1.0,0.0) [0.0|100.0] "%" ASDM
 SG_ FourDRadarObjSts41RCS : 231|11@0+ (0.1,-100.0) [-100.0|100.0] "dBm" ASDM
 SG_ FourDRadarObjSts41TargetClassificationConfidence : 221|6@0+ (1.5873,0.0) [0.0|99.9999] "%" ASDM
 SG_ FourDRadarObjSts41UpdateFlag : 32|1@0+ (1,0) [0|1] "" ASDM
 SG_ FourDRadarObjSts41VabsX : 263|11@0+ (0.1,-102.4) [-102.4|102.30000000000001] "m/s" ASDM
 SG_ FourDRadarObjSts41VabsXStd : 255|7@0+ (0.05,0.0) [0.0|6.3500000000000005] "m/s" ASDM
 SG_ FourDRadarObjSts41VabsY : 266|11@0+ (0.1,-102.4) [-102.4|102.30000000000001] "m/s" ASDM
 SG_ FourDRadarObjSts41VabsYStd : 287|7@0+ (0.05,0.0) [0.0|6.3500000000000005] "m/s" ASDM
 SG_ FourDRadarObjSts41ValidFlag : 64|1@0+ (1,0) [0|1] "" ASDM

BO_ 863 FLRSafetyCANFD2Frame87 : 64 FLR4
 SG_ FrontFourDRadarObjSts01_UB : 280|1@0+ (1,0) [0|1] "" ASDM
 SG_ FrontFourDRadarObjSts01Chks : 7|8@0+ (1.0,0.0) [0.0|255.0] "Unitless" ASDM
 SG_ FrontFourDRadarObjSts01Classification : 15|4@0+ (1,0) [0|15] "" ASDM
 SG_ FrontFourDRadarObjSts01Cntr : 11|4@0+ (1.0,0.0) [0.0|15.0] "Unitless" ASDM
 SG_ FrontFourDRadarObjSts01DistX : 23|16@0+ (0.015625,-512.0) [-512.0|511.984375] "m" ASDM
 SG_ FrontFourDRadarObjSts01DistXStd : 39|7@0+ (0.1,0.0) [0.0|12.700000000000001] "m" ASDM
 SG_ FrontFourDRadarObjSts01DistY : 47|13@0+ (0.015625,-64.0) [-64.0|63.984375] "m" ASDM
 SG_ FrontFourDRadarObjSts01DistYStd : 71|7@0+ (0.1,0.0) [0.0|12.700000000000001] "m" ASDM
 SG_ FrontFourDRadarObjSts01DistZ : 79|13@0+ (0.015625,-64.0) [-64.0|63.984375] "m" ASDM
 SG_ FrontFourDRadarObjSts01DistZStd : 103|7@0+ (0.1,0.0) [0.0|12.700000000000001] "m" ASDM
 SG_ FrontFourDRadarObjSts01DynamicProperty : 111|4@0+ (1,0) [0|15] "" ASDM
 SG_ FrontFourDRadarObjSts01HeadingAngle : 107|12@0+ (0.0879,-180.0) [-180.0|179.95050000000003] "Deg" ASDM
 SG_ FrontFourDRadarObjSts01ID : 127|8@0+ (1.0,0.0) [0.0|255.0] "Unitless" ASDM
 SG_ FrontFourDRadarObjSts01LifeCycles : 135|4@0+ (1.0,0.0) [0.0|15.0] "Unitless" ASDM
 SG_ FrontFourDRadarObjSts01ObjBoundingBoxHeight : 50|11@0+ (0.01,0.0) [0.0|20.0] "m" ASDM
 SG_ FrontFourDRadarObjSts01ObjBoundingBoxLength : 131|12@0+ (0.01,0.0) [0.0|40.95] "m" ASDM
 SG_ FrontFourDRadarObjSts01ObjBoundingBoxWidth : 82|11@0+ (0.01,0.0) [0.0|20.0] "m" ASDM
 SG_ FrontFourDRadarObjSts01ObjNearestPtX : 151|16@0+ (0.015625,-512.0) [-512.0|511.984375] "m" ASDM
 SG_ FrontFourDRadarObjSts01ObjNearestPtY : 167|13@0+ (0.015625,-64.0) [-64.0|63.984375] "m" ASDM
 SG_ FrontFourDRadarObjSts01ObjNearestPtZ : 191|13@0+ (0.015625,-64.0) [-64.0|63.984375] "m" ASDM
 SG_ FrontFourDRadarObjSts01ObjSNR : 169|10@0+ (0.1,0.0) [0.0|102.30000000000001] "dB" ASDM
 SG_ FrontFourDRadarObjSts01ObjXAccRel : 193|10@0+ (0.125,-44.5) [-44.5|44.5] "m/s^2" ASDM
 SG_ FrontFourDRadarObjSts01ObjYAccRel : 215|10@0+ (0.125,-44.5) [-44.5|44.5] "m/s^2" ASDM
 SG_ FrontFourDRadarObjSts01ObstacleProbability : 236|5@0+ (3.2258,0.0) [0.0|99.9998] "%" ASDM
 SG_ FrontFourDRadarObjSts01ProbabilityOfExistence : 247|8@0+ (1.0,0.0) [0.0|100.0] "%" ASDM
 SG_ FrontFourDRadarObjSts01RCS : 231|11@0+ (0.1,-100.0) [-100.0|100.0] "dBm" ASDM
 SG_ FrontFourDRadarObjSts01TargetClassificationConfidence : 221|6@0+ (1.5873,0.0) [0.0|99.9999] "%" ASDM
 SG_ FrontFourDRadarObjSts01UpdateFlag : 32|1@0+ (1,0) [0|1] "" ASDM
 SG_ FrontFourDRadarObjSts01VabsX : 263|11@0+ (0.1,-102.4) [-102.4|102.30000000000001] "m/s" ASDM
 SG_ FrontFourDRadarObjSts01VabsXStd : 255|7@0+ (0.05,0.0) [0.0|6.3500000000000005] "m/s" ASDM
 SG_ FrontFourDRadarObjSts01VabsY : 266|11@0+ (0.1,-102.4) [-102.4|102.30000000000001] "m/s" ASDM
 SG_ FrontFourDRadarObjSts01VabsYStd : 287|7@0+ (0.05,0.0) [0.0|6.3500000000000005] "m/s" ASDM
 SG_ FrontFourDRadarObjSts01ValidFlag : 64|1@0+ (1,0) [0|1] "" ASDM

BO_ 873 FLRSafetyCANFD2Frame88 : 64 FLR4
 SG_ FourDRadarObjSts04_UB : 280|1@0+ (1,0) [0|1] "" ASDM
 SG_ FourDRadarObjSts04Chks : 7|8@0+ (1.0,0.0) [0.0|255.0] "Unitless" ASDM
 SG_ FourDRadarObjSts04Classification : 15|4@0+ (1,0) [0|15] "" ASDM
 SG_ FourDRadarObjSts04Cntr : 11|4@0+ (1.0,0.0) [0.0|15.0] "Unitless" ASDM
 SG_ FourDRadarObjSts04DistX : 23|16@0+ (0.015625,-512.0) [-512.0|511.984375] "m" ASDM
 SG_ FourDRadarObjSts04DistXStd : 39|7@0+ (0.1,0.0) [0.0|12.700000000000001] "m" ASDM
 SG_ FourDRadarObjSts04DistY : 47|13@0+ (0.015625,-64.0) [-64.0|63.984375] "m" ASDM
 SG_ FourDRadarObjSts04DistYStd : 71|7@0+ (0.1,0.0) [0.0|12.700000000000001] "m" ASDM
 SG_ FourDRadarObjSts04DistZ : 79|13@0+ (0.015625,-64.0) [-64.0|63.984375] "m" ASDM
 SG_ FourDRadarObjSts04DistZStd : 103|7@0+ (0.1,0.0) [0.0|12.700000000000001] "m" ASDM
 SG_ FourDRadarObjSts04DynamicProperty : 111|4@0+ (1,0) [0|15] "" ASDM
 SG_ FourDRadarObjSts04HeadingAngle : 107|12@0+ (0.0879,-180.0) [-180.0|179.95050000000003] "Deg" ASDM
 SG_ FourDRadarObjSts04ID : 127|8@0+ (1.0,0.0) [0.0|255.0] "Unitless" ASDM
 SG_ FourDRadarObjSts04LifeCycles : 135|4@0+ (1.0,0.0) [0.0|15.0] "Unitless" ASDM
 SG_ FourDRadarObjSts04ObjBoundingBoxHeight : 50|11@0+ (0.01,0.0) [0.0|20.0] "m" ASDM
 SG_ FourDRadarObjSts04ObjBoundingBoxLength : 131|12@0+ (0.01,0.0) [0.0|40.95] "m" ASDM
 SG_ FourDRadarObjSts04ObjBoundingBoxWidth : 82|11@0+ (0.01,0.0) [0.0|20.0] "m" ASDM
 SG_ FourDRadarObjSts04ObjNearestPtX : 151|16@0+ (0.015625,-512.0) [-512.0|511.984375] "m" ASDM
 SG_ FourDRadarObjSts04ObjNearestPtY : 167|13@0+ (0.015625,-64.0) [-64.0|63.984375] "m" ASDM
 SG_ FourDRadarObjSts04ObjNearestPtZ : 191|13@0+ (0.015625,-64.0) [-64.0|63.984375] "m" ASDM
 SG_ FourDRadarObjSts04ObjSNR : 169|10@0+ (0.1,0.0) [0.0|102.30000000000001] "dB" ASDM
 SG_ FourDRadarObjSts04ObjXAccRel : 193|10@0+ (0.125,-44.5) [-44.5|44.5] "m/s^2" ASDM
 SG_ FourDRadarObjSts04ObjYAccRel : 215|10@0+ (0.125,-44.5) [-44.5|44.5] "m/s^2" ASDM
 SG_ FourDRadarObjSts04ObstacleProbability : 236|5@0+ (3.2258,0.0) [0.0|99.9998] "%" ASDM
 SG_ FourDRadarObjSts04ProbabilityOfExistence : 247|8@0+ (1.0,0.0) [0.0|100.0] "%" ASDM
 SG_ FourDRadarObjSts04RCS : 231|11@0+ (0.1,-100.0) [-100.0|100.0] "dBm" ASDM
 SG_ FourDRadarObjSts04TargetClassificationConfidence : 221|6@0+ (1.5873,0.0) [0.0|99.9999] "%" ASDM
 SG_ FourDRadarObjSts04UpdateFlag : 32|1@0+ (1,0) [0|1] "" ASDM
 SG_ FourDRadarObjSts04VabsX : 263|11@0+ (0.1,-102.4) [-102.4|102.30000000000001] "m/s" ASDM
 SG_ FourDRadarObjSts04VabsXStd : 255|7@0+ (0.05,0.0) [0.0|6.3500000000000005] "m/s" ASDM
 SG_ FourDRadarObjSts04VabsY : 266|11@0+ (0.1,-102.4) [-102.4|102.30000000000001] "m/s" ASDM
 SG_ FourDRadarObjSts04VabsYStd : 287|7@0+ (0.05,0.0) [0.0|6.3500000000000005] "m/s" ASDM
 SG_ FourDRadarObjSts04ValidFlag : 64|1@0+ (1,0) [0|1] "" ASDM

BO_ 951 FLRSafetyCANFD2Frame89 : 64 FLR4
 SG_ FourDRadarObjSts06_UB : 280|1@0+ (1,0) [0|1] "" ASDM
 SG_ FourDRadarObjSts06Chks : 7|8@0+ (1.0,0.0) [0.0|255.0] "Unitless" ASDM
 SG_ FourDRadarObjSts06Classification : 15|4@0+ (1,0) [0|15] "" ASDM
 SG_ FourDRadarObjSts06Cntr : 11|4@0+ (1.0,0.0) [0.0|15.0] "Unitless" ASDM
 SG_ FourDRadarObjSts06DistX : 23|16@0+ (0.015625,-512.0) [-512.0|511.984375] "m" ASDM
 SG_ FourDRadarObjSts06DistXStd : 39|7@0+ (0.1,0.0) [0.0|12.700000000000001] "m" ASDM
 SG_ FourDRadarObjSts06DistY : 47|13@0+ (0.015625,-64.0) [-64.0|63.984375] "m" ASDM
 SG_ FourDRadarObjSts06DistYStd : 71|7@0+ (0.1,0.0) [0.0|12.700000000000001] "m" ASDM
 SG_ FourDRadarObjSts06DistZ : 79|13@0+ (0.015625,-64.0) [-64.0|63.984375] "m" ASDM
 SG_ FourDRadarObjSts06DistZStd : 103|7@0+ (0.1,0.0) [0.0|12.700000000000001] "m" ASDM
 SG_ FourDRadarObjSts06DynamicProperty : 111|4@0+ (1,0) [0|15] "" ASDM
 SG_ FourDRadarObjSts06HeadingAngle : 107|12@0+ (0.0879,-180.0) [-180.0|179.95050000000003] "Deg" ASDM
 SG_ FourDRadarObjSts06ID : 127|8@0+ (1.0,0.0) [0.0|255.0] "Unitless" ASDM
 SG_ FourDRadarObjSts06LifeCycles : 135|4@0+ (1.0,0.0) [0.0|15.0] "Unitless" ASDM
 SG_ FourDRadarObjSts06ObjBoundingBoxHeight : 50|11@0+ (0.01,0.0) [0.0|20.0] "m" ASDM
 SG_ FourDRadarObjSts06ObjBoundingBoxLength : 131|12@0+ (0.01,0.0) [0.0|40.95] "m" ASDM
 SG_ FourDRadarObjSts06ObjBoundingBoxWidth : 82|11@0+ (0.01,0.0) [0.0|20.0] "m" ASDM
 SG_ FourDRadarObjSts06ObjNearestPtX : 151|16@0+ (0.015625,-512.0) [-512.0|511.984375] "m" ASDM
 SG_ FourDRadarObjSts06ObjNearestPtY : 167|13@0+ (0.015625,-64.0) [-64.0|63.984375] "m" ASDM
 SG_ FourDRadarObjSts06ObjNearestPtZ : 191|13@0+ (0.015625,-64.0) [-64.0|63.984375] "m" ASDM
 SG_ FourDRadarObjSts06ObjSNR : 169|10@0+ (0.1,0.0) [0.0|102.30000000000001] "dB" ASDM
 SG_ FourDRadarObjSts06ObjXAccRel : 193|10@0+ (0.125,-44.5) [-44.5|44.5] "m/s^2" ASDM
 SG_ FourDRadarObjSts06ObjYAccRel : 215|10@0+ (0.125,-44.5) [-44.5|44.5] "m/s^2" ASDM
 SG_ FourDRadarObjSts06ObstacleProbability : 236|5@0+ (3.2258,0.0) [0.0|99.9998] "%" ASDM
 SG_ FourDRadarObjSts06ProbabilityOfExistence : 247|8@0+ (1.0,0.0) [0.0|100.0] "%" ASDM
 SG_ FourDRadarObjSts06RCS : 231|11@0+ (0.1,-100.0) [-100.0|100.0] "dBm" ASDM
 SG_ FourDRadarObjSts06TargetClassificationConfidence : 221|6@0+ (1.5873,0.0) [0.0|99.9999] "%" ASDM
 SG_ FourDRadarObjSts06UpdateFlag : 32|1@0+ (1,0) [0|1] "" ASDM
 SG_ FourDRadarObjSts06VabsX : 263|11@0+ (0.1,-102.4) [-102.4|102.30000000000001] "m/s" ASDM
 SG_ FourDRadarObjSts06VabsXStd : 255|7@0+ (0.05,0.0) [0.0|6.3500000000000005] "m/s" ASDM
 SG_ FourDRadarObjSts06VabsY : 266|11@0+ (0.1,-102.4) [-102.4|102.30000000000001] "m/s" ASDM
 SG_ FourDRadarObjSts06VabsYStd : 287|7@0+ (0.05,0.0) [0.0|6.3500000000000005] "m/s" ASDM
 SG_ FourDRadarObjSts06ValidFlag : 64|1@0+ (1,0) [0|1] "" ASDM

BO_ 903 FLRSafetyCANFD2Frame90 : 64 FLR4
 SG_ FourDRadarObjSts08_UB : 280|1@0+ (1,0) [0|1] "" ASDM
 SG_ FourDRadarObjSts08Chks : 7|8@0+ (1.0,0.0) [0.0|255.0] "Unitless" ASDM
 SG_ FourDRadarObjSts08Classification : 15|4@0+ (1,0) [0|15] "" ASDM
 SG_ FourDRadarObjSts08Cntr : 11|4@0+ (1.0,0.0) [0.0|15.0] "Unitless" ASDM
 SG_ FourDRadarObjSts08DistX : 23|16@0+ (0.015625,-512.0) [-512.0|511.984375] "m" ASDM
 SG_ FourDRadarObjSts08DistXStd : 39|7@0+ (0.1,0.0) [0.0|12.700000000000001] "m" ASDM
 SG_ FourDRadarObjSts08DistY : 47|13@0+ (0.015625,-64.0) [-64.0|63.984375] "m" ASDM
 SG_ FourDRadarObjSts08DistYStd : 71|7@0+ (0.1,0.0) [0.0|12.700000000000001] "m" ASDM
 SG_ FourDRadarObjSts08DistZ : 79|13@0+ (0.015625,-64.0) [-64.0|63.984375] "m" ASDM
 SG_ FourDRadarObjSts08DistZStd : 103|7@0+ (0.1,0.0) [0.0|12.700000000000001] "m" ASDM
 SG_ FourDRadarObjSts08DynamicProperty : 111|4@0+ (1,0) [0|15] "" ASDM
 SG_ FourDRadarObjSts08HeadingAngle : 107|12@0+ (0.0879,-180.0) [-180.0|179.95050000000003] "Deg" ASDM
 SG_ FourDRadarObjSts08ID : 127|8@0+ (1.0,0.0) [0.0|255.0] "Unitless" ASDM
 SG_ FourDRadarObjSts08LifeCycles : 135|4@0+ (1.0,0.0) [0.0|15.0] "Unitless" ASDM
 SG_ FourDRadarObjSts08ObjBoundingBoxHeight : 50|11@0+ (0.01,0.0) [0.0|20.0] "m" ASDM
 SG_ FourDRadarObjSts08ObjBoundingBoxLength : 131|12@0+ (0.01,0.0) [0.0|40.95] "m" ASDM
 SG_ FourDRadarObjSts08ObjBoundingBoxWidth : 82|11@0+ (0.01,0.0) [0.0|20.0] "m" ASDM
 SG_ FourDRadarObjSts08ObjNearestPtX : 151|16@0+ (0.015625,-512.0) [-512.0|511.984375] "m" ASDM
 SG_ FourDRadarObjSts08ObjNearestPtY : 167|13@0+ (0.015625,-64.0) [-64.0|63.984375] "m" ASDM
 SG_ FourDRadarObjSts08ObjNearestPtZ : 191|13@0+ (0.015625,-64.0) [-64.0|63.984375] "m" ASDM
 SG_ FourDRadarObjSts08ObjSNR : 169|10@0+ (0.1,0.0) [0.0|102.30000000000001] "dB" ASDM
 SG_ FourDRadarObjSts08ObjXAccRel : 193|10@0+ (0.125,-44.5) [-44.5|44.5] "m/s^2" ASDM
 SG_ FourDRadarObjSts08ObjYAccRel : 215|10@0+ (0.125,-44.5) [-44.5|44.5] "m/s^2" ASDM
 SG_ FourDRadarObjSts08ObstacleProbability : 236|5@0+ (3.2258,0.0) [0.0|99.9998] "%" ASDM
 SG_ FourDRadarObjSts08ProbabilityOfExistence : 247|8@0+ (1.0,0.0) [0.0|100.0] "%" ASDM
 SG_ FourDRadarObjSts08RCS : 231|11@0+ (0.1,-100.0) [-100.0|100.0] "dBm" ASDM
 SG_ FourDRadarObjSts08TargetClassificationConfidence : 221|6@0+ (1.5873,0.0) [0.0|99.9999] "%" ASDM
 SG_ FourDRadarObjSts08UpdateFlag : 32|1@0+ (1,0) [0|1] "" ASDM
 SG_ FourDRadarObjSts08VabsX : 263|11@0+ (0.1,-102.4) [-102.4|102.30000000000001] "m/s" ASDM
 SG_ FourDRadarObjSts08VabsXStd : 255|7@0+ (0.05,0.0) [0.0|6.3500000000000005] "m/s" ASDM
 SG_ FourDRadarObjSts08VabsY : 266|11@0+ (0.1,-102.4) [-102.4|102.30000000000001] "m/s" ASDM
 SG_ FourDRadarObjSts08VabsYStd : 287|7@0+ (0.05,0.0) [0.0|6.3500000000000005] "m/s" ASDM
 SG_ FourDRadarObjSts08ValidFlag : 64|1@0+ (1,0) [0|1] "" ASDM

BO_ 913 FLRSafetyCANFD2Frame91 : 64 FLR4
 SG_ FourDRadarObjSts10_UB : 280|1@0+ (1,0) [0|1] "" ASDM
 SG_ FourDRadarObjSts10Chks : 7|8@0+ (1.0,0.0) [0.0|255.0] "Unitless" ASDM
 SG_ FourDRadarObjSts10Classification : 15|4@0+ (1,0) [0|15] "" ASDM
 SG_ FourDRadarObjSts10Cntr : 11|4@0+ (1.0,0.0) [0.0|15.0] "Unitless" ASDM
 SG_ FourDRadarObjSts10DistX : 23|16@0+ (0.015625,-512.0) [-512.0|511.984375] "m" ASDM
 SG_ FourDRadarObjSts10DistXStd : 39|7@0+ (0.1,0.0) [0.0|12.700000000000001] "m" ASDM
 SG_ FourDRadarObjSts10DistY : 47|13@0+ (0.015625,-64.0) [-64.0|63.984375] "m" ASDM
 SG_ FourDRadarObjSts10DistYStd : 71|7@0+ (0.1,0.0) [0.0|12.700000000000001] "m" ASDM
 SG_ FourDRadarObjSts10DistZ : 79|13@0+ (0.015625,-64.0) [-64.0|63.984375] "m" ASDM
 SG_ FourDRadarObjSts10DistZStd : 103|7@0+ (0.1,0.0) [0.0|12.700000000000001] "m" ASDM
 SG_ FourDRadarObjSts10DynamicProperty : 111|4@0+ (1,0) [0|15] "" ASDM
 SG_ FourDRadarObjSts10HeadingAngle : 107|12@0+ (0.0879,-180.0) [-180.0|179.95050000000003] "Deg" ASDM
 SG_ FourDRadarObjSts10ID : 127|8@0+ (1.0,0.0) [0.0|255.0] "Unitless" ASDM
 SG_ FourDRadarObjSts10LifeCycles : 135|4@0+ (1.0,0.0) [0.0|15.0] "Unitless" ASDM
 SG_ FourDRadarObjSts10ObjBoundingBoxHeight : 50|11@0+ (0.01,0.0) [0.0|20.0] "m" ASDM
 SG_ FourDRadarObjSts10ObjBoundingBoxLength : 131|12@0+ (0.01,0.0) [0.0|40.95] "m" ASDM
 SG_ FourDRadarObjSts10ObjBoundingBoxWidth : 82|11@0+ (0.01,0.0) [0.0|20.0] "m" ASDM
 SG_ FourDRadarObjSts10ObjNearestPtX : 151|16@0+ (0.015625,-512.0) [-512.0|511.984375] "m" ASDM
 SG_ FourDRadarObjSts10ObjNearestPtY : 167|13@0+ (0.015625,-64.0) [-64.0|63.984375] "m" ASDM
 SG_ FourDRadarObjSts10ObjNearestPtZ : 191|13@0+ (0.015625,-64.0) [-64.0|63.984375] "m" ASDM
 SG_ FourDRadarObjSts10ObjSNR : 169|10@0+ (0.1,0.0) [0.0|102.30000000000001] "dB" ASDM
 SG_ FourDRadarObjSts10ObjXAccRel : 193|10@0+ (0.125,-44.5) [-44.5|44.5] "m/s^2" ASDM
 SG_ FourDRadarObjSts10ObjYAccRel : 215|10@0+ (0.125,-44.5) [-44.5|44.5] "m/s^2" ASDM
 SG_ FourDRadarObjSts10ObstacleProbability : 236|5@0+ (3.2258,0.0) [0.0|99.9998] "%" ASDM
 SG_ FourDRadarObjSts10ProbabilityOfExistence : 247|8@0+ (1.0,0.0) [0.0|100.0] "%" ASDM
 SG_ FourDRadarObjSts10RCS : 231|11@0+ (0.1,-100.0) [-100.0|100.0] "dBm" ASDM
 SG_ FourDRadarObjSts10TargetClassificationConfidence : 221|6@0+ (1.5873,0.0) [0.0|99.9999] "%" ASDM
 SG_ FourDRadarObjSts10UpdateFlag : 32|1@0+ (1,0) [0|1] "" ASDM
 SG_ FourDRadarObjSts10VabsX : 263|11@0+ (0.1,-102.4) [-102.4|102.30000000000001] "m/s" ASDM
 SG_ FourDRadarObjSts10VabsXStd : 255|7@0+ (0.05,0.0) [0.0|6.3500000000000005] "m/s" ASDM
 SG_ FourDRadarObjSts10VabsY : 266|11@0+ (0.1,-102.4) [-102.4|102.30000000000001] "m/s" ASDM
 SG_ FourDRadarObjSts10VabsYStd : 287|7@0+ (0.05,0.0) [0.0|6.3500000000000005] "m/s" ASDM
 SG_ FourDRadarObjSts10ValidFlag : 64|1@0+ (1,0) [0|1] "" ASDM

BO_ 923 FLRSafetyCANFD2Frame92 : 64 FLR4
 SG_ FourDRadarObjSts12_UB : 280|1@0+ (1,0) [0|1] "" ASDM
 SG_ FourDRadarObjSts12Chks : 7|8@0+ (1.0,0.0) [0.0|255.0] "Unitless" ASDM
 SG_ FourDRadarObjSts12Classification : 15|4@0+ (1,0) [0|15] "" ASDM
 SG_ FourDRadarObjSts12Cntr : 11|4@0+ (1.0,0.0) [0.0|15.0] "Unitless" ASDM
 SG_ FourDRadarObjSts12DistX : 23|16@0+ (0.015625,-512.0) [-512.0|511.984375] "m" ASDM
 SG_ FourDRadarObjSts12DistXStd : 39|7@0+ (0.1,0.0) [0.0|12.700000000000001] "m" ASDM
 SG_ FourDRadarObjSts12DistY : 47|13@0+ (0.015625,-64.0) [-64.0|63.984375] "m" ASDM
 SG_ FourDRadarObjSts12DistYStd : 71|7@0+ (0.1,0.0) [0.0|12.700000000000001] "m" ASDM
 SG_ FourDRadarObjSts12DistZ : 79|13@0+ (0.015625,-64.0) [-64.0|63.984375] "m" ASDM
 SG_ FourDRadarObjSts12DistZStd : 103|7@0+ (0.1,0.0) [0.0|12.700000000000001] "m" ASDM
 SG_ FourDRadarObjSts12DynamicProperty : 111|4@0+ (1,0) [0|15] "" ASDM
 SG_ FourDRadarObjSts12HeadingAngle : 107|12@0+ (0.0879,-180.0) [-180.0|179.95050000000003] "Deg" ASDM
 SG_ FourDRadarObjSts12ID : 127|8@0+ (1.0,0.0) [0.0|255.0] "Unitless" ASDM
 SG_ FourDRadarObjSts12LifeCycles : 135|4@0+ (1.0,0.0) [0.0|15.0] "Unitless" ASDM
 SG_ FourDRadarObjSts12ObjBoundingBoxHeight : 50|11@0+ (0.01,0.0) [0.0|20.0] "m" ASDM
 SG_ FourDRadarObjSts12ObjBoundingBoxLength : 131|12@0+ (0.01,0.0) [0.0|40.95] "m" ASDM
 SG_ FourDRadarObjSts12ObjBoundingBoxWidth : 82|11@0+ (0.01,0.0) [0.0|20.0] "m" ASDM
 SG_ FourDRadarObjSts12ObjNearestPtX : 151|16@0+ (0.015625,-512.0) [-512.0|511.984375] "m" ASDM
 SG_ FourDRadarObjSts12ObjNearestPtY : 167|13@0+ (0.015625,-64.0) [-64.0|63.984375] "m" ASDM
 SG_ FourDRadarObjSts12ObjNearestPtZ : 191|13@0+ (0.015625,-64.0) [-64.0|63.984375] "m" ASDM
 SG_ FourDRadarObjSts12ObjSNR : 169|10@0+ (0.1,0.0) [0.0|102.30000000000001] "dB" ASDM
 SG_ FourDRadarObjSts12ObjXAccRel : 193|10@0+ (0.125,-44.5) [-44.5|44.5] "m/s^2" ASDM
 SG_ FourDRadarObjSts12ObjYAccRel : 215|10@0+ (0.125,-44.5) [-44.5|44.5] "m/s^2" ASDM
 SG_ FourDRadarObjSts12ObstacleProbability : 236|5@0+ (3.2258,0.0) [0.0|99.9998] "%" ASDM
 SG_ FourDRadarObjSts12ProbabilityOfExistence : 247|8@0+ (1.0,0.0) [0.0|100.0] "%" ASDM
 SG_ FourDRadarObjSts12RCS : 231|11@0+ (0.1,-100.0) [-100.0|100.0] "dBm" ASDM
 SG_ FourDRadarObjSts12TargetClassificationConfidence : 221|6@0+ (1.5873,0.0) [0.0|99.9999] "%" ASDM
 SG_ FourDRadarObjSts12UpdateFlag : 32|1@0+ (1,0) [0|1] "" ASDM
 SG_ FourDRadarObjSts12VabsX : 263|11@0+ (0.1,-102.4) [-102.4|102.30000000000001] "m/s" ASDM
 SG_ FourDRadarObjSts12VabsXStd : 255|7@0+ (0.05,0.0) [0.0|6.3500000000000005] "m/s" ASDM
 SG_ FourDRadarObjSts12VabsY : 266|11@0+ (0.1,-102.4) [-102.4|102.30000000000001] "m/s" ASDM
 SG_ FourDRadarObjSts12VabsYStd : 287|7@0+ (0.05,0.0) [0.0|6.3500000000000005] "m/s" ASDM
 SG_ FourDRadarObjSts12ValidFlag : 64|1@0+ (1,0) [0|1] "" ASDM

BO_ 952 FLRSafetyCANFD2Frame93 : 64 FLR4
 SG_ FourDRadarObjSts14_UB : 280|1@0+ (1,0) [0|1] "" ASDM
 SG_ FourDRadarObjSts14Chks : 7|8@0+ (1.0,0.0) [0.0|255.0] "Unitless" ASDM
 SG_ FourDRadarObjSts14Classification : 15|4@0+ (1,0) [0|15] "" ASDM
 SG_ FourDRadarObjSts14Cntr : 11|4@0+ (1.0,0.0) [0.0|15.0] "Unitless" ASDM
 SG_ FourDRadarObjSts14DistX : 23|16@0+ (0.015625,-512.0) [-512.0|511.984375] "m" ASDM
 SG_ FourDRadarObjSts14DistXStd : 39|7@0+ (0.1,0.0) [0.0|12.700000000000001] "m" ASDM
 SG_ FourDRadarObjSts14DistY : 47|13@0+ (0.015625,-64.0) [-64.0|63.984375] "m" ASDM
 SG_ FourDRadarObjSts14DistYStd : 71|7@0+ (0.1,0.0) [0.0|12.700000000000001] "m" ASDM
 SG_ FourDRadarObjSts14DistZ : 79|13@0+ (0.015625,-64.0) [-64.0|63.984375] "m" ASDM
 SG_ FourDRadarObjSts14DistZStd : 103|7@0+ (0.1,0.0) [0.0|12.700000000000001] "m" ASDM
 SG_ FourDRadarObjSts14DynamicProperty : 111|4@0+ (1,0) [0|15] "" ASDM
 SG_ FourDRadarObjSts14HeadingAngle : 107|12@0+ (0.0879,-180.0) [-180.0|179.95050000000003] "Deg" ASDM
 SG_ FourDRadarObjSts14ID : 127|8@0+ (1.0,0.0) [0.0|255.0] "Unitless" ASDM
 SG_ FourDRadarObjSts14LifeCycles : 135|4@0+ (1.0,0.0) [0.0|15.0] "Unitless" ASDM
 SG_ FourDRadarObjSts14ObjBoundingBoxHeight : 50|11@0+ (0.01,0.0) [0.0|20.0] "m" ASDM
 SG_ FourDRadarObjSts14ObjBoundingBoxLength : 131|12@0+ (0.01,0.0) [0.0|40.95] "m" ASDM
 SG_ FourDRadarObjSts14ObjBoundingBoxWidth : 82|11@0+ (0.01,0.0) [0.0|20.0] "m" ASDM
 SG_ FourDRadarObjSts14ObjNearestPtX : 151|16@0+ (0.015625,-512.0) [-512.0|511.984375] "m" ASDM
 SG_ FourDRadarObjSts14ObjNearestPtY : 167|13@0+ (0.015625,-64.0) [-64.0|63.984375] "m" ASDM
 SG_ FourDRadarObjSts14ObjNearestPtZ : 191|13@0+ (0.015625,-64.0) [-64.0|63.984375] "m" ASDM
 SG_ FourDRadarObjSts14ObjSNR : 169|10@0+ (0.1,0.0) [0.0|102.30000000000001] "dB" ASDM
 SG_ FourDRadarObjSts14ObjXAccRel : 193|10@0+ (0.125,-44.5) [-44.5|44.5] "m/s^2" ASDM
 SG_ FourDRadarObjSts14ObjYAccRel : 215|10@0+ (0.125,-44.5) [-44.5|44.5] "m/s^2" ASDM
 SG_ FourDRadarObjSts14ObstacleProbability : 236|5@0+ (3.2258,0.0) [0.0|99.9998] "%" ASDM
 SG_ FourDRadarObjSts14ProbabilityOfExistence : 247|8@0+ (1.0,0.0) [0.0|100.0] "%" ASDM
 SG_ FourDRadarObjSts14RCS : 231|11@0+ (0.1,-100.0) [-100.0|100.0] "dBm" ASDM
 SG_ FourDRadarObjSts14TargetClassificationConfidence : 221|6@0+ (1.5873,0.0) [0.0|99.9999] "%" ASDM
 SG_ FourDRadarObjSts14UpdateFlag : 32|1@0+ (1,0) [0|1] "" ASDM
 SG_ FourDRadarObjSts14VabsX : 263|11@0+ (0.1,-102.4) [-102.4|102.30000000000001] "m/s" ASDM
 SG_ FourDRadarObjSts14VabsXStd : 255|7@0+ (0.05,0.0) [0.0|6.3500000000000005] "m/s" ASDM
 SG_ FourDRadarObjSts14VabsY : 266|11@0+ (0.1,-102.4) [-102.4|102.30000000000001] "m/s" ASDM
 SG_ FourDRadarObjSts14VabsYStd : 287|7@0+ (0.05,0.0) [0.0|6.3500000000000005] "m/s" ASDM
 SG_ FourDRadarObjSts14ValidFlag : 64|1@0+ (1,0) [0|1] "" ASDM

BO_ 954 FLRSafetyCANFD2Frame94 : 64 FLR4
 SG_ FourDRadarObjSts16_UB : 280|1@0+ (1,0) [0|1] "" ASDM
 SG_ FourDRadarObjSts16Chks : 7|8@0+ (1.0,0.0) [0.0|255.0] "Unitless" ASDM
 SG_ FourDRadarObjSts16Classification : 15|4@0+ (1,0) [0|15] "" ASDM
 SG_ FourDRadarObjSts16Cntr : 11|4@0+ (1.0,0.0) [0.0|15.0] "Unitless" ASDM
 SG_ FourDRadarObjSts16DistX : 23|16@0+ (0.015625,-512.0) [-512.0|511.984375] "m" ASDM
 SG_ FourDRadarObjSts16DistXStd : 39|7@0+ (0.1,0.0) [0.0|12.700000000000001] "m" ASDM
 SG_ FourDRadarObjSts16DistY : 47|13@0+ (0.015625,-64.0) [-64.0|63.984375] "m" ASDM
 SG_ FourDRadarObjSts16DistYStd : 71|7@0+ (0.1,0.0) [0.0|12.700000000000001] "m" ASDM
 SG_ FourDRadarObjSts16DistZ : 79|13@0+ (0.015625,-64.0) [-64.0|63.984375] "m" ASDM
 SG_ FourDRadarObjSts16DistZStd : 103|7@0+ (0.1,0.0) [0.0|12.700000000000001] "m" ASDM
 SG_ FourDRadarObjSts16DynamicProperty : 111|4@0+ (1,0) [0|15] "" ASDM
 SG_ FourDRadarObjSts16HeadingAngle : 107|12@0+ (0.0879,-180.0) [-180.0|179.95050000000003] "Deg" ASDM
 SG_ FourDRadarObjSts16ID : 127|8@0+ (1.0,0.0) [0.0|255.0] "Unitless" ASDM
 SG_ FourDRadarObjSts16LifeCycles : 135|4@0+ (1.0,0.0) [0.0|15.0] "Unitless" ASDM
 SG_ FourDRadarObjSts16ObjBoundingBoxHeight : 50|11@0+ (0.01,0.0) [0.0|20.0] "m" ASDM
 SG_ FourDRadarObjSts16ObjBoundingBoxLength : 131|12@0+ (0.01,0.0) [0.0|40.95] "m" ASDM
 SG_ FourDRadarObjSts16ObjBoundingBoxWidth : 82|11@0+ (0.01,0.0) [0.0|20.0] "m" ASDM
 SG_ FourDRadarObjSts16ObjNearestPtX : 151|16@0+ (0.015625,-512.0) [-512.0|511.984375] "m" ASDM
 SG_ FourDRadarObjSts16ObjNearestPtY : 167|13@0+ (0.015625,-64.0) [-64.0|63.984375] "m" ASDM
 SG_ FourDRadarObjSts16ObjNearestPtZ : 191|13@0+ (0.015625,-64.0) [-64.0|63.984375] "m" ASDM
 SG_ FourDRadarObjSts16ObjSNR : 169|10@0+ (0.1,0.0) [0.0|102.30000000000001] "dB" ASDM
 SG_ FourDRadarObjSts16ObjXAccRel : 193|10@0+ (0.125,-44.5) [-44.5|44.5] "m/s^2" ASDM
 SG_ FourDRadarObjSts16ObjYAccRel : 215|10@0+ (0.125,-44.5) [-44.5|44.5] "m/s^2" ASDM
 SG_ FourDRadarObjSts16ObstacleProbability : 236|5@0+ (3.2258,0.0) [0.0|99.9998] "%" ASDM
 SG_ FourDRadarObjSts16ProbabilityOfExistence : 247|8@0+ (1.0,0.0) [0.0|100.0] "%" ASDM
 SG_ FourDRadarObjSts16RCS : 231|11@0+ (0.1,-100.0) [-100.0|100.0] "dBm" ASDM
 SG_ FourDRadarObjSts16TargetClassificationConfidence : 221|6@0+ (1.5873,0.0) [0.0|99.9999] "%" ASDM
 SG_ FourDRadarObjSts16UpdateFlag : 32|1@0+ (1,0) [0|1] "" ASDM
 SG_ FourDRadarObjSts16VabsX : 263|11@0+ (0.1,-102.4) [-102.4|102.30000000000001] "m/s" ASDM
 SG_ FourDRadarObjSts16VabsXStd : 255|7@0+ (0.05,0.0) [0.0|6.3500000000000005] "m/s" ASDM
 SG_ FourDRadarObjSts16VabsY : 266|11@0+ (0.1,-102.4) [-102.4|102.30000000000001] "m/s" ASDM
 SG_ FourDRadarObjSts16VabsYStd : 287|7@0+ (0.05,0.0) [0.0|6.3500000000000005] "m/s" ASDM
 SG_ FourDRadarObjSts16ValidFlag : 64|1@0+ (1,0) [0|1] "" ASDM

BO_ 953 FLRSafetyCANFD2Frame95 : 64 FLR4
 SG_ FourDRadarObjSts18_UB : 280|1@0+ (1,0) [0|1] "" ASDM
 SG_ FourDRadarObjSts18Chks : 7|8@0+ (1.0,0.0) [0.0|255.0] "Unitless" ASDM
 SG_ FourDRadarObjSts18Classification : 15|4@0+ (1,0) [0|15] "" ASDM
 SG_ FourDRadarObjSts18Cntr : 11|4@0+ (1.0,0.0) [0.0|15.0] "Unitless" ASDM
 SG_ FourDRadarObjSts18DistX : 23|16@0+ (0.015625,-512.0) [-512.0|511.984375] "m" ASDM
 SG_ FourDRadarObjSts18DistXStd : 39|7@0+ (0.1,0.0) [0.0|12.700000000000001] "m" ASDM
 SG_ FourDRadarObjSts18DistY : 47|13@0+ (0.015625,-64.0) [-64.0|63.984375] "m" ASDM
 SG_ FourDRadarObjSts18DistYStd : 71|7@0+ (0.1,0.0) [0.0|12.700000000000001] "m" ASDM
 SG_ FourDRadarObjSts18DistZ : 79|13@0+ (0.015625,-64.0) [-64.0|63.984375] "m" ASDM
 SG_ FourDRadarObjSts18DistZStd : 103|7@0+ (0.1,0.0) [0.0|12.700000000000001] "m" ASDM
 SG_ FourDRadarObjSts18DynamicProperty : 111|4@0+ (1,0) [0|15] "" ASDM
 SG_ FourDRadarObjSts18HeadingAngle : 107|12@0+ (0.0879,-180.0) [-180.0|179.95050000000003] "Deg" ASDM
 SG_ FourDRadarObjSts18ID : 127|8@0+ (1.0,0.0) [0.0|255.0] "Unitless" ASDM
 SG_ FourDRadarObjSts18LifeCycles : 135|4@0+ (1.0,0.0) [0.0|15.0] "Unitless" ASDM
 SG_ FourDRadarObjSts18ObjBoundingBoxHeight : 50|11@0+ (0.01,0.0) [0.0|20.0] "m" ASDM
 SG_ FourDRadarObjSts18ObjBoundingBoxLength : 131|12@0+ (0.01,0.0) [0.0|40.95] "m" ASDM
 SG_ FourDRadarObjSts18ObjBoundingBoxWidth : 82|11@0+ (0.01,0.0) [0.0|20.0] "m" ASDM
 SG_ FourDRadarObjSts18ObjNearestPtX : 151|16@0+ (0.015625,-512.0) [-512.0|511.984375] "m" ASDM
 SG_ FourDRadarObjSts18ObjNearestPtY : 167|13@0+ (0.015625,-64.0) [-64.0|63.984375] "m" ASDM
 SG_ FourDRadarObjSts18ObjNearestPtZ : 191|13@0+ (0.015625,-64.0) [-64.0|63.984375] "m" ASDM
 SG_ FourDRadarObjSts18ObjSNR : 169|10@0+ (0.1,0.0) [0.0|102.30000000000001] "dB" ASDM
 SG_ FourDRadarObjSts18ObjXAccRel : 193|10@0+ (0.125,-44.5) [-44.5|44.5] "m/s^2" ASDM
 SG_ FourDRadarObjSts18ObjYAccRel : 215|10@0+ (0.125,-44.5) [-44.5|44.5] "m/s^2" ASDM
 SG_ FourDRadarObjSts18ObstacleProbability : 236|5@0+ (3.2258,0.0) [0.0|99.9998] "%" ASDM
 SG_ FourDRadarObjSts18ProbabilityOfExistence : 247|8@0+ (1.0,0.0) [0.0|100.0] "%" ASDM
 SG_ FourDRadarObjSts18RCS : 231|11@0+ (0.1,-100.0) [-100.0|100.0] "dBm" ASDM
 SG_ FourDRadarObjSts18TargetClassificationConfidence : 221|6@0+ (1.5873,0.0) [0.0|99.9999] "%" ASDM
 SG_ FourDRadarObjSts18UpdateFlag : 32|1@0+ (1,0) [0|1] "" ASDM
 SG_ FourDRadarObjSts18VabsX : 263|11@0+ (0.1,-102.4) [-102.4|102.30000000000001] "m/s" ASDM
 SG_ FourDRadarObjSts18VabsXStd : 255|7@0+ (0.05,0.0) [0.0|6.3500000000000005] "m/s" ASDM
 SG_ FourDRadarObjSts18VabsY : 266|11@0+ (0.1,-102.4) [-102.4|102.30000000000001] "m/s" ASDM
 SG_ FourDRadarObjSts18VabsYStd : 287|7@0+ (0.05,0.0) [0.0|6.3500000000000005] "m/s" ASDM
 SG_ FourDRadarObjSts18ValidFlag : 64|1@0+ (1,0) [0|1] "" ASDM

BO_ 963 FLRSafetyCANFD2Frame96 : 64 FLR4
 SG_ FourDRadarObjSts20_UB : 280|1@0+ (1,0) [0|1] "" ASDM
 SG_ FourDRadarObjSts20Chks : 7|8@0+ (1.0,0.0) [0.0|255.0] "Unitless" ASDM
 SG_ FourDRadarObjSts20Classification : 15|4@0+ (1,0) [0|15] "" ASDM
 SG_ FourDRadarObjSts20Cntr : 11|4@0+ (1.0,0.0) [0.0|15.0] "Unitless" ASDM
 SG_ FourDRadarObjSts20DistX : 23|16@0+ (0.015625,-512.0) [-512.0|511.984375] "m" ASDM
 SG_ FourDRadarObjSts20DistXStd : 39|7@0+ (0.1,0.0) [0.0|12.700000000000001] "m" ASDM
 SG_ FourDRadarObjSts20DistY : 47|13@0+ (0.015625,-64.0) [-64.0|63.984375] "m" ASDM
 SG_ FourDRadarObjSts20DistYStd : 71|7@0+ (0.1,0.0) [0.0|12.700000000000001] "m" ASDM
 SG_ FourDRadarObjSts20DistZ : 79|13@0+ (0.015625,-64.0) [-64.0|63.984375] "m" ASDM
 SG_ FourDRadarObjSts20DistZStd : 103|7@0+ (0.1,0.0) [0.0|12.700000000000001] "m" ASDM
 SG_ FourDRadarObjSts20DynamicProperty : 111|4@0+ (1,0) [0|15] "" ASDM
 SG_ FourDRadarObjSts20HeadingAngle : 107|12@0+ (0.0879,-180.0) [-180.0|179.95050000000003] "Deg" ASDM
 SG_ FourDRadarObjSts20ID : 127|8@0+ (1.0,0.0) [0.0|255.0] "Unitless" ASDM
 SG_ FourDRadarObjSts20LifeCycles : 135|4@0+ (1.0,0.0) [0.0|15.0] "Unitless" ASDM
 SG_ FourDRadarObjSts20ObjBoundingBoxHeight : 50|11@0+ (0.01,0.0) [0.0|20.0] "m" ASDM
 SG_ FourDRadarObjSts20ObjBoundingBoxLength : 131|12@0+ (0.01,0.0) [0.0|40.95] "m" ASDM
 SG_ FourDRadarObjSts20ObjBoundingBoxWidth : 82|11@0+ (0.01,0.0) [0.0|20.0] "m" ASDM
 SG_ FourDRadarObjSts20ObjNearestPtX : 151|16@0+ (0.015625,-512.0) [-512.0|511.984375] "m" ASDM
 SG_ FourDRadarObjSts20ObjNearestPtY : 167|13@0+ (0.015625,-64.0) [-64.0|63.984375] "m" ASDM
 SG_ FourDRadarObjSts20ObjNearestPtZ : 191|13@0+ (0.015625,-64.0) [-64.0|63.984375] "m" ASDM
 SG_ FourDRadarObjSts20ObjSNR : 169|10@0+ (0.1,0.0) [0.0|102.30000000000001] "dB" ASDM
 SG_ FourDRadarObjSts20ObjXAccRel : 193|10@0+ (0.125,-44.5) [-44.5|44.5] "m/s^2" ASDM
 SG_ FourDRadarObjSts20ObjYAccRel : 215|10@0+ (0.125,-44.5) [-44.5|44.5] "m/s^2" ASDM
 SG_ FourDRadarObjSts20ObstacleProbability : 236|5@0+ (3.2258,0.0) [0.0|99.9998] "%" ASDM
 SG_ FourDRadarObjSts20ProbabilityOfExistence : 247|8@0+ (1.0,0.0) [0.0|100.0] "%" ASDM
 SG_ FourDRadarObjSts20RCS : 231|11@0+ (0.1,-100.0) [-100.0|100.0] "dBm" ASDM
 SG_ FourDRadarObjSts20TargetClassificationConfidence : 221|6@0+ (1.5873,0.0) [0.0|99.9999] "%" ASDM
 SG_ FourDRadarObjSts20UpdateFlag : 32|1@0+ (1,0) [0|1] "" ASDM
 SG_ FourDRadarObjSts20VabsX : 263|11@0+ (0.1,-102.4) [-102.4|102.30000000000001] "m/s" ASDM
 SG_ FourDRadarObjSts20VabsXStd : 255|7@0+ (0.05,0.0) [0.0|6.3500000000000005] "m/s" ASDM
 SG_ FourDRadarObjSts20VabsY : 266|11@0+ (0.1,-102.4) [-102.4|102.30000000000001] "m/s" ASDM
 SG_ FourDRadarObjSts20VabsYStd : 287|7@0+ (0.05,0.0) [0.0|6.3500000000000005] "m/s" ASDM
 SG_ FourDRadarObjSts20ValidFlag : 64|1@0+ (1,0) [0|1] "" ASDM

BO_ 973 FLRSafetyCANFD2Frame97 : 64 FLR4
 SG_ FourDRadarObjSts22_UB : 280|1@0+ (1,0) [0|1] "" ASDM
 SG_ FourDRadarObjSts22Chks : 7|8@0+ (1.0,0.0) [0.0|255.0] "Unitless" ASDM
 SG_ FourDRadarObjSts22Classification : 15|4@0+ (1,0) [0|15] "" ASDM
 SG_ FourDRadarObjSts22Cntr : 11|4@0+ (1.0,0.0) [0.0|15.0] "Unitless" ASDM
 SG_ FourDRadarObjSts22DistX : 23|16@0+ (0.015625,-512.0) [-512.0|511.984375] "m" ASDM
 SG_ FourDRadarObjSts22DistXStd : 39|7@0+ (0.1,0.0) [0.0|12.700000000000001] "m" ASDM
 SG_ FourDRadarObjSts22DistY : 47|13@0+ (0.015625,-64.0) [-64.0|63.984375] "m" ASDM
 SG_ FourDRadarObjSts22DistYStd : 71|7@0+ (0.1,0.0) [0.0|12.700000000000001] "m" ASDM
 SG_ FourDRadarObjSts22DistZ : 79|13@0+ (0.015625,-64.0) [-64.0|63.984375] "m" ASDM
 SG_ FourDRadarObjSts22DistZStd : 103|7@0+ (0.1,0.0) [0.0|12.700000000000001] "m" ASDM
 SG_ FourDRadarObjSts22DynamicProperty : 111|4@0+ (1,0) [0|15] "" ASDM
 SG_ FourDRadarObjSts22HeadingAngle : 107|12@0+ (0.0879,-180.0) [-180.0|179.95050000000003] "Deg" ASDM
 SG_ FourDRadarObjSts22ID : 127|8@0+ (1.0,0.0) [0.0|255.0] "Unitless" ASDM
 SG_ FourDRadarObjSts22LifeCycles : 135|4@0+ (1.0,0.0) [0.0|15.0] "Unitless" ASDM
 SG_ FourDRadarObjSts22ObjBoundingBoxHeight : 50|11@0+ (0.01,0.0) [0.0|20.0] "m" ASDM
 SG_ FourDRadarObjSts22ObjBoundingBoxLength : 131|12@0+ (0.01,0.0) [0.0|40.95] "m" ASDM
 SG_ FourDRadarObjSts22ObjBoundingBoxWidth : 82|11@0+ (0.01,0.0) [0.0|20.0] "m" ASDM
 SG_ FourDRadarObjSts22ObjNearestPtX : 151|16@0+ (0.015625,-512.0) [-512.0|511.984375] "m" ASDM
 SG_ FourDRadarObjSts22ObjNearestPtY : 167|13@0+ (0.015625,-64.0) [-64.0|63.984375] "m" ASDM
 SG_ FourDRadarObjSts22ObjNearestPtZ : 191|13@0+ (0.015625,-64.0) [-64.0|63.984375] "m" ASDM
 SG_ FourDRadarObjSts22ObjSNR : 169|10@0+ (0.1,0.0) [0.0|102.30000000000001] "dB" ASDM
 SG_ FourDRadarObjSts22ObjXAccRel : 193|10@0+ (0.125,-44.5) [-44.5|44.5] "m/s^2" ASDM
 SG_ FourDRadarObjSts22ObjYAccRel : 215|10@0+ (0.125,-44.5) [-44.5|44.5] "m/s^2" ASDM
 SG_ FourDRadarObjSts22ObstacleProbability : 236|5@0+ (3.2258,0.0) [0.0|99.9998] "%" ASDM
 SG_ FourDRadarObjSts22ProbabilityOfExistence : 247|8@0+ (1.0,0.0) [0.0|100.0] "%" ASDM
 SG_ FourDRadarObjSts22RCS : 231|11@0+ (0.1,-100.0) [-100.0|100.0] "dBm" ASDM
 SG_ FourDRadarObjSts22TargetClassificationConfidence : 221|6@0+ (1.5873,0.0) [0.0|99.9999] "%" ASDM
 SG_ FourDRadarObjSts22UpdateFlag : 32|1@0+ (1,0) [0|1] "" ASDM
 SG_ FourDRadarObjSts22VabsX : 263|11@0+ (0.1,-102.4) [-102.4|102.30000000000001] "m/s" ASDM
 SG_ FourDRadarObjSts22VabsXStd : 255|7@0+ (0.05,0.0) [0.0|6.3500000000000005] "m/s" ASDM
 SG_ FourDRadarObjSts22VabsY : 266|11@0+ (0.1,-102.4) [-102.4|102.30000000000001] "m/s" ASDM
 SG_ FourDRadarObjSts22VabsYStd : 287|7@0+ (0.05,0.0) [0.0|6.3500000000000005] "m/s" ASDM
 SG_ FourDRadarObjSts22ValidFlag : 64|1@0+ (1,0) [0|1] "" ASDM

BO_ 983 FLRSafetyCANFD2Frame98 : 64 FLR4
 SG_ FourDRadarObjSts24_UB : 280|1@0+ (1,0) [0|1] "" ASDM
 SG_ FourDRadarObjSts24Chks : 7|8@0+ (1.0,0.0) [0.0|255.0] "Unitless" ASDM
 SG_ FourDRadarObjSts24Classification : 15|4@0+ (1,0) [0|15] "" ASDM
 SG_ FourDRadarObjSts24Cntr : 11|4@0+ (1.0,0.0) [0.0|15.0] "Unitless" ASDM
 SG_ FourDRadarObjSts24DistX : 23|16@0+ (0.015625,-512.0) [-512.0|511.984375] "m" ASDM
 SG_ FourDRadarObjSts24DistXStd : 39|7@0+ (0.1,0.0) [0.0|12.700000000000001] "m" ASDM
 SG_ FourDRadarObjSts24DistY : 47|13@0+ (0.015625,-64.0) [-64.0|63.984375] "m" ASDM
 SG_ FourDRadarObjSts24DistYStd : 71|7@0+ (0.1,0.0) [0.0|12.700000000000001] "m" ASDM
 SG_ FourDRadarObjSts24DistZ : 79|13@0+ (0.015625,-64.0) [-64.0|63.984375] "m" ASDM
 SG_ FourDRadarObjSts24DistZStd : 103|7@0+ (0.1,0.0) [0.0|12.700000000000001] "m" ASDM
 SG_ FourDRadarObjSts24DynamicProperty : 111|4@0+ (1,0) [0|15] "" ASDM
 SG_ FourDRadarObjSts24HeadingAngle : 107|12@0+ (0.0879,-180.0) [-180.0|179.95050000000003] "Deg" ASDM
 SG_ FourDRadarObjSts24ID : 127|8@0+ (1.0,0.0) [0.0|255.0] "Unitless" ASDM
 SG_ FourDRadarObjSts24LifeCycles : 135|4@0+ (1.0,0.0) [0.0|15.0] "Unitless" ASDM
 SG_ FourDRadarObjSts24ObjBoundingBoxHeight : 50|11@0+ (0.01,0.0) [0.0|20.0] "m" ASDM
 SG_ FourDRadarObjSts24ObjBoundingBoxLength : 131|12@0+ (0.01,0.0) [0.0|40.95] "m" ASDM
 SG_ FourDRadarObjSts24ObjBoundingBoxWidth : 82|11@0+ (0.01,0.0) [0.0|20.0] "m" ASDM
 SG_ FourDRadarObjSts24ObjNearestPtX : 151|16@0+ (0.015625,-512.0) [-512.0|511.984375] "m" ASDM
 SG_ FourDRadarObjSts24ObjNearestPtY : 167|13@0+ (0.015625,-64.0) [-64.0|63.984375] "m" ASDM
 SG_ FourDRadarObjSts24ObjNearestPtZ : 191|13@0+ (0.015625,-64.0) [-64.0|63.984375] "m" ASDM
 SG_ FourDRadarObjSts24ObjSNR : 169|10@0+ (0.1,0.0) [0.0|102.30000000000001] "dB" ASDM
 SG_ FourDRadarObjSts24ObjXAccRel : 193|10@0+ (0.125,-44.5) [-44.5|44.5] "m/s^2" ASDM
 SG_ FourDRadarObjSts24ObjYAccRel : 215|10@0+ (0.125,-44.5) [-44.5|44.5] "m/s^2" ASDM
 SG_ FourDRadarObjSts24ObstacleProbability : 236|5@0+ (3.2258,0.0) [0.0|99.9998] "%" ASDM
 SG_ FourDRadarObjSts24ProbabilityOfExistence : 247|8@0+ (1.0,0.0) [0.0|100.0] "%" ASDM
 SG_ FourDRadarObjSts24RCS : 231|11@0+ (0.1,-100.0) [-100.0|100.0] "dBm" ASDM
 SG_ FourDRadarObjSts24TargetClassificationConfidence : 221|6@0+ (1.5873,0.0) [0.0|99.9999] "%" ASDM
 SG_ FourDRadarObjSts24UpdateFlag : 32|1@0+ (1,0) [0|1] "" ASDM
 SG_ FourDRadarObjSts24VabsX : 263|11@0+ (0.1,-102.4) [-102.4|102.30000000000001] "m/s" ASDM
 SG_ FourDRadarObjSts24VabsXStd : 255|7@0+ (0.05,0.0) [0.0|6.3500000000000005] "m/s" ASDM
 SG_ FourDRadarObjSts24VabsY : 266|11@0+ (0.1,-102.4) [-102.4|102.30000000000001] "m/s" ASDM
 SG_ FourDRadarObjSts24VabsYStd : 287|7@0+ (0.05,0.0) [0.0|6.3500000000000005] "m/s" ASDM
 SG_ FourDRadarObjSts24ValidFlag : 64|1@0+ (1,0) [0|1] "" ASDM

BO_ 993 FLRSafetyCANFD2Frame99 : 64 FLR4
 SG_ FourDRadarObjSts26_UB : 280|1@0+ (1,0) [0|1] "" ASDM
 SG_ FourDRadarObjSts26Chks : 7|8@0+ (1.0,0.0) [0.0|255.0] "Unitless" ASDM
 SG_ FourDRadarObjSts26Classification : 15|4@0+ (1,0) [0|15] "" ASDM
 SG_ FourDRadarObjSts26Cntr : 11|4@0+ (1.0,0.0) [0.0|15.0] "Unitless" ASDM
 SG_ FourDRadarObjSts26DistX : 23|16@0+ (0.015625,-512.0) [-512.0|511.984375] "m" ASDM
 SG_ FourDRadarObjSts26DistXStd : 39|7@0+ (0.1,0.0) [0.0|12.700000000000001] "m" ASDM
 SG_ FourDRadarObjSts26DistY : 47|13@0+ (0.015625,-64.0) [-64.0|63.984375] "m" ASDM
 SG_ FourDRadarObjSts26DistYStd : 71|7@0+ (0.1,0.0) [0.0|12.700000000000001] "m" ASDM
 SG_ FourDRadarObjSts26DistZ : 79|13@0+ (0.015625,-64.0) [-64.0|63.984375] "m" ASDM
 SG_ FourDRadarObjSts26DistZStd : 103|7@0+ (0.1,0.0) [0.0|12.700000000000001] "m" ASDM
 SG_ FourDRadarObjSts26DynamicProperty : 111|4@0+ (1,0) [0|15] "" ASDM
 SG_ FourDRadarObjSts26HeadingAngle : 107|12@0+ (0.0879,-180.0) [-180.0|179.95050000000003] "Deg" ASDM
 SG_ FourDRadarObjSts26ID : 127|8@0+ (1.0,0.0) [0.0|255.0] "Unitless" ASDM
 SG_ FourDRadarObjSts26LifeCycles : 135|4@0+ (1.0,0.0) [0.0|15.0] "Unitless" ASDM
 SG_ FourDRadarObjSts26ObjBoundingBoxHeight : 50|11@0+ (0.01,0.0) [0.0|20.0] "m" ASDM
 SG_ FourDRadarObjSts26ObjBoundingBoxLength : 131|12@0+ (0.01,0.0) [0.0|40.95] "m" ASDM
 SG_ FourDRadarObjSts26ObjBoundingBoxWidth : 82|11@0+ (0.01,0.0) [0.0|20.0] "m" ASDM
 SG_ FourDRadarObjSts26ObjNearestPtX : 151|16@0+ (0.015625,-512.0) [-512.0|511.984375] "m" ASDM
 SG_ FourDRadarObjSts26ObjNearestPtY : 167|13@0+ (0.015625,-64.0) [-64.0|63.984375] "m" ASDM
 SG_ FourDRadarObjSts26ObjNearestPtZ : 191|13@0+ (0.015625,-64.0) [-64.0|63.984375] "m" ASDM
 SG_ FourDRadarObjSts26ObjSNR : 169|10@0+ (0.1,0.0) [0.0|102.30000000000001] "dB" ASDM
 SG_ FourDRadarObjSts26ObjXAccRel : 193|10@0+ (0.125,-44.5) [-44.5|44.5] "m/s^2" ASDM
 SG_ FourDRadarObjSts26ObjYAccRel : 215|10@0+ (0.125,-44.5) [-44.5|44.5] "m/s^2" ASDM
 SG_ FourDRadarObjSts26ObstacleProbability : 236|5@0+ (3.2258,0.0) [0.0|99.9998] "%" ASDM
 SG_ FourDRadarObjSts26ProbabilityOfExistence : 247|8@0+ (1.0,0.0) [0.0|100.0] "%" ASDM
 SG_ FourDRadarObjSts26RCS : 231|11@0+ (0.1,-100.0) [-100.0|100.0] "dBm" ASDM
 SG_ FourDRadarObjSts26TargetClassificationConfidence : 221|6@0+ (1.5873,0.0) [0.0|99.9999] "%" ASDM
 SG_ FourDRadarObjSts26UpdateFlag : 32|1@0+ (1,0) [0|1] "" ASDM
 SG_ FourDRadarObjSts26VabsX : 263|11@0+ (0.1,-102.4) [-102.4|102.30000000000001] "m/s" ASDM
 SG_ FourDRadarObjSts26VabsXStd : 255|7@0+ (0.05,0.0) [0.0|6.3500000000000005] "m/s" ASDM
 SG_ FourDRadarObjSts26VabsY : 266|11@0+ (0.1,-102.4) [-102.4|102.30000000000001] "m/s" ASDM
 SG_ FourDRadarObjSts26VabsYStd : 287|7@0+ (0.05,0.0) [0.0|6.3500000000000005] "m/s" ASDM
 SG_ FourDRadarObjSts26ValidFlag : 64|1@0+ (1,0) [0|1] "" ASDM

BO_ 1282 FlrSafetyCanFD2NmFr : 8 FLR4
 SG_ PNC16_FLR4 : 16|1@0+ (1,0) [0|0] "" ASDM
 SG_ PNC17_FLR4 : 17|1@0+ (1,0) [0|0] "" ASDM
 SG_ PNC18_FLR4 : 18|1@0+ (1,0) [0|0] "" ASDM
 SG_ PNC19_FLR4 : 19|1@0+ (1,0) [0|0] "" ASDM
 SG_ PNC20_FLR4 : 20|1@0+ (1,0) [0|0] "" ASDM
 SG_ PNC21_FLR4 : 21|1@0+ (1,0) [0|0] "" ASDM
 SG_ PNC22_FLR4 : 22|1@0+ (1,0) [0|0] "" ASDM
 SG_ PNC23_FLR4 : 23|1@0+ (1,0) [0|0] "" ASDM
 SG_ PNC24_FLR4 : 24|1@0+ (1,0) [0|0] "" ASDM
 SG_ PNC25_FLR4 : 25|1@0+ (1,0) [0|0] "" ASDM
 SG_ PNC26_FLR4 : 26|1@0+ (1,0) [0|0] "" ASDM
 SG_ PNC27_FLR4 : 27|1@0+ (1,0) [0|0] "" ASDM
 SG_ PNC28_FLR4 : 28|1@0+ (1,0) [0|0] "" ASDM
 SG_ PNC29_FLR4 : 29|1@0+ (1,0) [0|0] "" ASDM
 SG_ PNC30_FLR4 : 30|1@0+ (1,0) [0|0] "" ASDM
 SG_ PNC31_FLR4 : 31|1@0+ (1,0) [0|0] "" ASDM
 SG_ PNC32_FLR4 : 32|1@0+ (1,0) [0|0] "" ASDM
 SG_ PNC33_FLR4 : 33|1@0+ (1,0) [0|0] "" ASDM
 SG_ PNC34_FLR4 : 34|1@0+ (1,0) [0|0] "" ASDM
 SG_ PNC35_FLR4 : 35|1@0+ (1,0) [0|0] "" ASDM
 SG_ PNC36_FLR4 : 36|1@0+ (1,0) [0|0] "" ASDM
 SG_ PNC37_FLR4 : 37|1@0+ (1,0) [0|0] "" ASDM
 SG_ PNC38_FLR4 : 38|1@0+ (1,0) [0|0] "" ASDM
 SG_ PNC39_FLR4 : 39|1@0+ (1,0) [0|0] "" ASDM
 SG_ PNC40_FLR4 : 40|1@0+ (1,0) [0|0] "" ASDM
 SG_ PNC41_FLR4 : 41|1@0+ (1,0) [0|0] "" ASDM
 SG_ PNC42_FLR4 : 42|1@0+ (1,0) [0|0] "" ASDM
 SG_ NM_PNI_FLR4 : 14|1@0+ (1,0) [0|0] "" ASDM
 SG_ NM_AW_FLR4 : 12|1@0+ (1,0) [0|0] "" ASDM
 SG_ NM_CS_FLR4 : 11|1@0+ (1,0) [0|0] "" ASDM
 SG_ NM_RMR_FLR4 : 8|1@0+ (1,0) [0|0] "" ASDM
 SG_ NM_NodeID_FLR4 : 7|8@0+ (1,0) [0|0] "" ASDM

BO_ 1604 FlrToAsdmSafetyCanFD2DiagResFrame1 : 64 FLR4
 SG_ FlrToAsdmSafetyCanFD2DiagResNpdu : 7|512@0+ (1,0) [0|0] "" ASDM

CM_ SG_ 898 FourDRadarObjSts35Chks "4d Radar attributes";
CM_ SG_ 898 FourDRadarObjSts35Classification "4d Radar attributes";
CM_ SG_ 898 FourDRadarObjSts35Cntr "Counter";
CM_ SG_ 898 FourDRadarObjSts35DistX "4d Radar attributes";
CM_ SG_ 898 FourDRadarObjSts35DistXStd "4d Radar attributes";
CM_ SG_ 898 FourDRadarObjSts35DistY "4d Radar attributes";
CM_ SG_ 898 FourDRadarObjSts35DistYStd "4d Radar attributes";
CM_ SG_ 898 FourDRadarObjSts35DistZ "4d Radar attributes";
CM_ SG_ 898 FourDRadarObjSts35DistZStd "4d Radar attributes";
CM_ SG_ 898 FourDRadarObjSts35DynamicProperty "4d Radar attributes";
CM_ SG_ 898 FourDRadarObjSts35HeadingAngle "4d Radar attributes";
CM_ SG_ 898 FourDRadarObjSts35ID "4d Radar attributes";
CM_ SG_ 898 FourDRadarObjSts35LifeCycles "4d Radar attributes";
CM_ SG_ 898 FourDRadarObjSts35ObjBoundingBoxHeight "4d Radar attributes";
CM_ SG_ 898 FourDRadarObjSts35ObjBoundingBoxLength "4d Radar attributes";
CM_ SG_ 898 FourDRadarObjSts35ObjBoundingBoxWidth "4d Radar attributes";
CM_ SG_ 898 FourDRadarObjSts35ObjNearestPtX "4d Radar attributes";
CM_ SG_ 898 FourDRadarObjSts35ObjNearestPtY "4d Radar attributes";
CM_ SG_ 898 FourDRadarObjSts35ObjNearestPtZ "4d Radar attributes";
CM_ SG_ 898 FourDRadarObjSts35ObjSNR "4d Radar attributes";
CM_ SG_ 898 FourDRadarObjSts35ObjXAccRel "4d Radar attributes";
CM_ SG_ 898 FourDRadarObjSts35ObjYAccRel "4d Radar attributes";
CM_ SG_ 898 FourDRadarObjSts35ObstacleProbability "4d Radar attributes";
CM_ SG_ 898 FourDRadarObjSts35ProbabilityOfExistence "4d Radar attributes";
CM_ SG_ 898 FourDRadarObjSts35RCS "4d Radar attributes";
CM_ SG_ 898 FourDRadarObjSts35TargetClassificationConfidence "4d Radar attributes";
CM_ SG_ 898 FourDRadarObjSts35UpdateFlag "4d Radar attributes";
CM_ SG_ 898 FourDRadarObjSts35VabsX "4d Radar attributes";
CM_ SG_ 898 FourDRadarObjSts35VabsXStd "4d Radar attributes";
CM_ SG_ 898 FourDRadarObjSts35VabsY "4d Radar attributes";
CM_ SG_ 898 FourDRadarObjSts35VabsYStd "4d Radar attributes";
CM_ SG_ 898 FourDRadarObjSts35ValidFlag "4d Radar attributes";
CM_ SG_ 899 FourDRadarObjSts37Chks "4d Radar attributes";
CM_ SG_ 899 FourDRadarObjSts37Classification "4d Radar attributes";
CM_ SG_ 899 FourDRadarObjSts37Cntr "Counter";
CM_ SG_ 899 FourDRadarObjSts37DistX "4d Radar attributes";
CM_ SG_ 899 FourDRadarObjSts37DistXStd "4d Radar attributes";
CM_ SG_ 899 FourDRadarObjSts37DistY "4d Radar attributes";
CM_ SG_ 899 FourDRadarObjSts37DistYStd "4d Radar attributes";
CM_ SG_ 899 FourDRadarObjSts37DistZ "4d Radar attributes";
CM_ SG_ 899 FourDRadarObjSts37DistZStd "4d Radar attributes";
CM_ SG_ 899 FourDRadarObjSts37DynamicProperty "4d Radar attributes";
CM_ SG_ 899 FourDRadarObjSts37HeadingAngle "4d Radar attributes";
CM_ SG_ 899 FourDRadarObjSts37ID "4d Radar attributes";
CM_ SG_ 899 FourDRadarObjSts37LifeCycles "4d Radar attributes";
CM_ SG_ 899 FourDRadarObjSts37ObjBoundingBoxHeight "4d Radar attributes";
CM_ SG_ 899 FourDRadarObjSts37ObjBoundingBoxLength "4d Radar attributes";
CM_ SG_ 899 FourDRadarObjSts37ObjBoundingBoxWidth "4d Radar attributes";
CM_ SG_ 899 FourDRadarObjSts37ObjNearestPtX "4d Radar attributes";
CM_ SG_ 899 FourDRadarObjSts37ObjNearestPtY "4d Radar attributes";
CM_ SG_ 899 FourDRadarObjSts37ObjNearestPtZ "4d Radar attributes";
CM_ SG_ 899 FourDRadarObjSts37ObjSNR "4d Radar attributes";
CM_ SG_ 899 FourDRadarObjSts37ObjXAccRel "4d Radar attributes";
CM_ SG_ 899 FourDRadarObjSts37ObjYAccRel "4d Radar attributes";
CM_ SG_ 899 FourDRadarObjSts37ObstacleProbability "4d Radar attributes";
CM_ SG_ 899 FourDRadarObjSts37ProbabilityOfExistence "4d Radar attributes";
CM_ SG_ 899 FourDRadarObjSts37RCS "4d Radar attributes";
CM_ SG_ 899 FourDRadarObjSts37TargetClassificationConfidence "4d Radar attributes";
CM_ SG_ 899 FourDRadarObjSts37UpdateFlag "4d Radar attributes";
CM_ SG_ 899 FourDRadarObjSts37VabsX "4d Radar attributes";
CM_ SG_ 899 FourDRadarObjSts37VabsXStd "4d Radar attributes";
CM_ SG_ 899 FourDRadarObjSts37VabsY "4d Radar attributes";
CM_ SG_ 899 FourDRadarObjSts37VabsYStd "4d Radar attributes";
CM_ SG_ 899 FourDRadarObjSts37ValidFlag "4d Radar attributes";
CM_ SG_ 900 FourDRadarObjSts39Chks "4d Radar attributes";
CM_ SG_ 900 FourDRadarObjSts39Classification "4d Radar attributes";
CM_ SG_ 900 FourDRadarObjSts39Cntr "Counter";
CM_ SG_ 900 FourDRadarObjSts39DistX "4d Radar attributes";
CM_ SG_ 900 FourDRadarObjSts39DistXStd "4d Radar attributes";
CM_ SG_ 900 FourDRadarObjSts39DistY "4d Radar attributes";
CM_ SG_ 900 FourDRadarObjSts39DistYStd "4d Radar attributes";
CM_ SG_ 900 FourDRadarObjSts39DistZ "4d Radar attributes";
CM_ SG_ 900 FourDRadarObjSts39DistZStd "4d Radar attributes";
CM_ SG_ 900 FourDRadarObjSts39DynamicProperty "4d Radar attributes";
CM_ SG_ 900 FourDRadarObjSts39HeadingAngle "4d Radar attributes";
CM_ SG_ 900 FourDRadarObjSts39ID "4d Radar attributes";
CM_ SG_ 900 FourDRadarObjSts39LifeCycles "4d Radar attributes";
CM_ SG_ 900 FourDRadarObjSts39ObjBoundingBoxHeight "4d Radar attributes";
CM_ SG_ 900 FourDRadarObjSts39ObjBoundingBoxLength "4d Radar attributes";
CM_ SG_ 900 FourDRadarObjSts39ObjBoundingBoxWidth "4d Radar attributes";
CM_ SG_ 900 FourDRadarObjSts39ObjNearestPtX "4d Radar attributes";
CM_ SG_ 900 FourDRadarObjSts39ObjNearestPtY "4d Radar attributes";
CM_ SG_ 900 FourDRadarObjSts39ObjNearestPtZ "4d Radar attributes";
CM_ SG_ 900 FourDRadarObjSts39ObjSNR "4d Radar attributes";
CM_ SG_ 900 FourDRadarObjSts39ObjXAccRel "4d Radar attributes";
CM_ SG_ 900 FourDRadarObjSts39ObjYAccRel "4d Radar attributes";
CM_ SG_ 900 FourDRadarObjSts39ObstacleProbability "4d Radar attributes";
CM_ SG_ 900 FourDRadarObjSts39ProbabilityOfExistence "4d Radar attributes";
CM_ SG_ 900 FourDRadarObjSts39RCS "4d Radar attributes";
CM_ SG_ 900 FourDRadarObjSts39TargetClassificationConfidence "4d Radar attributes";
CM_ SG_ 900 FourDRadarObjSts39UpdateFlag "4d Radar attributes";
CM_ SG_ 900 FourDRadarObjSts39VabsX "4d Radar attributes";
CM_ SG_ 900 FourDRadarObjSts39VabsXStd "4d Radar attributes";
CM_ SG_ 900 FourDRadarObjSts39VabsY "4d Radar attributes";
CM_ SG_ 900 FourDRadarObjSts39VabsYStd "4d Radar attributes";
CM_ SG_ 900 FourDRadarObjSts39ValidFlag "4d Radar attributes";
CM_ SG_ 901 FourDRadarObjSts41Chks "4d Radar attributes";
CM_ SG_ 901 FourDRadarObjSts41Classification "4d Radar attributes";
CM_ SG_ 901 FourDRadarObjSts41Cntr "Counter";
CM_ SG_ 901 FourDRadarObjSts41DistX "4d Radar attributes";
CM_ SG_ 901 FourDRadarObjSts41DistXStd "4d Radar attributes";
CM_ SG_ 901 FourDRadarObjSts41DistY "4d Radar attributes";
CM_ SG_ 901 FourDRadarObjSts41DistYStd "4d Radar attributes";
CM_ SG_ 901 FourDRadarObjSts41DistZ "4d Radar attributes";
CM_ SG_ 901 FourDRadarObjSts41DistZStd "4d Radar attributes";
CM_ SG_ 901 FourDRadarObjSts41DynamicProperty "4d Radar attributes";
CM_ SG_ 901 FourDRadarObjSts41HeadingAngle "4d Radar attributes";
CM_ SG_ 901 FourDRadarObjSts41ID "4d Radar attributes";
CM_ SG_ 901 FourDRadarObjSts41LifeCycles "4d Radar attributes";
CM_ SG_ 901 FourDRadarObjSts41ObjBoundingBoxHeight "4d Radar attributes";
CM_ SG_ 901 FourDRadarObjSts41ObjBoundingBoxLength "4d Radar attributes";
CM_ SG_ 901 FourDRadarObjSts41ObjBoundingBoxWidth "4d Radar attributes";
CM_ SG_ 901 FourDRadarObjSts41ObjNearestPtX "4d Radar attributes";
CM_ SG_ 901 FourDRadarObjSts41ObjNearestPtY "4d Radar attributes";
CM_ SG_ 901 FourDRadarObjSts41ObjNearestPtZ "4d Radar attributes";
CM_ SG_ 901 FourDRadarObjSts41ObjSNR "4d Radar attributes";
CM_ SG_ 901 FourDRadarObjSts41ObjXAccRel "4d Radar attributes";
CM_ SG_ 901 FourDRadarObjSts41ObjYAccRel "4d Radar attributes";
CM_ SG_ 901 FourDRadarObjSts41ObstacleProbability "4d Radar attributes";
CM_ SG_ 901 FourDRadarObjSts41ProbabilityOfExistence "4d Radar attributes";
CM_ SG_ 901 FourDRadarObjSts41RCS "4d Radar attributes";
CM_ SG_ 901 FourDRadarObjSts41TargetClassificationConfidence "4d Radar attributes";
CM_ SG_ 901 FourDRadarObjSts41UpdateFlag "4d Radar attributes";
CM_ SG_ 901 FourDRadarObjSts41VabsX "4d Radar attributes";
CM_ SG_ 901 FourDRadarObjSts41VabsXStd "4d Radar attributes";
CM_ SG_ 901 FourDRadarObjSts41VabsY "4d Radar attributes";
CM_ SG_ 901 FourDRadarObjSts41VabsYStd "4d Radar attributes";
CM_ SG_ 901 FourDRadarObjSts41ValidFlag "4d Radar attributes";
CM_ SG_ 863 FrontFourDRadarObjSts01Chks "Check sum";
CM_ SG_ 863 FrontFourDRadarObjSts01Classification "Classfication";
CM_ SG_ 863 FrontFourDRadarObjSts01Cntr "Counter";
CM_ SG_ 863 FrontFourDRadarObjSts01DistX "4d Radar attributes";
CM_ SG_ 863 FrontFourDRadarObjSts01DistXStd "fDistXSTD
";
CM_ SG_ 863 FrontFourDRadarObjSts01DistY "fDistY";
CM_ SG_ 863 FrontFourDRadarObjSts01DistYStd "fDistYStd
";
CM_ SG_ 863 FrontFourDRadarObjSts01DistZ "fDistZ";
CM_ SG_ 863 FrontFourDRadarObjSts01DistZStd "4d Radar attributes";
CM_ SG_ 863 FrontFourDRadarObjSts01DynamicProperty "DynamicProperty";
CM_ SG_ 863 FrontFourDRadarObjSts01HeadingAngle "HeadingAngle";
CM_ SG_ 863 FrontFourDRadarObjSts01ID "ID";
CM_ SG_ 863 FrontFourDRadarObjSts01LifeCycles "UlifeCycles";
CM_ SG_ 863 FrontFourDRadarObjSts01ObjBoundingBoxHeight "BB Height";
CM_ SG_ 863 FrontFourDRadarObjSts01ObjBoundingBoxLength "BB Length";
CM_ SG_ 863 FrontFourDRadarObjSts01ObjBoundingBoxWidth "BB WIdth";
CM_ SG_ 863 FrontFourDRadarObjSts01ObjNearestPtX "4d Radar attributes";
CM_ SG_ 863 FrontFourDRadarObjSts01ObjNearestPtY "4d Radar attributes";
CM_ SG_ 863 FrontFourDRadarObjSts01ObjNearestPtZ "4d Radar attributes";
CM_ SG_ 863 FrontFourDRadarObjSts01ObjSNR "SNR";
CM_ SG_ 863 FrontFourDRadarObjSts01ObjXAccRel "XAccRel";
CM_ SG_ 863 FrontFourDRadarObjSts01ObjYAccRel "YAccRel";
CM_ SG_ 863 FrontFourDRadarObjSts01ObstacleProbability "Obstacle probability";
CM_ SG_ 863 FrontFourDRadarObjSts01ProbabilityOfExistence "Probability of Existence";
CM_ SG_ 863 FrontFourDRadarObjSts01RCS "RCS";
CM_ SG_ 863 FrontFourDRadarObjSts01TargetClassificationConfidence "Target Classification Confident";
CM_ SG_ 863 FrontFourDRadarObjSts01UpdateFlag "4d Radar attributes";
CM_ SG_ 863 FrontFourDRadarObjSts01VabsX "VabsX
";
CM_ SG_ 863 FrontFourDRadarObjSts01VabsXStd "VabsXstd
";
CM_ SG_ 863 FrontFourDRadarObjSts01VabsY "VabsY";
CM_ SG_ 863 FrontFourDRadarObjSts01VabsYStd "VabsYStd
";
CM_ SG_ 863 FrontFourDRadarObjSts01ValidFlag "ValidFlag
";
CM_ SG_ 873 FourDRadarObjSts04Chks "Check Sum";
CM_ SG_ 873 FourDRadarObjSts04Classification "classification";
CM_ SG_ 873 FourDRadarObjSts04Cntr "Counter";
CM_ SG_ 873 FourDRadarObjSts04DistX "4d Radar attributes";
CM_ SG_ 873 FourDRadarObjSts04DistXStd "fdistxstd";
CM_ SG_ 873 FourDRadarObjSts04DistY "fdisty";
CM_ SG_ 873 FourDRadarObjSts04DistYStd "fdistystd";
CM_ SG_ 873 FourDRadarObjSts04DistZ "fdistz";
CM_ SG_ 873 FourDRadarObjSts04DistZStd "4d Radar attributes";
CM_ SG_ 873 FourDRadarObjSts04DynamicProperty "edynamicProperty";
CM_ SG_ 873 FourDRadarObjSts04HeadingAngle "heading angle";
CM_ SG_ 873 FourDRadarObjSts04ID "id";
CM_ SG_ 873 FourDRadarObjSts04LifeCycles "Ulifwcycles";
CM_ SG_ 873 FourDRadarObjSts04ObjBoundingBoxHeight "BB height";
CM_ SG_ 873 FourDRadarObjSts04ObjBoundingBoxLength "BB length";
CM_ SG_ 873 FourDRadarObjSts04ObjBoundingBoxWidth "BB width
";
CM_ SG_ 873 FourDRadarObjSts04ObjNearestPtX "4d Radar attributes";
CM_ SG_ 873 FourDRadarObjSts04ObjNearestPtY "4d Radar attributes";
CM_ SG_ 873 FourDRadarObjSts04ObjNearestPtZ "4d Radar attributes";
CM_ SG_ 873 FourDRadarObjSts04ObjSNR "SNR";
CM_ SG_ 873 FourDRadarObjSts04ObjXAccRel "xACCrel";
CM_ SG_ 873 FourDRadarObjSts04ObjYAccRel "YaccREL";
CM_ SG_ 873 FourDRadarObjSts04ObstacleProbability "Obj probability";
CM_ SG_ 873 FourDRadarObjSts04ProbabilityOfExistence "probability of Existence";
CM_ SG_ 873 FourDRadarObjSts04RCS "rcs";
CM_ SG_ 873 FourDRadarObjSts04TargetClassificationConfidence "confidence";
CM_ SG_ 873 FourDRadarObjSts04UpdateFlag "4d Radar attributes";
CM_ SG_ 873 FourDRadarObjSts04VabsX "vabsx
";
CM_ SG_ 873 FourDRadarObjSts04VabsXStd "vabsxStd";
CM_ SG_ 873 FourDRadarObjSts04VabsY "vabsY";
CM_ SG_ 873 FourDRadarObjSts04VabsYStd "VabsYstd";
CM_ SG_ 873 FourDRadarObjSts04ValidFlag "ValidFlag";
CM_ SG_ 951 FourDRadarObjSts06Chks "Check Sum";
CM_ SG_ 951 FourDRadarObjSts06Classification "4d Radar attributes";
CM_ SG_ 951 FourDRadarObjSts06Cntr "Counter";
CM_ SG_ 951 FourDRadarObjSts06DistX "4d Radar attributes";
CM_ SG_ 951 FourDRadarObjSts06DistXStd "4d Radar attributes";
CM_ SG_ 951 FourDRadarObjSts06DistY "4d Radar attributes";
CM_ SG_ 951 FourDRadarObjSts06DistYStd "4d Radar attributes";
CM_ SG_ 951 FourDRadarObjSts06DistZ "4d Radar attributes";
CM_ SG_ 951 FourDRadarObjSts06DistZStd "4d Radar attributes";
CM_ SG_ 951 FourDRadarObjSts06DynamicProperty "4d Radar attributes";
CM_ SG_ 951 FourDRadarObjSts06HeadingAngle "4d Radar attributes";
CM_ SG_ 951 FourDRadarObjSts06ID "4d Radar attributes";
CM_ SG_ 951 FourDRadarObjSts06LifeCycles "4d Radar attributes";
CM_ SG_ 951 FourDRadarObjSts06ObjBoundingBoxHeight "4d Radar attributes";
CM_ SG_ 951 FourDRadarObjSts06ObjBoundingBoxLength "4d Radar attributes";
CM_ SG_ 951 FourDRadarObjSts06ObjBoundingBoxWidth "4d Radar attributes";
CM_ SG_ 951 FourDRadarObjSts06ObjNearestPtX "4d Radar attributes";
CM_ SG_ 951 FourDRadarObjSts06ObjNearestPtY "4d Radar attributes";
CM_ SG_ 951 FourDRadarObjSts06ObjNearestPtZ "4d Radar attributes";
CM_ SG_ 951 FourDRadarObjSts06ObjSNR "4d Radar attributes";
CM_ SG_ 951 FourDRadarObjSts06ObjXAccRel "4d Radar attributes";
CM_ SG_ 951 FourDRadarObjSts06ObjYAccRel "4d Radar attributes";
CM_ SG_ 951 FourDRadarObjSts06ObstacleProbability "4d Radar attributes";
CM_ SG_ 951 FourDRadarObjSts06ProbabilityOfExistence "4d Radar attributes";
CM_ SG_ 951 FourDRadarObjSts06RCS "4d Radar attributes";
CM_ SG_ 951 FourDRadarObjSts06TargetClassificationConfidence "4d Radar attributes";
CM_ SG_ 951 FourDRadarObjSts06UpdateFlag "4d Radar attributes";
CM_ SG_ 951 FourDRadarObjSts06VabsX "4d Radar attributes";
CM_ SG_ 951 FourDRadarObjSts06VabsXStd "4d Radar attributes";
CM_ SG_ 951 FourDRadarObjSts06VabsY "4d Radar attributes";
CM_ SG_ 951 FourDRadarObjSts06VabsYStd "4d Radar attributes";
CM_ SG_ 951 FourDRadarObjSts06ValidFlag "4d Radar attributes";
CM_ SG_ 903 FourDRadarObjSts08Chks "4d Radar attributes";
CM_ SG_ 903 FourDRadarObjSts08Classification "4d Radar attributes";
CM_ SG_ 903 FourDRadarObjSts08Cntr "Counter";
CM_ SG_ 903 FourDRadarObjSts08DistX "4d Radar attributes";
CM_ SG_ 903 FourDRadarObjSts08DistXStd "4d Radar attributes";
CM_ SG_ 903 FourDRadarObjSts08DistY "4d Radar attributes";
CM_ SG_ 903 FourDRadarObjSts08DistYStd "4d Radar attributes";
CM_ SG_ 903 FourDRadarObjSts08DistZ "4d Radar attributes";
CM_ SG_ 903 FourDRadarObjSts08DistZStd "4d Radar attributes";
CM_ SG_ 903 FourDRadarObjSts08DynamicProperty "4d Radar attributes";
CM_ SG_ 903 FourDRadarObjSts08HeadingAngle "4d Radar attributes";
CM_ SG_ 903 FourDRadarObjSts08ID "4d Radar attributes";
CM_ SG_ 903 FourDRadarObjSts08LifeCycles "4d Radar attributes";
CM_ SG_ 903 FourDRadarObjSts08ObjBoundingBoxHeight "4d Radar attributes";
CM_ SG_ 903 FourDRadarObjSts08ObjBoundingBoxLength "4d Radar attributes";
CM_ SG_ 903 FourDRadarObjSts08ObjBoundingBoxWidth "4d Radar attributes";
CM_ SG_ 903 FourDRadarObjSts08ObjNearestPtX "4d Radar attributes";
CM_ SG_ 903 FourDRadarObjSts08ObjNearestPtY "4d Radar attributes";
CM_ SG_ 903 FourDRadarObjSts08ObjNearestPtZ "4d Radar attributes";
CM_ SG_ 903 FourDRadarObjSts08ObjSNR "4d Radar attributes";
CM_ SG_ 903 FourDRadarObjSts08ObjXAccRel "4d Radar attributes";
CM_ SG_ 903 FourDRadarObjSts08ObjYAccRel "4d Radar attributes";
CM_ SG_ 903 FourDRadarObjSts08ObstacleProbability "4d Radar attributes";
CM_ SG_ 903 FourDRadarObjSts08ProbabilityOfExistence "4d Radar attributes";
CM_ SG_ 903 FourDRadarObjSts08RCS "4d Radar attributes";
CM_ SG_ 903 FourDRadarObjSts08TargetClassificationConfidence "4d Radar attributes";
CM_ SG_ 903 FourDRadarObjSts08UpdateFlag "4d Radar attributes";
CM_ SG_ 903 FourDRadarObjSts08VabsX "4d Radar attributes";
CM_ SG_ 903 FourDRadarObjSts08VabsXStd "4d Radar attributes";
CM_ SG_ 903 FourDRadarObjSts08VabsY "4d Radar attributes";
CM_ SG_ 903 FourDRadarObjSts08VabsYStd "4d Radar attributes";
CM_ SG_ 903 FourDRadarObjSts08ValidFlag "4d Radar attributes";
CM_ SG_ 913 FourDRadarObjSts10Chks "4d Radar attributes";
CM_ SG_ 913 FourDRadarObjSts10Classification "4d Radar attributes";
CM_ SG_ 913 FourDRadarObjSts10Cntr "Counter";
CM_ SG_ 913 FourDRadarObjSts10DistX "4d Radar attributes";
CM_ SG_ 913 FourDRadarObjSts10DistXStd "4d Radar attributes";
CM_ SG_ 913 FourDRadarObjSts10DistY "4d Radar attributes";
CM_ SG_ 913 FourDRadarObjSts10DistYStd "4d Radar attributes";
CM_ SG_ 913 FourDRadarObjSts10DistZ "4d Radar attributes";
CM_ SG_ 913 FourDRadarObjSts10DistZStd "4d Radar attributes";
CM_ SG_ 913 FourDRadarObjSts10DynamicProperty "4d Radar attributes";
CM_ SG_ 913 FourDRadarObjSts10HeadingAngle "4d Radar attributes";
CM_ SG_ 913 FourDRadarObjSts10ID "4d Radar attributes";
CM_ SG_ 913 FourDRadarObjSts10LifeCycles "4d Radar attributes";
CM_ SG_ 913 FourDRadarObjSts10ObjBoundingBoxHeight "4d Radar attributes";
CM_ SG_ 913 FourDRadarObjSts10ObjBoundingBoxLength "4d Radar attributes";
CM_ SG_ 913 FourDRadarObjSts10ObjBoundingBoxWidth "4d Radar attributes";
CM_ SG_ 913 FourDRadarObjSts10ObjNearestPtX "4d Radar attributes";
CM_ SG_ 913 FourDRadarObjSts10ObjNearestPtY "4d Radar attributes";
CM_ SG_ 913 FourDRadarObjSts10ObjNearestPtZ "4d Radar attributes";
CM_ SG_ 913 FourDRadarObjSts10ObjSNR "4d Radar attributes";
CM_ SG_ 913 FourDRadarObjSts10ObjXAccRel "4d Radar attributes";
CM_ SG_ 913 FourDRadarObjSts10ObjYAccRel "4d Radar attributes";
CM_ SG_ 913 FourDRadarObjSts10ObstacleProbability "4d Radar attributes";
CM_ SG_ 913 FourDRadarObjSts10ProbabilityOfExistence "4d Radar attributes";
CM_ SG_ 913 FourDRadarObjSts10RCS "4d Radar attributes";
CM_ SG_ 913 FourDRadarObjSts10TargetClassificationConfidence "4d Radar attributes";
CM_ SG_ 913 FourDRadarObjSts10UpdateFlag "4d Radar attributes";
CM_ SG_ 913 FourDRadarObjSts10VabsX "4d Radar attributes";
CM_ SG_ 913 FourDRadarObjSts10VabsXStd "4d Radar attributes";
CM_ SG_ 913 FourDRadarObjSts10VabsY "4d Radar attributes";
CM_ SG_ 913 FourDRadarObjSts10VabsYStd "4d Radar attributes";
CM_ SG_ 913 FourDRadarObjSts10ValidFlag "4d Radar attributes";
CM_ SG_ 923 FourDRadarObjSts12Chks "4d Radar attributes";
CM_ SG_ 923 FourDRadarObjSts12Classification "4d Radar attributes";
CM_ SG_ 923 FourDRadarObjSts12Cntr "Counter";
CM_ SG_ 923 FourDRadarObjSts12DistX "4d Radar attributes";
CM_ SG_ 923 FourDRadarObjSts12DistXStd "4d Radar attributes";
CM_ SG_ 923 FourDRadarObjSts12DistY "4d Radar attributes";
CM_ SG_ 923 FourDRadarObjSts12DistYStd "4d Radar attributes";
CM_ SG_ 923 FourDRadarObjSts12DistZ "4d Radar attributes";
CM_ SG_ 923 FourDRadarObjSts12DistZStd "4d Radar attributes";
CM_ SG_ 923 FourDRadarObjSts12DynamicProperty "4d Radar attributes";
CM_ SG_ 923 FourDRadarObjSts12HeadingAngle "4d Radar attributes";
CM_ SG_ 923 FourDRadarObjSts12ID "4d Radar attributes";
CM_ SG_ 923 FourDRadarObjSts12LifeCycles "4d Radar attributes";
CM_ SG_ 923 FourDRadarObjSts12ObjBoundingBoxHeight "4d Radar attributes";
CM_ SG_ 923 FourDRadarObjSts12ObjBoundingBoxLength "4d Radar attributes";
CM_ SG_ 923 FourDRadarObjSts12ObjBoundingBoxWidth "4d Radar attributes";
CM_ SG_ 923 FourDRadarObjSts12ObjNearestPtX "4d Radar attributes";
CM_ SG_ 923 FourDRadarObjSts12ObjNearestPtY "4d Radar attributes";
CM_ SG_ 923 FourDRadarObjSts12ObjNearestPtZ "4d Radar attributes";
CM_ SG_ 923 FourDRadarObjSts12ObjSNR "4d Radar attributes";
CM_ SG_ 923 FourDRadarObjSts12ObjXAccRel "4d Radar attributes";
CM_ SG_ 923 FourDRadarObjSts12ObjYAccRel "4d Radar attributes";
CM_ SG_ 923 FourDRadarObjSts12ObstacleProbability "4d Radar attributes";
CM_ SG_ 923 FourDRadarObjSts12ProbabilityOfExistence "4d Radar attributes";
CM_ SG_ 923 FourDRadarObjSts12RCS "4d Radar attributes";
CM_ SG_ 923 FourDRadarObjSts12TargetClassificationConfidence "4d Radar attributes";
CM_ SG_ 923 FourDRadarObjSts12UpdateFlag "4d Radar attributes";
CM_ SG_ 923 FourDRadarObjSts12VabsX "4d Radar attributes";
CM_ SG_ 923 FourDRadarObjSts12VabsXStd "4d Radar attributes";
CM_ SG_ 923 FourDRadarObjSts12VabsY "4d Radar attributes";
CM_ SG_ 923 FourDRadarObjSts12VabsYStd "4d Radar attributes";
CM_ SG_ 923 FourDRadarObjSts12ValidFlag "4d Radar attributes";
CM_ SG_ 952 FourDRadarObjSts14Chks "4d Radar attributes";
CM_ SG_ 952 FourDRadarObjSts14Classification "4d Radar attributes";
CM_ SG_ 952 FourDRadarObjSts14Cntr "Counter";
CM_ SG_ 952 FourDRadarObjSts14DistX "4d Radar attributes";
CM_ SG_ 952 FourDRadarObjSts14DistXStd "4d Radar attributes";
CM_ SG_ 952 FourDRadarObjSts14DistY "4d Radar attributes";
CM_ SG_ 952 FourDRadarObjSts14DistYStd "4d Radar attributes";
CM_ SG_ 952 FourDRadarObjSts14DistZ "4d Radar attributes";
CM_ SG_ 952 FourDRadarObjSts14DistZStd "4d Radar attributes";
CM_ SG_ 952 FourDRadarObjSts14DynamicProperty "4d Radar attributes";
CM_ SG_ 952 FourDRadarObjSts14HeadingAngle "4d Radar attributes";
CM_ SG_ 952 FourDRadarObjSts14ID "4d Radar attributes";
CM_ SG_ 952 FourDRadarObjSts14LifeCycles "4d Radar attributes";
CM_ SG_ 952 FourDRadarObjSts14ObjBoundingBoxHeight "4d Radar attributes";
CM_ SG_ 952 FourDRadarObjSts14ObjBoundingBoxLength "4d Radar attributes";
CM_ SG_ 952 FourDRadarObjSts14ObjBoundingBoxWidth "4d Radar attributes";
CM_ SG_ 952 FourDRadarObjSts14ObjNearestPtX "4d Radar attributes";
CM_ SG_ 952 FourDRadarObjSts14ObjNearestPtY "4d Radar attributes";
CM_ SG_ 952 FourDRadarObjSts14ObjNearestPtZ "4d Radar attributes";
CM_ SG_ 952 FourDRadarObjSts14ObjSNR "4d Radar attributes";
CM_ SG_ 952 FourDRadarObjSts14ObjXAccRel "4d Radar attributes";
CM_ SG_ 952 FourDRadarObjSts14ObjYAccRel "4d Radar attributes";
CM_ SG_ 952 FourDRadarObjSts14ObstacleProbability "4d Radar attributes";
CM_ SG_ 952 FourDRadarObjSts14ProbabilityOfExistence "4d Radar attributes";
CM_ SG_ 952 FourDRadarObjSts14RCS "4d Radar attributes";
CM_ SG_ 952 FourDRadarObjSts14TargetClassificationConfidence "4d Radar attributes";
CM_ SG_ 952 FourDRadarObjSts14UpdateFlag "4d Radar attributes";
CM_ SG_ 952 FourDRadarObjSts14VabsX "4d Radar attributes";
CM_ SG_ 952 FourDRadarObjSts14VabsXStd "4d Radar attributes";
CM_ SG_ 952 FourDRadarObjSts14VabsY "4d Radar attributes";
CM_ SG_ 952 FourDRadarObjSts14VabsYStd "4d Radar attributes";
CM_ SG_ 952 FourDRadarObjSts14ValidFlag "4d Radar attributes";
CM_ SG_ 954 FourDRadarObjSts16Chks "4d Radar attributes";
CM_ SG_ 954 FourDRadarObjSts16Classification "4d Radar attributes";
CM_ SG_ 954 FourDRadarObjSts16Cntr "Counter";
CM_ SG_ 954 FourDRadarObjSts16DistX "4d Radar attributes";
CM_ SG_ 954 FourDRadarObjSts16DistXStd "4d Radar attributes";
CM_ SG_ 954 FourDRadarObjSts16DistY "4d Radar attributes";
CM_ SG_ 954 FourDRadarObjSts16DistYStd "4d Radar attributes";
CM_ SG_ 954 FourDRadarObjSts16DistZ "4d Radar attributes";
CM_ SG_ 954 FourDRadarObjSts16DistZStd "4d Radar attributes";
CM_ SG_ 954 FourDRadarObjSts16DynamicProperty "4d Radar attributes";
CM_ SG_ 954 FourDRadarObjSts16HeadingAngle "4d Radar attributes";
CM_ SG_ 954 FourDRadarObjSts16ID "4d Radar attributes";
CM_ SG_ 954 FourDRadarObjSts16LifeCycles "4d Radar attributes";
CM_ SG_ 954 FourDRadarObjSts16ObjBoundingBoxHeight "4d Radar attributes";
CM_ SG_ 954 FourDRadarObjSts16ObjBoundingBoxLength "4d Radar attributes";
CM_ SG_ 954 FourDRadarObjSts16ObjBoundingBoxWidth "4d Radar attributes";
CM_ SG_ 954 FourDRadarObjSts16ObjNearestPtX "4d Radar attributes";
CM_ SG_ 954 FourDRadarObjSts16ObjNearestPtY "4d Radar attributes";
CM_ SG_ 954 FourDRadarObjSts16ObjNearestPtZ "4d Radar attributes";
CM_ SG_ 954 FourDRadarObjSts16ObjSNR "4d Radar attributes";
CM_ SG_ 954 FourDRadarObjSts16ObjXAccRel "4d Radar attributes";
CM_ SG_ 954 FourDRadarObjSts16ObjYAccRel "4d Radar attributes";
CM_ SG_ 954 FourDRadarObjSts16ObstacleProbability "4d Radar attributes";
CM_ SG_ 954 FourDRadarObjSts16ProbabilityOfExistence "4d Radar attributes";
CM_ SG_ 954 FourDRadarObjSts16RCS "4d Radar attributes";
CM_ SG_ 954 FourDRadarObjSts16TargetClassificationConfidence "4d Radar attributes";
CM_ SG_ 954 FourDRadarObjSts16UpdateFlag "4d Radar attributes";
CM_ SG_ 954 FourDRadarObjSts16VabsX "4d Radar attributes";
CM_ SG_ 954 FourDRadarObjSts16VabsXStd "4d Radar attributes";
CM_ SG_ 954 FourDRadarObjSts16VabsY "4d Radar attributes";
CM_ SG_ 954 FourDRadarObjSts16VabsYStd "4d Radar attributes";
CM_ SG_ 954 FourDRadarObjSts16ValidFlag "4d Radar attributes";
CM_ SG_ 953 FourDRadarObjSts18Chks "4d Radar attributes";
CM_ SG_ 953 FourDRadarObjSts18Classification "4d Radar attributes";
CM_ SG_ 953 FourDRadarObjSts18Cntr "Counter";
CM_ SG_ 953 FourDRadarObjSts18DistX "4d Radar attributes";
CM_ SG_ 953 FourDRadarObjSts18DistXStd "4d Radar attributes";
CM_ SG_ 953 FourDRadarObjSts18DistY "4d Radar attributes";
CM_ SG_ 953 FourDRadarObjSts18DistYStd "4d Radar attributes";
CM_ SG_ 953 FourDRadarObjSts18DistZ "4d Radar attributes";
CM_ SG_ 953 FourDRadarObjSts18DistZStd "4d Radar attributes";
CM_ SG_ 953 FourDRadarObjSts18DynamicProperty "4d Radar attributes";
CM_ SG_ 953 FourDRadarObjSts18HeadingAngle "4d Radar attributes";
CM_ SG_ 953 FourDRadarObjSts18ID "4d Radar attributes";
CM_ SG_ 953 FourDRadarObjSts18LifeCycles "4d Radar attributes";
CM_ SG_ 953 FourDRadarObjSts18ObjBoundingBoxHeight "4d Radar attributes";
CM_ SG_ 953 FourDRadarObjSts18ObjBoundingBoxLength "4d Radar attributes";
CM_ SG_ 953 FourDRadarObjSts18ObjBoundingBoxWidth "4d Radar attributes";
CM_ SG_ 953 FourDRadarObjSts18ObjNearestPtX "4d Radar attributes";
CM_ SG_ 953 FourDRadarObjSts18ObjNearestPtY "4d Radar attributes";
CM_ SG_ 953 FourDRadarObjSts18ObjNearestPtZ "4d Radar attributes";
CM_ SG_ 953 FourDRadarObjSts18ObjSNR "4d Radar attributes";
CM_ SG_ 953 FourDRadarObjSts18ObjXAccRel "4d Radar attributes";
CM_ SG_ 953 FourDRadarObjSts18ObjYAccRel "4d Radar attributes";
CM_ SG_ 953 FourDRadarObjSts18ObstacleProbability "4d Radar attributes";
CM_ SG_ 953 FourDRadarObjSts18ProbabilityOfExistence "4d Radar attributes";
CM_ SG_ 953 FourDRadarObjSts18RCS "4d Radar attributes";
CM_ SG_ 953 FourDRadarObjSts18TargetClassificationConfidence "4d Radar attributes";
CM_ SG_ 953 FourDRadarObjSts18UpdateFlag "4d Radar attributes";
CM_ SG_ 953 FourDRadarObjSts18VabsX "4d Radar attributes";
CM_ SG_ 953 FourDRadarObjSts18VabsXStd "4d Radar attributes";
CM_ SG_ 953 FourDRadarObjSts18VabsY "4d Radar attributes";
CM_ SG_ 953 FourDRadarObjSts18VabsYStd "4d Radar attributes";
CM_ SG_ 953 FourDRadarObjSts18ValidFlag "4d Radar attributes";
CM_ SG_ 963 FourDRadarObjSts20Chks "4d Radar attributes";
CM_ SG_ 963 FourDRadarObjSts20Classification "4d Radar attributes";
CM_ SG_ 963 FourDRadarObjSts20Cntr "Counter";
CM_ SG_ 963 FourDRadarObjSts20DistX "4d Radar attributes";
CM_ SG_ 963 FourDRadarObjSts20DistXStd "4d Radar attributes";
CM_ SG_ 963 FourDRadarObjSts20DistY "4d Radar attributes";
CM_ SG_ 963 FourDRadarObjSts20DistYStd "4d Radar attributes";
CM_ SG_ 963 FourDRadarObjSts20DistZ "4d Radar attributes";
CM_ SG_ 963 FourDRadarObjSts20DistZStd "4d Radar attributes";
CM_ SG_ 963 FourDRadarObjSts20DynamicProperty "4d Radar attributes";
CM_ SG_ 963 FourDRadarObjSts20HeadingAngle "4d Radar attributes";
CM_ SG_ 963 FourDRadarObjSts20ID "4d Radar attributes";
CM_ SG_ 963 FourDRadarObjSts20LifeCycles "4d Radar attributes";
CM_ SG_ 963 FourDRadarObjSts20ObjBoundingBoxHeight "4d Radar attributes";
CM_ SG_ 963 FourDRadarObjSts20ObjBoundingBoxLength "4d Radar attributes";
CM_ SG_ 963 FourDRadarObjSts20ObjBoundingBoxWidth "4d Radar attributes";
CM_ SG_ 963 FourDRadarObjSts20ObjNearestPtX "4d Radar attributes";
CM_ SG_ 963 FourDRadarObjSts20ObjNearestPtY "4d Radar attributes";
CM_ SG_ 963 FourDRadarObjSts20ObjNearestPtZ "4d Radar attributes";
CM_ SG_ 963 FourDRadarObjSts20ObjSNR "4d Radar attributes";
CM_ SG_ 963 FourDRadarObjSts20ObjXAccRel "4d Radar attributes";
CM_ SG_ 963 FourDRadarObjSts20ObjYAccRel "4d Radar attributes";
CM_ SG_ 963 FourDRadarObjSts20ObstacleProbability "4d Radar attributes";
CM_ SG_ 963 FourDRadarObjSts20ProbabilityOfExistence "4d Radar attributes";
CM_ SG_ 963 FourDRadarObjSts20RCS "4d Radar attributes";
CM_ SG_ 963 FourDRadarObjSts20TargetClassificationConfidence "4d Radar attributes";
CM_ SG_ 963 FourDRadarObjSts20UpdateFlag "4d Radar attributes";
CM_ SG_ 963 FourDRadarObjSts20VabsX "4d Radar attributes";
CM_ SG_ 963 FourDRadarObjSts20VabsXStd "4d Radar attributes";
CM_ SG_ 963 FourDRadarObjSts20VabsY "4d Radar attributes";
CM_ SG_ 963 FourDRadarObjSts20VabsYStd "4d Radar attributes";
CM_ SG_ 963 FourDRadarObjSts20ValidFlag "4d Radar attributes";
CM_ SG_ 973 FourDRadarObjSts22Chks "4d Radar attributes";
CM_ SG_ 973 FourDRadarObjSts22Classification "4d Radar attributes";
CM_ SG_ 973 FourDRadarObjSts22Cntr "Counter";
CM_ SG_ 973 FourDRadarObjSts22DistX "4d Radar attributes";
CM_ SG_ 973 FourDRadarObjSts22DistXStd "4d Radar attributes";
CM_ SG_ 973 FourDRadarObjSts22DistY "4d Radar attributes";
CM_ SG_ 973 FourDRadarObjSts22DistYStd "4d Radar attributes";
CM_ SG_ 973 FourDRadarObjSts22DistZ "4d Radar attributes";
CM_ SG_ 973 FourDRadarObjSts22DistZStd "4d Radar attributes";
CM_ SG_ 973 FourDRadarObjSts22DynamicProperty "4d Radar attributes";
CM_ SG_ 973 FourDRadarObjSts22HeadingAngle "4d Radar attributes";
CM_ SG_ 973 FourDRadarObjSts22ID "4d Radar attributes";
CM_ SG_ 973 FourDRadarObjSts22LifeCycles "4d Radar attributes";
CM_ SG_ 973 FourDRadarObjSts22ObjBoundingBoxHeight "4d Radar attributes";
CM_ SG_ 973 FourDRadarObjSts22ObjBoundingBoxLength "4d Radar attributes";
CM_ SG_ 973 FourDRadarObjSts22ObjBoundingBoxWidth "4d Radar attributes";
CM_ SG_ 973 FourDRadarObjSts22ObjNearestPtX "4d Radar attributes";
CM_ SG_ 973 FourDRadarObjSts22ObjNearestPtY "4d Radar attributes";
CM_ SG_ 973 FourDRadarObjSts22ObjNearestPtZ "4d Radar attributes";
CM_ SG_ 973 FourDRadarObjSts22ObjSNR "4d Radar attributes";
CM_ SG_ 973 FourDRadarObjSts22ObjXAccRel "4d Radar attributes";
CM_ SG_ 973 FourDRadarObjSts22ObjYAccRel "4d Radar attributes";
CM_ SG_ 973 FourDRadarObjSts22ObstacleProbability "4d Radar attributes";
CM_ SG_ 973 FourDRadarObjSts22ProbabilityOfExistence "4d Radar attributes";
CM_ SG_ 973 FourDRadarObjSts22RCS "4d Radar attributes";
CM_ SG_ 973 FourDRadarObjSts22TargetClassificationConfidence "4d Radar attributes";
CM_ SG_ 973 FourDRadarObjSts22UpdateFlag "4d Radar attributes";
CM_ SG_ 973 FourDRadarObjSts22VabsX "4d Radar attributes";
CM_ SG_ 973 FourDRadarObjSts22VabsXStd "4d Radar attributes";
CM_ SG_ 973 FourDRadarObjSts22VabsY "4d Radar attributes";
CM_ SG_ 973 FourDRadarObjSts22VabsYStd "4d Radar attributes";
CM_ SG_ 973 FourDRadarObjSts22ValidFlag "4d Radar attributes";
CM_ SG_ 983 FourDRadarObjSts24Chks "4d Radar attributes";
CM_ SG_ 983 FourDRadarObjSts24Classification "4d Radar attributes";
CM_ SG_ 983 FourDRadarObjSts24Cntr "Counter";
CM_ SG_ 983 FourDRadarObjSts24DistX "4d Radar attributes";
CM_ SG_ 983 FourDRadarObjSts24DistXStd "4d Radar attributes";
CM_ SG_ 983 FourDRadarObjSts24DistY "4d Radar attributes";
CM_ SG_ 983 FourDRadarObjSts24DistYStd "4d Radar attributes";
CM_ SG_ 983 FourDRadarObjSts24DistZ "4d Radar attributes";
CM_ SG_ 983 FourDRadarObjSts24DistZStd "4d Radar attributes";
CM_ SG_ 983 FourDRadarObjSts24DynamicProperty "4d Radar attributes";
CM_ SG_ 983 FourDRadarObjSts24HeadingAngle "4d Radar attributes";
CM_ SG_ 983 FourDRadarObjSts24ID "4d Radar attributes";
CM_ SG_ 983 FourDRadarObjSts24LifeCycles "4d Radar attributes";
CM_ SG_ 983 FourDRadarObjSts24ObjBoundingBoxHeight "4d Radar attributes";
CM_ SG_ 983 FourDRadarObjSts24ObjBoundingBoxLength "4d Radar attributes";
CM_ SG_ 983 FourDRadarObjSts24ObjBoundingBoxWidth "4d Radar attributes";
CM_ SG_ 983 FourDRadarObjSts24ObjNearestPtX "4d Radar attributes";
CM_ SG_ 983 FourDRadarObjSts24ObjNearestPtY "4d Radar attributes";
CM_ SG_ 983 FourDRadarObjSts24ObjNearestPtZ "4d Radar attributes";
CM_ SG_ 983 FourDRadarObjSts24ObjSNR "4d Radar attributes";
CM_ SG_ 983 FourDRadarObjSts24ObjXAccRel "4d Radar attributes";
CM_ SG_ 983 FourDRadarObjSts24ObjYAccRel "4d Radar attributes";
CM_ SG_ 983 FourDRadarObjSts24ObstacleProbability "4d Radar attributes";
CM_ SG_ 983 FourDRadarObjSts24ProbabilityOfExistence "4d Radar attributes";
CM_ SG_ 983 FourDRadarObjSts24RCS "4d Radar attributes";
CM_ SG_ 983 FourDRadarObjSts24TargetClassificationConfidence "4d Radar attributes";
CM_ SG_ 983 FourDRadarObjSts24UpdateFlag "4d Radar attributes";
CM_ SG_ 983 FourDRadarObjSts24VabsX "4d Radar attributes";
CM_ SG_ 983 FourDRadarObjSts24VabsXStd "4d Radar attributes";
CM_ SG_ 983 FourDRadarObjSts24VabsY "4d Radar attributes";
CM_ SG_ 983 FourDRadarObjSts24VabsYStd "4d Radar attributes";
CM_ SG_ 983 FourDRadarObjSts24ValidFlag "4d Radar attributes";
CM_ SG_ 993 FourDRadarObjSts26Chks "4d Radar attributes";
CM_ SG_ 993 FourDRadarObjSts26Classification "4d Radar attributes";
CM_ SG_ 993 FourDRadarObjSts26Cntr "Counter";
CM_ SG_ 993 FourDRadarObjSts26DistX "4d Radar attributes";
CM_ SG_ 993 FourDRadarObjSts26DistXStd "4d Radar attributes";
CM_ SG_ 993 FourDRadarObjSts26DistY "4d Radar attributes";
CM_ SG_ 993 FourDRadarObjSts26DistYStd "4d Radar attributes";
CM_ SG_ 993 FourDRadarObjSts26DistZ "4d Radar attributes";
CM_ SG_ 993 FourDRadarObjSts26DistZStd "4d Radar attributes";
CM_ SG_ 993 FourDRadarObjSts26DynamicProperty "4d Radar attributes";
CM_ SG_ 993 FourDRadarObjSts26HeadingAngle "4d Radar attributes";
CM_ SG_ 993 FourDRadarObjSts26ID "4d Radar attributes";
CM_ SG_ 993 FourDRadarObjSts26LifeCycles "4d Radar attributes";
CM_ SG_ 993 FourDRadarObjSts26ObjBoundingBoxHeight "4d Radar attributes";
CM_ SG_ 993 FourDRadarObjSts26ObjBoundingBoxLength "4d Radar attributes";
CM_ SG_ 993 FourDRadarObjSts26ObjBoundingBoxWidth "4d Radar attributes";
CM_ SG_ 993 FourDRadarObjSts26ObjNearestPtX "4d Radar attributes";
CM_ SG_ 993 FourDRadarObjSts26ObjNearestPtY "4d Radar attributes";
CM_ SG_ 993 FourDRadarObjSts26ObjNearestPtZ "4d Radar attributes";
CM_ SG_ 993 FourDRadarObjSts26ObjSNR "4d Radar attributes";
CM_ SG_ 993 FourDRadarObjSts26ObjXAccRel "4d Radar attributes";
CM_ SG_ 993 FourDRadarObjSts26ObjYAccRel "4d Radar attributes";
CM_ SG_ 993 FourDRadarObjSts26ObstacleProbability "4d Radar attributes";
CM_ SG_ 993 FourDRadarObjSts26ProbabilityOfExistence "4d Radar attributes";
CM_ SG_ 993 FourDRadarObjSts26RCS "4d Radar attributes";
CM_ SG_ 993 FourDRadarObjSts26TargetClassificationConfidence "4d Radar attributes";
CM_ SG_ 993 FourDRadarObjSts26UpdateFlag "4d Radar attributes";
CM_ SG_ 993 FourDRadarObjSts26VabsX "4d Radar attributes";
CM_ SG_ 993 FourDRadarObjSts26VabsXStd "4d Radar attributes";
CM_ SG_ 993 FourDRadarObjSts26VabsY "4d Radar attributes";
CM_ SG_ 993 FourDRadarObjSts26VabsYStd "4d Radar attributes";
CM_ SG_ 993 FourDRadarObjSts26ValidFlag "4d Radar attributes";
BA_DEF_ BO_ "CANFD_BRS" ENUM "0","1";
BA_DEF_ BO_ "GenMsgCycleTime" INT 0 65536; // [ms]
BA_DEF_ BO_ "GenMsgDelayTime" INT 0 65536; // [ms]
BA_DEF_ BO_ "GenMsgSendType" ENUM "cyclic", "spontaneous", "not-used", "not-used", "not-used", "cyclicAndSpontaneous", "not-used", "cyclicIfActive", "NoMsgSendType"; // [us]
BA_DEF_ BO_ "GenMsgStartDelayTime" INT 0 65536; // [ms]
BA_DEF_ BO_ "VFrameFormat" ENUM "StandardCAN","ExtendedCAN","reserved","J1939PG","reserved","reserved","reserved","reserved","reserved","reserved","reserved","reserved","reserved","reserved","StandardCAN_FD","ExtendedCAN_FD";
BA_DEF_ SG_ "GenSigSendType" ENUM "Cyclic","OnWrite","OnWriteWithRepetition","OnChange","OnChangeWithRepetition","IfActive","IfActiveWithRepetition","NoSigSendType";
BA_DEF_ SG_ "GenSigStartValue" HEX 0 80000000;
BA_DEF_ BO_ "GenMsgILSupport" ENUM "No","Yes";
BA_DEF_ BO_ "NmAsrMessage" ENUM "No","Yes";
BA_DEF_ SG_ "GenSigFuncType" ENUM "NoFunction","n/a","n/a","n/a","n/a","n/a","n/a","n/a","n/a","n/a","n/a","n/a","n/a","n/a","n/a","CHK","CNTR","n/a","n/a","n/a","CNTR_AR_01","CRC_AR_01_BOTH","CRC_AR_01_ALT","CRC_AR_01_LOW","CRC_AR_01_NIBBLE","CNTR_AR_04","CRC_AR_04A","CNTR_AR_05","CRC_AR_05";
BA_DEF_ SG_ "GenSigDataID" STRING;
BA_DEF_DEF_ "CANFD_BRS" "1";
BA_DEF_DEF_ "GenSigStartValue" 0;
BA_DEF_DEF_ "VFrameFormat" "J1939PG";
BA_DEF_DEF_ "GenSigSendType" "NoSigSendType";
BA_DEF_DEF_ "GenMsgCycleTime" 0;
BA_DEF_DEF_ "GenMsgDelayTime" 0;
BA_DEF_DEF_ "GenMsgStartDelayTime" 0;
BA_DEF_DEF_ "GenMsgSendType" "NoMsgSendType";
BA_DEF_DEF_ "GenMsgILSupport" "Yes";
BA_DEF_DEF_ "NmAsrMessage" "No";
BA_DEF_DEF_ "GenSigFuncType" "NoFunction";
BA_DEF_DEF_ "GenSigDataID" "";
// Frame: FLRSafetyCANFD2Frame83
BA_ "GenMsgCycleTime" BO_ 898 60.000;
BA_ "GenMsgSendType" BO_ 898 0;
BA_ "VFrameFormat" BO_ 898 14;
// Frame: FLRSafetyCANFD2Frame84
BA_ "GenMsgCycleTime" BO_ 899 60.000;
BA_ "GenMsgSendType" BO_ 899 0;
BA_ "VFrameFormat" BO_ 899 14;
// Frame: FLRSafetyCANFD2Frame85
BA_ "GenMsgCycleTime" BO_ 900 60.000;
BA_ "GenMsgSendType" BO_ 900 0;
BA_ "VFrameFormat" BO_ 900 14;
// Frame: FLRSafetyCANFD2Frame86
BA_ "GenMsgCycleTime" BO_ 901 60.000;
BA_ "GenMsgSendType" BO_ 901 0;
BA_ "VFrameFormat" BO_ 901 14;
// Frame: FLRSafetyCANFD2Frame87
BA_ "GenMsgCycleTime" BO_ 863 60.000;
BA_ "GenMsgSendType" BO_ 863 0;
BA_ "VFrameFormat" BO_ 863 14;
// Frame: FLRSafetyCANFD2Frame88
BA_ "GenMsgCycleTime" BO_ 873 60.000;
BA_ "GenMsgSendType" BO_ 873 0;
BA_ "VFrameFormat" BO_ 873 14;
// Frame: FLRSafetyCANFD2Frame89
BA_ "GenMsgCycleTime" BO_ 951 60.000;
BA_ "GenMsgSendType" BO_ 951 0;
BA_ "VFrameFormat" BO_ 951 14;
// Frame: FLRSafetyCANFD2Frame90
BA_ "GenMsgCycleTime" BO_ 903 60.000;
BA_ "GenMsgSendType" BO_ 903 0;
BA_ "VFrameFormat" BO_ 903 14;
// Frame: FLRSafetyCANFD2Frame91
BA_ "GenMsgCycleTime" BO_ 913 60.000;
BA_ "GenMsgSendType" BO_ 913 0;
BA_ "VFrameFormat" BO_ 913 14;
// Frame: FLRSafetyCANFD2Frame92
BA_ "GenMsgCycleTime" BO_ 923 60.000;
BA_ "GenMsgSendType" BO_ 923 0;
BA_ "VFrameFormat" BO_ 923 14;
// Frame: FLRSafetyCANFD2Frame93
BA_ "GenMsgCycleTime" BO_ 952 60.000;
BA_ "GenMsgSendType" BO_ 952 0;
BA_ "VFrameFormat" BO_ 952 14;
// Frame: FLRSafetyCANFD2Frame94
BA_ "GenMsgCycleTime" BO_ 954 60.000;
BA_ "GenMsgSendType" BO_ 954 0;
BA_ "VFrameFormat" BO_ 954 14;
// Frame: FLRSafetyCANFD2Frame95
BA_ "GenMsgCycleTime" BO_ 953 60.000;
BA_ "GenMsgSendType" BO_ 953 0;
BA_ "VFrameFormat" BO_ 953 14;
// Frame: FLRSafetyCANFD2Frame96
BA_ "GenMsgCycleTime" BO_ 963 60.000;
BA_ "GenMsgSendType" BO_ 963 0;
BA_ "VFrameFormat" BO_ 963 14;
// Frame: FLRSafetyCANFD2Frame97
BA_ "GenMsgCycleTime" BO_ 973 60.000;
BA_ "GenMsgSendType" BO_ 973 0;
BA_ "VFrameFormat" BO_ 973 14;
// Frame: FLRSafetyCANFD2Frame98
BA_ "GenMsgCycleTime" BO_ 983 60.000;
BA_ "GenMsgSendType" BO_ 983 0;
BA_ "VFrameFormat" BO_ 983 14;
// Frame: FLRSafetyCANFD2Frame99
BA_ "GenMsgCycleTime" BO_ 993 60.000;
BA_ "GenMsgSendType" BO_ 993 0;
BA_ "VFrameFormat" BO_ 993 14;
// Frame: FlrSafetyCanFD2NmFr
BA_ "GenMsgDelayTime" BO_ 1282 20.000;
BA_ "GenMsgSendType" BO_ 1282 1;
BA_ "VFrameFormat" BO_ 1282 0;
// Frame: FlrToAsdmSafetyCanFD2DiagResFrame1
BA_ "GenMsgDelayTime" BO_ 1604 5.000;
BA_ "GenMsgSendType" BO_ 1604 1;
BA_ "VFrameFormat" BO_ 1604 14;
BA_ "GenMsgILSupport" BO_ 1282 0;
BA_ "NmAsrMessage" BO_ 1282 1;
BA_ "GenSigDataID" SG_ 873 FourDRadarObjSts04Chks "0xE06";
BA_ "GenSigFuncType" SG_ 873 FourDRadarObjSts04Chks 15;
BA_ "GenSigSendType" SG_ 873 FourDRadarObjSts04Chks 0;
BA_ "GenSigSendType" SG_ 873 FourDRadarObjSts04Classification 0;
BA_ "GenSigFuncType" SG_ 873 FourDRadarObjSts04Cntr 16;
BA_ "GenSigSendType" SG_ 873 FourDRadarObjSts04Cntr 0;
BA_ "GenSigSendType" SG_ 873 FourDRadarObjSts04DistX 0;
BA_ "GenSigStartValue" SG_ 873 FourDRadarObjSts04DistX 32768;
BA_ "GenSigSendType" SG_ 873 FourDRadarObjSts04DistXStd 0;
BA_ "GenSigSendType" SG_ 873 FourDRadarObjSts04DistY 0;
BA_ "GenSigStartValue" SG_ 873 FourDRadarObjSts04DistY 4096;
BA_ "GenSigSendType" SG_ 873 FourDRadarObjSts04DistYStd 0;
BA_ "GenSigSendType" SG_ 873 FourDRadarObjSts04DistZ 0;
BA_ "GenSigStartValue" SG_ 873 FourDRadarObjSts04DistZ 4096;
BA_ "GenSigSendType" SG_ 873 FourDRadarObjSts04DistZStd 0;
BA_ "GenSigSendType" SG_ 873 FourDRadarObjSts04DynamicProperty 0;
BA_ "GenSigSendType" SG_ 873 FourDRadarObjSts04HeadingAngle 0;
BA_ "GenSigStartValue" SG_ 873 FourDRadarObjSts04HeadingAngle 2047.78157;
BA_ "GenSigSendType" SG_ 873 FourDRadarObjSts04ID 0;
BA_ "GenSigSendType" SG_ 873 FourDRadarObjSts04LifeCycles 0;
BA_ "GenSigSendType" SG_ 873 FourDRadarObjSts04ObjBoundingBoxHeight 0;
BA_ "GenSigSendType" SG_ 873 FourDRadarObjSts04ObjBoundingBoxLength 0;
BA_ "GenSigSendType" SG_ 873 FourDRadarObjSts04ObjBoundingBoxWidth 0;
BA_ "GenSigSendType" SG_ 873 FourDRadarObjSts04ObjNearestPtX 0;
BA_ "GenSigStartValue" SG_ 873 FourDRadarObjSts04ObjNearestPtX 32768;
BA_ "GenSigSendType" SG_ 873 FourDRadarObjSts04ObjNearestPtY 0;
BA_ "GenSigStartValue" SG_ 873 FourDRadarObjSts04ObjNearestPtY 4096;
BA_ "GenSigSendType" SG_ 873 FourDRadarObjSts04ObjNearestPtZ 0;
BA_ "GenSigStartValue" SG_ 873 FourDRadarObjSts04ObjNearestPtZ 4096;
BA_ "GenSigSendType" SG_ 873 FourDRadarObjSts04ObjSNR 0;
BA_ "GenSigSendType" SG_ 873 FourDRadarObjSts04ObjXAccRel 0;
BA_ "GenSigStartValue" SG_ 873 FourDRadarObjSts04ObjXAccRel 356;
BA_ "GenSigSendType" SG_ 873 FourDRadarObjSts04ObjYAccRel 0;
BA_ "GenSigStartValue" SG_ 873 FourDRadarObjSts04ObjYAccRel 356;
BA_ "GenSigSendType" SG_ 873 FourDRadarObjSts04ObstacleProbability 0;
BA_ "GenSigSendType" SG_ 873 FourDRadarObjSts04ProbabilityOfExistence 0;
BA_ "GenSigSendType" SG_ 873 FourDRadarObjSts04RCS 0;
BA_ "GenSigStartValue" SG_ 873 FourDRadarObjSts04RCS 1000;
BA_ "GenSigSendType" SG_ 873 FourDRadarObjSts04TargetClassificationConfidence 0;
BA_ "GenSigSendType" SG_ 873 FourDRadarObjSts04UpdateFlag 0;
BA_ "GenSigSendType" SG_ 873 FourDRadarObjSts04VabsX 0;
BA_ "GenSigStartValue" SG_ 873 FourDRadarObjSts04VabsX 1024;
BA_ "GenSigSendType" SG_ 873 FourDRadarObjSts04VabsXStd 0;
BA_ "GenSigSendType" SG_ 873 FourDRadarObjSts04VabsY 0;
BA_ "GenSigStartValue" SG_ 873 FourDRadarObjSts04VabsY 1024;
BA_ "GenSigSendType" SG_ 873 FourDRadarObjSts04VabsYStd 0;
BA_ "GenSigSendType" SG_ 873 FourDRadarObjSts04ValidFlag 0;
BA_ "GenSigDataID" SG_ 951 FourDRadarObjSts06Chks "0xE08";
BA_ "GenSigFuncType" SG_ 951 FourDRadarObjSts06Chks 15;
BA_ "GenSigSendType" SG_ 951 FourDRadarObjSts06Chks 0;
BA_ "GenSigSendType" SG_ 951 FourDRadarObjSts06Classification 0;
BA_ "GenSigFuncType" SG_ 951 FourDRadarObjSts06Cntr 16;
BA_ "GenSigSendType" SG_ 951 FourDRadarObjSts06Cntr 0;
BA_ "GenSigSendType" SG_ 951 FourDRadarObjSts06DistX 0;
BA_ "GenSigStartValue" SG_ 951 FourDRadarObjSts06DistX 32768;
BA_ "GenSigSendType" SG_ 951 FourDRadarObjSts06DistXStd 0;
BA_ "GenSigSendType" SG_ 951 FourDRadarObjSts06DistY 0;
BA_ "GenSigStartValue" SG_ 951 FourDRadarObjSts06DistY 4096;
BA_ "GenSigSendType" SG_ 951 FourDRadarObjSts06DistYStd 0;
BA_ "GenSigSendType" SG_ 951 FourDRadarObjSts06DistZ 0;
BA_ "GenSigStartValue" SG_ 951 FourDRadarObjSts06DistZ 4096;
BA_ "GenSigSendType" SG_ 951 FourDRadarObjSts06DistZStd 0;
BA_ "GenSigSendType" SG_ 951 FourDRadarObjSts06DynamicProperty 0;
BA_ "GenSigSendType" SG_ 951 FourDRadarObjSts06HeadingAngle 0;
BA_ "GenSigStartValue" SG_ 951 FourDRadarObjSts06HeadingAngle 2047.78157;
BA_ "GenSigSendType" SG_ 951 FourDRadarObjSts06ID 0;
BA_ "GenSigSendType" SG_ 951 FourDRadarObjSts06LifeCycles 0;
BA_ "GenSigSendType" SG_ 951 FourDRadarObjSts06ObjBoundingBoxHeight 0;
BA_ "GenSigSendType" SG_ 951 FourDRadarObjSts06ObjBoundingBoxLength 0;
BA_ "GenSigSendType" SG_ 951 FourDRadarObjSts06ObjBoundingBoxWidth 0;
BA_ "GenSigSendType" SG_ 951 FourDRadarObjSts06ObjNearestPtX 0;
BA_ "GenSigStartValue" SG_ 951 FourDRadarObjSts06ObjNearestPtX 32768;
BA_ "GenSigSendType" SG_ 951 FourDRadarObjSts06ObjNearestPtY 0;
BA_ "GenSigStartValue" SG_ 951 FourDRadarObjSts06ObjNearestPtY 4096;
BA_ "GenSigSendType" SG_ 951 FourDRadarObjSts06ObjNearestPtZ 0;
BA_ "GenSigStartValue" SG_ 951 FourDRadarObjSts06ObjNearestPtZ 4096;
BA_ "GenSigSendType" SG_ 951 FourDRadarObjSts06ObjSNR 0;
BA_ "GenSigSendType" SG_ 951 FourDRadarObjSts06ObjXAccRel 0;
BA_ "GenSigStartValue" SG_ 951 FourDRadarObjSts06ObjXAccRel 356;
BA_ "GenSigSendType" SG_ 951 FourDRadarObjSts06ObjYAccRel 0;
BA_ "GenSigStartValue" SG_ 951 FourDRadarObjSts06ObjYAccRel 356;
BA_ "GenSigSendType" SG_ 951 FourDRadarObjSts06ObstacleProbability 0;
BA_ "GenSigSendType" SG_ 951 FourDRadarObjSts06ProbabilityOfExistence 0;
BA_ "GenSigSendType" SG_ 951 FourDRadarObjSts06RCS 0;
BA_ "GenSigStartValue" SG_ 951 FourDRadarObjSts06RCS 1000;
BA_ "GenSigSendType" SG_ 951 FourDRadarObjSts06TargetClassificationConfidence 0;
BA_ "GenSigSendType" SG_ 951 FourDRadarObjSts06UpdateFlag 0;
BA_ "GenSigSendType" SG_ 951 FourDRadarObjSts06VabsX 0;
BA_ "GenSigStartValue" SG_ 951 FourDRadarObjSts06VabsX 1024;
BA_ "GenSigSendType" SG_ 951 FourDRadarObjSts06VabsXStd 0;
BA_ "GenSigSendType" SG_ 951 FourDRadarObjSts06VabsY 0;
BA_ "GenSigStartValue" SG_ 951 FourDRadarObjSts06VabsY 1024;
BA_ "GenSigSendType" SG_ 951 FourDRadarObjSts06VabsYStd 0;
BA_ "GenSigSendType" SG_ 951 FourDRadarObjSts06ValidFlag 0;
BA_ "GenSigDataID" SG_ 903 FourDRadarObjSts08Chks "0xE0A";
BA_ "GenSigFuncType" SG_ 903 FourDRadarObjSts08Chks 15;
BA_ "GenSigSendType" SG_ 903 FourDRadarObjSts08Chks 0;
BA_ "GenSigSendType" SG_ 903 FourDRadarObjSts08Classification 0;
BA_ "GenSigFuncType" SG_ 903 FourDRadarObjSts08Cntr 16;
BA_ "GenSigSendType" SG_ 903 FourDRadarObjSts08Cntr 0;
BA_ "GenSigSendType" SG_ 903 FourDRadarObjSts08DistX 0;
BA_ "GenSigStartValue" SG_ 903 FourDRadarObjSts08DistX 32768;
BA_ "GenSigSendType" SG_ 903 FourDRadarObjSts08DistXStd 0;
BA_ "GenSigSendType" SG_ 903 FourDRadarObjSts08DistY 0;
BA_ "GenSigStartValue" SG_ 903 FourDRadarObjSts08DistY 4096;
BA_ "GenSigSendType" SG_ 903 FourDRadarObjSts08DistYStd 0;
BA_ "GenSigSendType" SG_ 903 FourDRadarObjSts08DistZ 0;
BA_ "GenSigStartValue" SG_ 903 FourDRadarObjSts08DistZ 4096;
BA_ "GenSigSendType" SG_ 903 FourDRadarObjSts08DistZStd 0;
BA_ "GenSigSendType" SG_ 903 FourDRadarObjSts08DynamicProperty 0;
BA_ "GenSigSendType" SG_ 903 FourDRadarObjSts08HeadingAngle 0;
BA_ "GenSigStartValue" SG_ 903 FourDRadarObjSts08HeadingAngle 2047.78157;
BA_ "GenSigSendType" SG_ 903 FourDRadarObjSts08ID 0;
BA_ "GenSigSendType" SG_ 903 FourDRadarObjSts08LifeCycles 0;
BA_ "GenSigSendType" SG_ 903 FourDRadarObjSts08ObjBoundingBoxHeight 0;
BA_ "GenSigSendType" SG_ 903 FourDRadarObjSts08ObjBoundingBoxLength 0;
BA_ "GenSigSendType" SG_ 903 FourDRadarObjSts08ObjBoundingBoxWidth 0;
BA_ "GenSigSendType" SG_ 903 FourDRadarObjSts08ObjNearestPtX 0;
BA_ "GenSigStartValue" SG_ 903 FourDRadarObjSts08ObjNearestPtX 32768;
BA_ "GenSigSendType" SG_ 903 FourDRadarObjSts08ObjNearestPtY 0;
BA_ "GenSigStartValue" SG_ 903 FourDRadarObjSts08ObjNearestPtY 4096;
BA_ "GenSigSendType" SG_ 903 FourDRadarObjSts08ObjNearestPtZ 0;
BA_ "GenSigStartValue" SG_ 903 FourDRadarObjSts08ObjNearestPtZ 4096;
BA_ "GenSigSendType" SG_ 903 FourDRadarObjSts08ObjSNR 0;
BA_ "GenSigSendType" SG_ 903 FourDRadarObjSts08ObjXAccRel 0;
BA_ "GenSigStartValue" SG_ 903 FourDRadarObjSts08ObjXAccRel 356;
BA_ "GenSigSendType" SG_ 903 FourDRadarObjSts08ObjYAccRel 0;
BA_ "GenSigStartValue" SG_ 903 FourDRadarObjSts08ObjYAccRel 356;
BA_ "GenSigSendType" SG_ 903 FourDRadarObjSts08ObstacleProbability 0;
BA_ "GenSigSendType" SG_ 903 FourDRadarObjSts08ProbabilityOfExistence 0;
BA_ "GenSigSendType" SG_ 903 FourDRadarObjSts08RCS 0;
BA_ "GenSigStartValue" SG_ 903 FourDRadarObjSts08RCS 1000;
BA_ "GenSigSendType" SG_ 903 FourDRadarObjSts08TargetClassificationConfidence 0;
BA_ "GenSigSendType" SG_ 903 FourDRadarObjSts08UpdateFlag 0;
BA_ "GenSigSendType" SG_ 903 FourDRadarObjSts08VabsX 0;
BA_ "GenSigStartValue" SG_ 903 FourDRadarObjSts08VabsX 1024;
BA_ "GenSigSendType" SG_ 903 FourDRadarObjSts08VabsXStd 0;
BA_ "GenSigSendType" SG_ 903 FourDRadarObjSts08VabsY 0;
BA_ "GenSigStartValue" SG_ 903 FourDRadarObjSts08VabsY 1024;
BA_ "GenSigSendType" SG_ 903 FourDRadarObjSts08VabsYStd 0;
BA_ "GenSigSendType" SG_ 903 FourDRadarObjSts08ValidFlag 0;
BA_ "GenSigDataID" SG_ 913 FourDRadarObjSts10Chks "0xE0C";
BA_ "GenSigFuncType" SG_ 913 FourDRadarObjSts10Chks 15;
BA_ "GenSigSendType" SG_ 913 FourDRadarObjSts10Chks 0;
BA_ "GenSigSendType" SG_ 913 FourDRadarObjSts10Classification 0;
BA_ "GenSigFuncType" SG_ 913 FourDRadarObjSts10Cntr 16;
BA_ "GenSigSendType" SG_ 913 FourDRadarObjSts10Cntr 0;
BA_ "GenSigSendType" SG_ 913 FourDRadarObjSts10DistX 0;
BA_ "GenSigStartValue" SG_ 913 FourDRadarObjSts10DistX 32768;
BA_ "GenSigSendType" SG_ 913 FourDRadarObjSts10DistXStd 0;
BA_ "GenSigSendType" SG_ 913 FourDRadarObjSts10DistY 0;
BA_ "GenSigStartValue" SG_ 913 FourDRadarObjSts10DistY 4096;
BA_ "GenSigSendType" SG_ 913 FourDRadarObjSts10DistYStd 0;
BA_ "GenSigSendType" SG_ 913 FourDRadarObjSts10DistZ 0;
BA_ "GenSigStartValue" SG_ 913 FourDRadarObjSts10DistZ 4096;
BA_ "GenSigSendType" SG_ 913 FourDRadarObjSts10DistZStd 0;
BA_ "GenSigSendType" SG_ 913 FourDRadarObjSts10DynamicProperty 0;
BA_ "GenSigSendType" SG_ 913 FourDRadarObjSts10HeadingAngle 0;
BA_ "GenSigStartValue" SG_ 913 FourDRadarObjSts10HeadingAngle 2047.78157;
BA_ "GenSigSendType" SG_ 913 FourDRadarObjSts10ID 0;
BA_ "GenSigSendType" SG_ 913 FourDRadarObjSts10LifeCycles 0;
BA_ "GenSigSendType" SG_ 913 FourDRadarObjSts10ObjBoundingBoxHeight 0;
BA_ "GenSigSendType" SG_ 913 FourDRadarObjSts10ObjBoundingBoxLength 0;
BA_ "GenSigSendType" SG_ 913 FourDRadarObjSts10ObjBoundingBoxWidth 0;
BA_ "GenSigSendType" SG_ 913 FourDRadarObjSts10ObjNearestPtX 0;
BA_ "GenSigStartValue" SG_ 913 FourDRadarObjSts10ObjNearestPtX 32768;
BA_ "GenSigSendType" SG_ 913 FourDRadarObjSts10ObjNearestPtY 0;
BA_ "GenSigStartValue" SG_ 913 FourDRadarObjSts10ObjNearestPtY 4096;
BA_ "GenSigSendType" SG_ 913 FourDRadarObjSts10ObjNearestPtZ 0;
BA_ "GenSigStartValue" SG_ 913 FourDRadarObjSts10ObjNearestPtZ 4096;
BA_ "GenSigSendType" SG_ 913 FourDRadarObjSts10ObjSNR 0;
BA_ "GenSigSendType" SG_ 913 FourDRadarObjSts10ObjXAccRel 0;
BA_ "GenSigStartValue" SG_ 913 FourDRadarObjSts10ObjXAccRel 356;
BA_ "GenSigSendType" SG_ 913 FourDRadarObjSts10ObjYAccRel 0;
BA_ "GenSigStartValue" SG_ 913 FourDRadarObjSts10ObjYAccRel 356;
BA_ "GenSigSendType" SG_ 913 FourDRadarObjSts10ObstacleProbability 0;
BA_ "GenSigSendType" SG_ 913 FourDRadarObjSts10ProbabilityOfExistence 0;
BA_ "GenSigSendType" SG_ 913 FourDRadarObjSts10RCS 0;
BA_ "GenSigStartValue" SG_ 913 FourDRadarObjSts10RCS 1000;
BA_ "GenSigSendType" SG_ 913 FourDRadarObjSts10TargetClassificationConfidence 0;
BA_ "GenSigSendType" SG_ 913 FourDRadarObjSts10UpdateFlag 0;
BA_ "GenSigSendType" SG_ 913 FourDRadarObjSts10VabsX 0;
BA_ "GenSigStartValue" SG_ 913 FourDRadarObjSts10VabsX 1024;
BA_ "GenSigSendType" SG_ 913 FourDRadarObjSts10VabsXStd 0;
BA_ "GenSigSendType" SG_ 913 FourDRadarObjSts10VabsY 0;
BA_ "GenSigStartValue" SG_ 913 FourDRadarObjSts10VabsY 1024;
BA_ "GenSigSendType" SG_ 913 FourDRadarObjSts10VabsYStd 0;
BA_ "GenSigSendType" SG_ 913 FourDRadarObjSts10ValidFlag 0;
BA_ "GenSigDataID" SG_ 923 FourDRadarObjSts12Chks "0xE0E";
BA_ "GenSigFuncType" SG_ 923 FourDRadarObjSts12Chks 15;
BA_ "GenSigSendType" SG_ 923 FourDRadarObjSts12Chks 0;
BA_ "GenSigSendType" SG_ 923 FourDRadarObjSts12Classification 0;
BA_ "GenSigFuncType" SG_ 923 FourDRadarObjSts12Cntr 16;
BA_ "GenSigSendType" SG_ 923 FourDRadarObjSts12Cntr 0;
BA_ "GenSigSendType" SG_ 923 FourDRadarObjSts12DistX 0;
BA_ "GenSigStartValue" SG_ 923 FourDRadarObjSts12DistX 32768;
BA_ "GenSigSendType" SG_ 923 FourDRadarObjSts12DistXStd 0;
BA_ "GenSigSendType" SG_ 923 FourDRadarObjSts12DistY 0;
BA_ "GenSigStartValue" SG_ 923 FourDRadarObjSts12DistY 4096;
BA_ "GenSigSendType" SG_ 923 FourDRadarObjSts12DistYStd 0;
BA_ "GenSigSendType" SG_ 923 FourDRadarObjSts12DistZ 0;
BA_ "GenSigStartValue" SG_ 923 FourDRadarObjSts12DistZ 4096;
BA_ "GenSigSendType" SG_ 923 FourDRadarObjSts12DistZStd 0;
BA_ "GenSigSendType" SG_ 923 FourDRadarObjSts12DynamicProperty 0;
BA_ "GenSigSendType" SG_ 923 FourDRadarObjSts12HeadingAngle 0;
BA_ "GenSigStartValue" SG_ 923 FourDRadarObjSts12HeadingAngle 2047.78157;
BA_ "GenSigSendType" SG_ 923 FourDRadarObjSts12ID 0;
BA_ "GenSigSendType" SG_ 923 FourDRadarObjSts12LifeCycles 0;
BA_ "GenSigSendType" SG_ 923 FourDRadarObjSts12ObjBoundingBoxHeight 0;
BA_ "GenSigSendType" SG_ 923 FourDRadarObjSts12ObjBoundingBoxLength 0;
BA_ "GenSigSendType" SG_ 923 FourDRadarObjSts12ObjBoundingBoxWidth 0;
BA_ "GenSigSendType" SG_ 923 FourDRadarObjSts12ObjNearestPtX 0;
BA_ "GenSigStartValue" SG_ 923 FourDRadarObjSts12ObjNearestPtX 32768;
BA_ "GenSigSendType" SG_ 923 FourDRadarObjSts12ObjNearestPtY 0;
BA_ "GenSigStartValue" SG_ 923 FourDRadarObjSts12ObjNearestPtY 4096;
BA_ "GenSigSendType" SG_ 923 FourDRadarObjSts12ObjNearestPtZ 0;
BA_ "GenSigStartValue" SG_ 923 FourDRadarObjSts12ObjNearestPtZ 4096;
BA_ "GenSigSendType" SG_ 923 FourDRadarObjSts12ObjSNR 0;
BA_ "GenSigSendType" SG_ 923 FourDRadarObjSts12ObjXAccRel 0;
BA_ "GenSigStartValue" SG_ 923 FourDRadarObjSts12ObjXAccRel 356;
BA_ "GenSigSendType" SG_ 923 FourDRadarObjSts12ObjYAccRel 0;
BA_ "GenSigStartValue" SG_ 923 FourDRadarObjSts12ObjYAccRel 356;
BA_ "GenSigSendType" SG_ 923 FourDRadarObjSts12ObstacleProbability 0;
BA_ "GenSigSendType" SG_ 923 FourDRadarObjSts12ProbabilityOfExistence 0;
BA_ "GenSigSendType" SG_ 923 FourDRadarObjSts12RCS 0;
BA_ "GenSigStartValue" SG_ 923 FourDRadarObjSts12RCS 1000;
BA_ "GenSigSendType" SG_ 923 FourDRadarObjSts12TargetClassificationConfidence 0;
BA_ "GenSigSendType" SG_ 923 FourDRadarObjSts12UpdateFlag 0;
BA_ "GenSigSendType" SG_ 923 FourDRadarObjSts12VabsX 0;
BA_ "GenSigStartValue" SG_ 923 FourDRadarObjSts12VabsX 1024;
BA_ "GenSigSendType" SG_ 923 FourDRadarObjSts12VabsXStd 0;
BA_ "GenSigSendType" SG_ 923 FourDRadarObjSts12VabsY 0;
BA_ "GenSigStartValue" SG_ 923 FourDRadarObjSts12VabsY 1024;
BA_ "GenSigSendType" SG_ 923 FourDRadarObjSts12VabsYStd 0;
BA_ "GenSigSendType" SG_ 923 FourDRadarObjSts12ValidFlag 0;
BA_ "GenSigDataID" SG_ 952 FourDRadarObjSts14Chks "0xE10";
BA_ "GenSigFuncType" SG_ 952 FourDRadarObjSts14Chks 15;
BA_ "GenSigSendType" SG_ 952 FourDRadarObjSts14Chks 0;
BA_ "GenSigSendType" SG_ 952 FourDRadarObjSts14Classification 0;
BA_ "GenSigFuncType" SG_ 952 FourDRadarObjSts14Cntr 16;
BA_ "GenSigSendType" SG_ 952 FourDRadarObjSts14Cntr 0;
BA_ "GenSigSendType" SG_ 952 FourDRadarObjSts14DistX 0;
BA_ "GenSigStartValue" SG_ 952 FourDRadarObjSts14DistX 32768;
BA_ "GenSigSendType" SG_ 952 FourDRadarObjSts14DistXStd 0;
BA_ "GenSigSendType" SG_ 952 FourDRadarObjSts14DistY 0;
BA_ "GenSigStartValue" SG_ 952 FourDRadarObjSts14DistY 4096;
BA_ "GenSigSendType" SG_ 952 FourDRadarObjSts14DistYStd 0;
BA_ "GenSigSendType" SG_ 952 FourDRadarObjSts14DistZ 0;
BA_ "GenSigStartValue" SG_ 952 FourDRadarObjSts14DistZ 4096;
BA_ "GenSigSendType" SG_ 952 FourDRadarObjSts14DistZStd 0;
BA_ "GenSigSendType" SG_ 952 FourDRadarObjSts14DynamicProperty 0;
BA_ "GenSigSendType" SG_ 952 FourDRadarObjSts14HeadingAngle 0;
BA_ "GenSigStartValue" SG_ 952 FourDRadarObjSts14HeadingAngle 2047.78157;
BA_ "GenSigSendType" SG_ 952 FourDRadarObjSts14ID 0;
BA_ "GenSigSendType" SG_ 952 FourDRadarObjSts14LifeCycles 0;
BA_ "GenSigSendType" SG_ 952 FourDRadarObjSts14ObjBoundingBoxHeight 0;
BA_ "GenSigSendType" SG_ 952 FourDRadarObjSts14ObjBoundingBoxLength 0;
BA_ "GenSigSendType" SG_ 952 FourDRadarObjSts14ObjBoundingBoxWidth 0;
BA_ "GenSigSendType" SG_ 952 FourDRadarObjSts14ObjNearestPtX 0;
BA_ "GenSigStartValue" SG_ 952 FourDRadarObjSts14ObjNearestPtX 32768;
BA_ "GenSigSendType" SG_ 952 FourDRadarObjSts14ObjNearestPtY 0;
BA_ "GenSigStartValue" SG_ 952 FourDRadarObjSts14ObjNearestPtY 4096;
BA_ "GenSigSendType" SG_ 952 FourDRadarObjSts14ObjNearestPtZ 0;
BA_ "GenSigStartValue" SG_ 952 FourDRadarObjSts14ObjNearestPtZ 4096;
BA_ "GenSigSendType" SG_ 952 FourDRadarObjSts14ObjSNR 0;
BA_ "GenSigSendType" SG_ 952 FourDRadarObjSts14ObjXAccRel 0;
BA_ "GenSigStartValue" SG_ 952 FourDRadarObjSts14ObjXAccRel 356;
BA_ "GenSigSendType" SG_ 952 FourDRadarObjSts14ObjYAccRel 0;
BA_ "GenSigStartValue" SG_ 952 FourDRadarObjSts14ObjYAccRel 356;
BA_ "GenSigSendType" SG_ 952 FourDRadarObjSts14ObstacleProbability 0;
BA_ "GenSigSendType" SG_ 952 FourDRadarObjSts14ProbabilityOfExistence 0;
BA_ "GenSigSendType" SG_ 952 FourDRadarObjSts14RCS 0;
BA_ "GenSigStartValue" SG_ 952 FourDRadarObjSts14RCS 1000;
BA_ "GenSigSendType" SG_ 952 FourDRadarObjSts14TargetClassificationConfidence 0;
BA_ "GenSigSendType" SG_ 952 FourDRadarObjSts14UpdateFlag 0;
BA_ "GenSigSendType" SG_ 952 FourDRadarObjSts14VabsX 0;
BA_ "GenSigStartValue" SG_ 952 FourDRadarObjSts14VabsX 1024;
BA_ "GenSigSendType" SG_ 952 FourDRadarObjSts14VabsXStd 0;
BA_ "GenSigSendType" SG_ 952 FourDRadarObjSts14VabsY 0;
BA_ "GenSigStartValue" SG_ 952 FourDRadarObjSts14VabsY 1024;
BA_ "GenSigSendType" SG_ 952 FourDRadarObjSts14VabsYStd 0;
BA_ "GenSigSendType" SG_ 952 FourDRadarObjSts14ValidFlag 0;
BA_ "GenSigDataID" SG_ 954 FourDRadarObjSts16Chks "0xE12";
BA_ "GenSigFuncType" SG_ 954 FourDRadarObjSts16Chks 15;
BA_ "GenSigSendType" SG_ 954 FourDRadarObjSts16Chks 0;
BA_ "GenSigSendType" SG_ 954 FourDRadarObjSts16Classification 0;
BA_ "GenSigFuncType" SG_ 954 FourDRadarObjSts16Cntr 16;
BA_ "GenSigSendType" SG_ 954 FourDRadarObjSts16Cntr 0;
BA_ "GenSigSendType" SG_ 954 FourDRadarObjSts16DistX 0;
BA_ "GenSigStartValue" SG_ 954 FourDRadarObjSts16DistX 32768;
BA_ "GenSigSendType" SG_ 954 FourDRadarObjSts16DistXStd 0;
BA_ "GenSigSendType" SG_ 954 FourDRadarObjSts16DistY 0;
BA_ "GenSigStartValue" SG_ 954 FourDRadarObjSts16DistY 4096;
BA_ "GenSigSendType" SG_ 954 FourDRadarObjSts16DistYStd 0;
BA_ "GenSigSendType" SG_ 954 FourDRadarObjSts16DistZ 0;
BA_ "GenSigStartValue" SG_ 954 FourDRadarObjSts16DistZ 4096;
BA_ "GenSigSendType" SG_ 954 FourDRadarObjSts16DistZStd 0;
BA_ "GenSigSendType" SG_ 954 FourDRadarObjSts16DynamicProperty 0;
BA_ "GenSigSendType" SG_ 954 FourDRadarObjSts16HeadingAngle 0;
BA_ "GenSigStartValue" SG_ 954 FourDRadarObjSts16HeadingAngle 2047.78157;
BA_ "GenSigSendType" SG_ 954 FourDRadarObjSts16ID 0;
BA_ "GenSigSendType" SG_ 954 FourDRadarObjSts16LifeCycles 0;
BA_ "GenSigSendType" SG_ 954 FourDRadarObjSts16ObjBoundingBoxHeight 0;
BA_ "GenSigSendType" SG_ 954 FourDRadarObjSts16ObjBoundingBoxLength 0;
BA_ "GenSigSendType" SG_ 954 FourDRadarObjSts16ObjBoundingBoxWidth 0;
BA_ "GenSigSendType" SG_ 954 FourDRadarObjSts16ObjNearestPtX 0;
BA_ "GenSigStartValue" SG_ 954 FourDRadarObjSts16ObjNearestPtX 32768;
BA_ "GenSigSendType" SG_ 954 FourDRadarObjSts16ObjNearestPtY 0;
BA_ "GenSigStartValue" SG_ 954 FourDRadarObjSts16ObjNearestPtY 4096;
BA_ "GenSigSendType" SG_ 954 FourDRadarObjSts16ObjNearestPtZ 0;
BA_ "GenSigStartValue" SG_ 954 FourDRadarObjSts16ObjNearestPtZ 4096;
BA_ "GenSigSendType" SG_ 954 FourDRadarObjSts16ObjSNR 0;
BA_ "GenSigSendType" SG_ 954 FourDRadarObjSts16ObjXAccRel 0;
BA_ "GenSigStartValue" SG_ 954 FourDRadarObjSts16ObjXAccRel 356;
BA_ "GenSigSendType" SG_ 954 FourDRadarObjSts16ObjYAccRel 0;
BA_ "GenSigStartValue" SG_ 954 FourDRadarObjSts16ObjYAccRel 356;
BA_ "GenSigSendType" SG_ 954 FourDRadarObjSts16ObstacleProbability 0;
BA_ "GenSigSendType" SG_ 954 FourDRadarObjSts16ProbabilityOfExistence 0;
BA_ "GenSigSendType" SG_ 954 FourDRadarObjSts16RCS 0;
BA_ "GenSigStartValue" SG_ 954 FourDRadarObjSts16RCS 1000;
BA_ "GenSigSendType" SG_ 954 FourDRadarObjSts16TargetClassificationConfidence 0;
BA_ "GenSigSendType" SG_ 954 FourDRadarObjSts16UpdateFlag 0;
BA_ "GenSigSendType" SG_ 954 FourDRadarObjSts16VabsX 0;
BA_ "GenSigStartValue" SG_ 954 FourDRadarObjSts16VabsX 1024;
BA_ "GenSigSendType" SG_ 954 FourDRadarObjSts16VabsXStd 0;
BA_ "GenSigSendType" SG_ 954 FourDRadarObjSts16VabsY 0;
BA_ "GenSigStartValue" SG_ 954 FourDRadarObjSts16VabsY 1024;
BA_ "GenSigSendType" SG_ 954 FourDRadarObjSts16VabsYStd 0;
BA_ "GenSigSendType" SG_ 954 FourDRadarObjSts16ValidFlag 0;
BA_ "GenSigDataID" SG_ 953 FourDRadarObjSts18Chks "0xE14";
BA_ "GenSigFuncType" SG_ 953 FourDRadarObjSts18Chks 15;
BA_ "GenSigSendType" SG_ 953 FourDRadarObjSts18Chks 0;
BA_ "GenSigSendType" SG_ 953 FourDRadarObjSts18Classification 0;
BA_ "GenSigFuncType" SG_ 953 FourDRadarObjSts18Cntr 16;
BA_ "GenSigSendType" SG_ 953 FourDRadarObjSts18Cntr 0;
BA_ "GenSigSendType" SG_ 953 FourDRadarObjSts18DistX 0;
BA_ "GenSigStartValue" SG_ 953 FourDRadarObjSts18DistX 32768;
BA_ "GenSigSendType" SG_ 953 FourDRadarObjSts18DistXStd 0;
BA_ "GenSigSendType" SG_ 953 FourDRadarObjSts18DistY 0;
BA_ "GenSigStartValue" SG_ 953 FourDRadarObjSts18DistY 4096;
BA_ "GenSigSendType" SG_ 953 FourDRadarObjSts18DistYStd 0;
BA_ "GenSigSendType" SG_ 953 FourDRadarObjSts18DistZ 0;
BA_ "GenSigStartValue" SG_ 953 FourDRadarObjSts18DistZ 4096;
BA_ "GenSigSendType" SG_ 953 FourDRadarObjSts18DistZStd 0;
BA_ "GenSigSendType" SG_ 953 FourDRadarObjSts18DynamicProperty 0;
BA_ "GenSigSendType" SG_ 953 FourDRadarObjSts18HeadingAngle 0;
BA_ "GenSigStartValue" SG_ 953 FourDRadarObjSts18HeadingAngle 2047.78157;
BA_ "GenSigSendType" SG_ 953 FourDRadarObjSts18ID 0;
BA_ "GenSigSendType" SG_ 953 FourDRadarObjSts18LifeCycles 0;
BA_ "GenSigSendType" SG_ 953 FourDRadarObjSts18ObjBoundingBoxHeight 0;
BA_ "GenSigSendType" SG_ 953 FourDRadarObjSts18ObjBoundingBoxLength 0;
BA_ "GenSigSendType" SG_ 953 FourDRadarObjSts18ObjBoundingBoxWidth 0;
BA_ "GenSigSendType" SG_ 953 FourDRadarObjSts18ObjNearestPtX 0;
BA_ "GenSigStartValue" SG_ 953 FourDRadarObjSts18ObjNearestPtX 32768;
BA_ "GenSigSendType" SG_ 953 FourDRadarObjSts18ObjNearestPtY 0;
BA_ "GenSigStartValue" SG_ 953 FourDRadarObjSts18ObjNearestPtY 4096;
BA_ "GenSigSendType" SG_ 953 FourDRadarObjSts18ObjNearestPtZ 0;
BA_ "GenSigStartValue" SG_ 953 FourDRadarObjSts18ObjNearestPtZ 4096;
BA_ "GenSigSendType" SG_ 953 FourDRadarObjSts18ObjSNR 0;
BA_ "GenSigSendType" SG_ 953 FourDRadarObjSts18ObjXAccRel 0;
BA_ "GenSigStartValue" SG_ 953 FourDRadarObjSts18ObjXAccRel 356;
BA_ "GenSigSendType" SG_ 953 FourDRadarObjSts18ObjYAccRel 0;
BA_ "GenSigStartValue" SG_ 953 FourDRadarObjSts18ObjYAccRel 356;
BA_ "GenSigSendType" SG_ 953 FourDRadarObjSts18ObstacleProbability 0;
BA_ "GenSigSendType" SG_ 953 FourDRadarObjSts18ProbabilityOfExistence 0;
BA_ "GenSigSendType" SG_ 953 FourDRadarObjSts18RCS 0;
BA_ "GenSigStartValue" SG_ 953 FourDRadarObjSts18RCS 1000;
BA_ "GenSigSendType" SG_ 953 FourDRadarObjSts18TargetClassificationConfidence 0;
BA_ "GenSigSendType" SG_ 953 FourDRadarObjSts18UpdateFlag 0;
BA_ "GenSigSendType" SG_ 953 FourDRadarObjSts18VabsX 0;
BA_ "GenSigStartValue" SG_ 953 FourDRadarObjSts18VabsX 1024;
BA_ "GenSigSendType" SG_ 953 FourDRadarObjSts18VabsXStd 0;
BA_ "GenSigSendType" SG_ 953 FourDRadarObjSts18VabsY 0;
BA_ "GenSigStartValue" SG_ 953 FourDRadarObjSts18VabsY 1024;
BA_ "GenSigSendType" SG_ 953 FourDRadarObjSts18VabsYStd 0;
BA_ "GenSigSendType" SG_ 953 FourDRadarObjSts18ValidFlag 0;
BA_ "GenSigDataID" SG_ 963 FourDRadarObjSts20Chks "0xE16";
BA_ "GenSigFuncType" SG_ 963 FourDRadarObjSts20Chks 15;
BA_ "GenSigSendType" SG_ 963 FourDRadarObjSts20Chks 0;
BA_ "GenSigSendType" SG_ 963 FourDRadarObjSts20Classification 0;
BA_ "GenSigFuncType" SG_ 963 FourDRadarObjSts20Cntr 16;
BA_ "GenSigSendType" SG_ 963 FourDRadarObjSts20Cntr 0;
BA_ "GenSigSendType" SG_ 963 FourDRadarObjSts20DistX 0;
BA_ "GenSigStartValue" SG_ 963 FourDRadarObjSts20DistX 32768;
BA_ "GenSigSendType" SG_ 963 FourDRadarObjSts20DistXStd 0;
BA_ "GenSigSendType" SG_ 963 FourDRadarObjSts20DistY 0;
BA_ "GenSigStartValue" SG_ 963 FourDRadarObjSts20DistY 4096;
BA_ "GenSigSendType" SG_ 963 FourDRadarObjSts20DistYStd 0;
BA_ "GenSigSendType" SG_ 963 FourDRadarObjSts20DistZ 0;
BA_ "GenSigStartValue" SG_ 963 FourDRadarObjSts20DistZ 4096;
BA_ "GenSigSendType" SG_ 963 FourDRadarObjSts20DistZStd 0;
BA_ "GenSigSendType" SG_ 963 FourDRadarObjSts20DynamicProperty 0;
BA_ "GenSigSendType" SG_ 963 FourDRadarObjSts20HeadingAngle 0;
BA_ "GenSigStartValue" SG_ 963 FourDRadarObjSts20HeadingAngle 2047.78157;
BA_ "GenSigSendType" SG_ 963 FourDRadarObjSts20ID 0;
BA_ "GenSigSendType" SG_ 963 FourDRadarObjSts20LifeCycles 0;
BA_ "GenSigSendType" SG_ 963 FourDRadarObjSts20ObjBoundingBoxHeight 0;
BA_ "GenSigSendType" SG_ 963 FourDRadarObjSts20ObjBoundingBoxLength 0;
BA_ "GenSigSendType" SG_ 963 FourDRadarObjSts20ObjBoundingBoxWidth 0;
BA_ "GenSigSendType" SG_ 963 FourDRadarObjSts20ObjNearestPtX 0;
BA_ "GenSigStartValue" SG_ 963 FourDRadarObjSts20ObjNearestPtX 32768;
BA_ "GenSigSendType" SG_ 963 FourDRadarObjSts20ObjNearestPtY 0;
BA_ "GenSigStartValue" SG_ 963 FourDRadarObjSts20ObjNearestPtY 4096;
BA_ "GenSigSendType" SG_ 963 FourDRadarObjSts20ObjNearestPtZ 0;
BA_ "GenSigStartValue" SG_ 963 FourDRadarObjSts20ObjNearestPtZ 4096;
BA_ "GenSigSendType" SG_ 963 FourDRadarObjSts20ObjSNR 0;
BA_ "GenSigSendType" SG_ 963 FourDRadarObjSts20ObjXAccRel 0;
BA_ "GenSigStartValue" SG_ 963 FourDRadarObjSts20ObjXAccRel 356;
BA_ "GenSigSendType" SG_ 963 FourDRadarObjSts20ObjYAccRel 0;
BA_ "GenSigStartValue" SG_ 963 FourDRadarObjSts20ObjYAccRel 356;
BA_ "GenSigSendType" SG_ 963 FourDRadarObjSts20ObstacleProbability 0;
BA_ "GenSigSendType" SG_ 963 FourDRadarObjSts20ProbabilityOfExistence 0;
BA_ "GenSigSendType" SG_ 963 FourDRadarObjSts20RCS 0;
BA_ "GenSigStartValue" SG_ 963 FourDRadarObjSts20RCS 1000;
BA_ "GenSigSendType" SG_ 963 FourDRadarObjSts20TargetClassificationConfidence 0;
BA_ "GenSigSendType" SG_ 963 FourDRadarObjSts20UpdateFlag 0;
BA_ "GenSigSendType" SG_ 963 FourDRadarObjSts20VabsX 0;
BA_ "GenSigStartValue" SG_ 963 FourDRadarObjSts20VabsX 1024;
BA_ "GenSigSendType" SG_ 963 FourDRadarObjSts20VabsXStd 0;
BA_ "GenSigSendType" SG_ 963 FourDRadarObjSts20VabsY 0;
BA_ "GenSigStartValue" SG_ 963 FourDRadarObjSts20VabsY 1024;
BA_ "GenSigSendType" SG_ 963 FourDRadarObjSts20VabsYStd 0;
BA_ "GenSigSendType" SG_ 963 FourDRadarObjSts20ValidFlag 0;
BA_ "GenSigDataID" SG_ 973 FourDRadarObjSts22Chks "0xE18";
BA_ "GenSigFuncType" SG_ 973 FourDRadarObjSts22Chks 15;
BA_ "GenSigSendType" SG_ 973 FourDRadarObjSts22Chks 0;
BA_ "GenSigSendType" SG_ 973 FourDRadarObjSts22Classification 0;
BA_ "GenSigFuncType" SG_ 973 FourDRadarObjSts22Cntr 16;
BA_ "GenSigSendType" SG_ 973 FourDRadarObjSts22Cntr 0;
BA_ "GenSigSendType" SG_ 973 FourDRadarObjSts22DistX 0;
BA_ "GenSigStartValue" SG_ 973 FourDRadarObjSts22DistX 32768;
BA_ "GenSigSendType" SG_ 973 FourDRadarObjSts22DistXStd 0;
BA_ "GenSigSendType" SG_ 973 FourDRadarObjSts22DistY 0;
BA_ "GenSigStartValue" SG_ 973 FourDRadarObjSts22DistY 4096;
BA_ "GenSigSendType" SG_ 973 FourDRadarObjSts22DistYStd 0;
BA_ "GenSigSendType" SG_ 973 FourDRadarObjSts22DistZ 0;
BA_ "GenSigStartValue" SG_ 973 FourDRadarObjSts22DistZ 4096;
BA_ "GenSigSendType" SG_ 973 FourDRadarObjSts22DistZStd 0;
BA_ "GenSigSendType" SG_ 973 FourDRadarObjSts22DynamicProperty 0;
BA_ "GenSigSendType" SG_ 973 FourDRadarObjSts22HeadingAngle 0;
BA_ "GenSigStartValue" SG_ 973 FourDRadarObjSts22HeadingAngle 2047.78157;
BA_ "GenSigSendType" SG_ 973 FourDRadarObjSts22ID 0;
BA_ "GenSigSendType" SG_ 973 FourDRadarObjSts22LifeCycles 0;
BA_ "GenSigSendType" SG_ 973 FourDRadarObjSts22ObjBoundingBoxHeight 0;
BA_ "GenSigSendType" SG_ 973 FourDRadarObjSts22ObjBoundingBoxLength 0;
BA_ "GenSigSendType" SG_ 973 FourDRadarObjSts22ObjBoundingBoxWidth 0;
BA_ "GenSigSendType" SG_ 973 FourDRadarObjSts22ObjNearestPtX 0;
BA_ "GenSigStartValue" SG_ 973 FourDRadarObjSts22ObjNearestPtX 32768;
BA_ "GenSigSendType" SG_ 973 FourDRadarObjSts22ObjNearestPtY 0;
BA_ "GenSigStartValue" SG_ 973 FourDRadarObjSts22ObjNearestPtY 4096;
BA_ "GenSigSendType" SG_ 973 FourDRadarObjSts22ObjNearestPtZ 0;
BA_ "GenSigStartValue" SG_ 973 FourDRadarObjSts22ObjNearestPtZ 4096;
BA_ "GenSigSendType" SG_ 973 FourDRadarObjSts22ObjSNR 0;
BA_ "GenSigSendType" SG_ 973 FourDRadarObjSts22ObjXAccRel 0;
BA_ "GenSigStartValue" SG_ 973 FourDRadarObjSts22ObjXAccRel 356;
BA_ "GenSigSendType" SG_ 973 FourDRadarObjSts22ObjYAccRel 0;
BA_ "GenSigStartValue" SG_ 973 FourDRadarObjSts22ObjYAccRel 356;
BA_ "GenSigSendType" SG_ 973 FourDRadarObjSts22ObstacleProbability 0;
BA_ "GenSigSendType" SG_ 973 FourDRadarObjSts22ProbabilityOfExistence 0;
BA_ "GenSigSendType" SG_ 973 FourDRadarObjSts22RCS 0;
BA_ "GenSigStartValue" SG_ 973 FourDRadarObjSts22RCS 1000;
BA_ "GenSigSendType" SG_ 973 FourDRadarObjSts22TargetClassificationConfidence 0;
BA_ "GenSigSendType" SG_ 973 FourDRadarObjSts22UpdateFlag 0;
BA_ "GenSigSendType" SG_ 973 FourDRadarObjSts22VabsX 0;
BA_ "GenSigStartValue" SG_ 973 FourDRadarObjSts22VabsX 1024;
BA_ "GenSigSendType" SG_ 973 FourDRadarObjSts22VabsXStd 0;
BA_ "GenSigSendType" SG_ 973 FourDRadarObjSts22VabsY 0;
BA_ "GenSigStartValue" SG_ 973 FourDRadarObjSts22VabsY 1024;
BA_ "GenSigSendType" SG_ 973 FourDRadarObjSts22VabsYStd 0;
BA_ "GenSigSendType" SG_ 973 FourDRadarObjSts22ValidFlag 0;
BA_ "GenSigDataID" SG_ 983 FourDRadarObjSts24Chks "0xE1A";
BA_ "GenSigFuncType" SG_ 983 FourDRadarObjSts24Chks 15;
BA_ "GenSigSendType" SG_ 983 FourDRadarObjSts24Chks 0;
BA_ "GenSigSendType" SG_ 983 FourDRadarObjSts24Classification 0;
BA_ "GenSigFuncType" SG_ 983 FourDRadarObjSts24Cntr 16;
BA_ "GenSigSendType" SG_ 983 FourDRadarObjSts24Cntr 0;
BA_ "GenSigSendType" SG_ 983 FourDRadarObjSts24DistX 0;
BA_ "GenSigStartValue" SG_ 983 FourDRadarObjSts24DistX 32768;
BA_ "GenSigSendType" SG_ 983 FourDRadarObjSts24DistXStd 0;
BA_ "GenSigSendType" SG_ 983 FourDRadarObjSts24DistY 0;
BA_ "GenSigStartValue" SG_ 983 FourDRadarObjSts24DistY 4096;
BA_ "GenSigSendType" SG_ 983 FourDRadarObjSts24DistYStd 0;
BA_ "GenSigSendType" SG_ 983 FourDRadarObjSts24DistZ 0;
BA_ "GenSigStartValue" SG_ 983 FourDRadarObjSts24DistZ 4096;
BA_ "GenSigSendType" SG_ 983 FourDRadarObjSts24DistZStd 0;
BA_ "GenSigSendType" SG_ 983 FourDRadarObjSts24DynamicProperty 0;
BA_ "GenSigSendType" SG_ 983 FourDRadarObjSts24HeadingAngle 0;
BA_ "GenSigStartValue" SG_ 983 FourDRadarObjSts24HeadingAngle 2047.78157;
BA_ "GenSigSendType" SG_ 983 FourDRadarObjSts24ID 0;
BA_ "GenSigSendType" SG_ 983 FourDRadarObjSts24LifeCycles 0;
BA_ "GenSigSendType" SG_ 983 FourDRadarObjSts24ObjBoundingBoxHeight 0;
BA_ "GenSigSendType" SG_ 983 FourDRadarObjSts24ObjBoundingBoxLength 0;
BA_ "GenSigSendType" SG_ 983 FourDRadarObjSts24ObjBoundingBoxWidth 0;
BA_ "GenSigSendType" SG_ 983 FourDRadarObjSts24ObjNearestPtX 0;
BA_ "GenSigStartValue" SG_ 983 FourDRadarObjSts24ObjNearestPtX 32768;
BA_ "GenSigSendType" SG_ 983 FourDRadarObjSts24ObjNearestPtY 0;
BA_ "GenSigStartValue" SG_ 983 FourDRadarObjSts24ObjNearestPtY 4096;
BA_ "GenSigSendType" SG_ 983 FourDRadarObjSts24ObjNearestPtZ 0;
BA_ "GenSigStartValue" SG_ 983 FourDRadarObjSts24ObjNearestPtZ 4096;
BA_ "GenSigSendType" SG_ 983 FourDRadarObjSts24ObjSNR 0;
BA_ "GenSigSendType" SG_ 983 FourDRadarObjSts24ObjXAccRel 0;
BA_ "GenSigStartValue" SG_ 983 FourDRadarObjSts24ObjXAccRel 356;
BA_ "GenSigSendType" SG_ 983 FourDRadarObjSts24ObjYAccRel 0;
BA_ "GenSigStartValue" SG_ 983 FourDRadarObjSts24ObjYAccRel 356;
BA_ "GenSigSendType" SG_ 983 FourDRadarObjSts24ObstacleProbability 0;
BA_ "GenSigSendType" SG_ 983 FourDRadarObjSts24ProbabilityOfExistence 0;
BA_ "GenSigSendType" SG_ 983 FourDRadarObjSts24RCS 0;
BA_ "GenSigStartValue" SG_ 983 FourDRadarObjSts24RCS 1000;
BA_ "GenSigSendType" SG_ 983 FourDRadarObjSts24TargetClassificationConfidence 0;
BA_ "GenSigSendType" SG_ 983 FourDRadarObjSts24UpdateFlag 0;
BA_ "GenSigSendType" SG_ 983 FourDRadarObjSts24VabsX 0;
BA_ "GenSigStartValue" SG_ 983 FourDRadarObjSts24VabsX 1024;
BA_ "GenSigSendType" SG_ 983 FourDRadarObjSts24VabsXStd 0;
BA_ "GenSigSendType" SG_ 983 FourDRadarObjSts24VabsY 0;
BA_ "GenSigStartValue" SG_ 983 FourDRadarObjSts24VabsY 1024;
BA_ "GenSigSendType" SG_ 983 FourDRadarObjSts24VabsYStd 0;
BA_ "GenSigSendType" SG_ 983 FourDRadarObjSts24ValidFlag 0;
BA_ "GenSigDataID" SG_ 993 FourDRadarObjSts26Chks "0xE1C";
BA_ "GenSigFuncType" SG_ 993 FourDRadarObjSts26Chks 15;
BA_ "GenSigSendType" SG_ 993 FourDRadarObjSts26Chks 0;
BA_ "GenSigSendType" SG_ 993 FourDRadarObjSts26Classification 0;
BA_ "GenSigFuncType" SG_ 993 FourDRadarObjSts26Cntr 16;
BA_ "GenSigSendType" SG_ 993 FourDRadarObjSts26Cntr 0;
BA_ "GenSigSendType" SG_ 993 FourDRadarObjSts26DistX 0;
BA_ "GenSigStartValue" SG_ 993 FourDRadarObjSts26DistX 32768;
BA_ "GenSigSendType" SG_ 993 FourDRadarObjSts26DistXStd 0;
BA_ "GenSigSendType" SG_ 993 FourDRadarObjSts26DistY 0;
BA_ "GenSigStartValue" SG_ 993 FourDRadarObjSts26DistY 4096;
BA_ "GenSigSendType" SG_ 993 FourDRadarObjSts26DistYStd 0;
BA_ "GenSigSendType" SG_ 993 FourDRadarObjSts26DistZ 0;
BA_ "GenSigStartValue" SG_ 993 FourDRadarObjSts26DistZ 4096;
BA_ "GenSigSendType" SG_ 993 FourDRadarObjSts26DistZStd 0;
BA_ "GenSigSendType" SG_ 993 FourDRadarObjSts26DynamicProperty 0;
BA_ "GenSigSendType" SG_ 993 FourDRadarObjSts26HeadingAngle 0;
BA_ "GenSigStartValue" SG_ 993 FourDRadarObjSts26HeadingAngle 2047.78157;
BA_ "GenSigSendType" SG_ 993 FourDRadarObjSts26ID 0;
BA_ "GenSigSendType" SG_ 993 FourDRadarObjSts26LifeCycles 0;
BA_ "GenSigSendType" SG_ 993 FourDRadarObjSts26ObjBoundingBoxHeight 0;
BA_ "GenSigSendType" SG_ 993 FourDRadarObjSts26ObjBoundingBoxLength 0;
BA_ "GenSigSendType" SG_ 993 FourDRadarObjSts26ObjBoundingBoxWidth 0;
BA_ "GenSigSendType" SG_ 993 FourDRadarObjSts26ObjNearestPtX 0;
BA_ "GenSigStartValue" SG_ 993 FourDRadarObjSts26ObjNearestPtX 32768;
BA_ "GenSigSendType" SG_ 993 FourDRadarObjSts26ObjNearestPtY 0;
BA_ "GenSigStartValue" SG_ 993 FourDRadarObjSts26ObjNearestPtY 4096;
BA_ "GenSigSendType" SG_ 993 FourDRadarObjSts26ObjNearestPtZ 0;
BA_ "GenSigStartValue" SG_ 993 FourDRadarObjSts26ObjNearestPtZ 4096;
BA_ "GenSigSendType" SG_ 993 FourDRadarObjSts26ObjSNR 0;
BA_ "GenSigSendType" SG_ 993 FourDRadarObjSts26ObjXAccRel 0;
BA_ "GenSigStartValue" SG_ 993 FourDRadarObjSts26ObjXAccRel 356;
BA_ "GenSigSendType" SG_ 993 FourDRadarObjSts26ObjYAccRel 0;
BA_ "GenSigStartValue" SG_ 993 FourDRadarObjSts26ObjYAccRel 356;
BA_ "GenSigSendType" SG_ 993 FourDRadarObjSts26ObstacleProbability 0;
BA_ "GenSigSendType" SG_ 993 FourDRadarObjSts26ProbabilityOfExistence 0;
BA_ "GenSigSendType" SG_ 993 FourDRadarObjSts26RCS 0;
BA_ "GenSigStartValue" SG_ 993 FourDRadarObjSts26RCS 1000;
BA_ "GenSigSendType" SG_ 993 FourDRadarObjSts26TargetClassificationConfidence 0;
BA_ "GenSigSendType" SG_ 993 FourDRadarObjSts26UpdateFlag 0;
BA_ "GenSigSendType" SG_ 993 FourDRadarObjSts26VabsX 0;
BA_ "GenSigStartValue" SG_ 993 FourDRadarObjSts26VabsX 1024;
BA_ "GenSigSendType" SG_ 993 FourDRadarObjSts26VabsXStd 0;
BA_ "GenSigSendType" SG_ 993 FourDRadarObjSts26VabsY 0;
BA_ "GenSigStartValue" SG_ 993 FourDRadarObjSts26VabsY 1024;
BA_ "GenSigSendType" SG_ 993 FourDRadarObjSts26VabsYStd 0;
BA_ "GenSigSendType" SG_ 993 FourDRadarObjSts26ValidFlag 0;
BA_ "GenSigDataID" SG_ 898 FourDRadarObjSts35Chks "0xE25";
BA_ "GenSigFuncType" SG_ 898 FourDRadarObjSts35Chks 15;
BA_ "GenSigSendType" SG_ 898 FourDRadarObjSts35Chks 0;
BA_ "GenSigSendType" SG_ 898 FourDRadarObjSts35Classification 0;
BA_ "GenSigFuncType" SG_ 898 FourDRadarObjSts35Cntr 16;
BA_ "GenSigSendType" SG_ 898 FourDRadarObjSts35Cntr 0;
BA_ "GenSigSendType" SG_ 898 FourDRadarObjSts35DistX 0;
BA_ "GenSigStartValue" SG_ 898 FourDRadarObjSts35DistX 32768;
BA_ "GenSigSendType" SG_ 898 FourDRadarObjSts35DistXStd 0;
BA_ "GenSigSendType" SG_ 898 FourDRadarObjSts35DistY 0;
BA_ "GenSigStartValue" SG_ 898 FourDRadarObjSts35DistY 4096;
BA_ "GenSigSendType" SG_ 898 FourDRadarObjSts35DistYStd 0;
BA_ "GenSigSendType" SG_ 898 FourDRadarObjSts35DistZ 0;
BA_ "GenSigStartValue" SG_ 898 FourDRadarObjSts35DistZ 4096;
BA_ "GenSigSendType" SG_ 898 FourDRadarObjSts35DistZStd 0;
BA_ "GenSigSendType" SG_ 898 FourDRadarObjSts35DynamicProperty 0;
BA_ "GenSigSendType" SG_ 898 FourDRadarObjSts35HeadingAngle 0;
BA_ "GenSigStartValue" SG_ 898 FourDRadarObjSts35HeadingAngle 2047.78157;
BA_ "GenSigSendType" SG_ 898 FourDRadarObjSts35ID 0;
BA_ "GenSigSendType" SG_ 898 FourDRadarObjSts35LifeCycles 0;
BA_ "GenSigSendType" SG_ 898 FourDRadarObjSts35ObjBoundingBoxHeight 0;
BA_ "GenSigSendType" SG_ 898 FourDRadarObjSts35ObjBoundingBoxLength 0;
BA_ "GenSigSendType" SG_ 898 FourDRadarObjSts35ObjBoundingBoxWidth 0;
BA_ "GenSigSendType" SG_ 898 FourDRadarObjSts35ObjNearestPtX 0;
BA_ "GenSigStartValue" SG_ 898 FourDRadarObjSts35ObjNearestPtX 32768;
BA_ "GenSigSendType" SG_ 898 FourDRadarObjSts35ObjNearestPtY 0;
BA_ "GenSigStartValue" SG_ 898 FourDRadarObjSts35ObjNearestPtY 4096;
BA_ "GenSigSendType" SG_ 898 FourDRadarObjSts35ObjNearestPtZ 0;
BA_ "GenSigStartValue" SG_ 898 FourDRadarObjSts35ObjNearestPtZ 4096;
BA_ "GenSigSendType" SG_ 898 FourDRadarObjSts35ObjSNR 0;
BA_ "GenSigSendType" SG_ 898 FourDRadarObjSts35ObjXAccRel 0;
BA_ "GenSigStartValue" SG_ 898 FourDRadarObjSts35ObjXAccRel 356;
BA_ "GenSigSendType" SG_ 898 FourDRadarObjSts35ObjYAccRel 0;
BA_ "GenSigStartValue" SG_ 898 FourDRadarObjSts35ObjYAccRel 356;
BA_ "GenSigSendType" SG_ 898 FourDRadarObjSts35ObstacleProbability 0;
BA_ "GenSigSendType" SG_ 898 FourDRadarObjSts35ProbabilityOfExistence 0;
BA_ "GenSigSendType" SG_ 898 FourDRadarObjSts35RCS 0;
BA_ "GenSigStartValue" SG_ 898 FourDRadarObjSts35RCS 1000;
BA_ "GenSigSendType" SG_ 898 FourDRadarObjSts35TargetClassificationConfidence 0;
BA_ "GenSigSendType" SG_ 898 FourDRadarObjSts35UpdateFlag 0;
BA_ "GenSigSendType" SG_ 898 FourDRadarObjSts35VabsX 0;
BA_ "GenSigStartValue" SG_ 898 FourDRadarObjSts35VabsX 1024;
BA_ "GenSigSendType" SG_ 898 FourDRadarObjSts35VabsXStd 0;
BA_ "GenSigSendType" SG_ 898 FourDRadarObjSts35VabsY 0;
BA_ "GenSigStartValue" SG_ 898 FourDRadarObjSts35VabsY 1024;
BA_ "GenSigSendType" SG_ 898 FourDRadarObjSts35VabsYStd 0;
BA_ "GenSigSendType" SG_ 898 FourDRadarObjSts35ValidFlag 0;
BA_ "GenSigDataID" SG_ 899 FourDRadarObjSts37Chks "0xE27";
BA_ "GenSigFuncType" SG_ 899 FourDRadarObjSts37Chks 15;
BA_ "GenSigSendType" SG_ 899 FourDRadarObjSts37Chks 0;
BA_ "GenSigSendType" SG_ 899 FourDRadarObjSts37Classification 0;
BA_ "GenSigFuncType" SG_ 899 FourDRadarObjSts37Cntr 16;
BA_ "GenSigSendType" SG_ 899 FourDRadarObjSts37Cntr 0;
BA_ "GenSigSendType" SG_ 899 FourDRadarObjSts37DistX 0;
BA_ "GenSigStartValue" SG_ 899 FourDRadarObjSts37DistX 32768;
BA_ "GenSigSendType" SG_ 899 FourDRadarObjSts37DistXStd 0;
BA_ "GenSigSendType" SG_ 899 FourDRadarObjSts37DistY 0;
BA_ "GenSigStartValue" SG_ 899 FourDRadarObjSts37DistY 4096;
BA_ "GenSigSendType" SG_ 899 FourDRadarObjSts37DistYStd 0;
BA_ "GenSigSendType" SG_ 899 FourDRadarObjSts37DistZ 0;
BA_ "GenSigStartValue" SG_ 899 FourDRadarObjSts37DistZ 4096;
BA_ "GenSigSendType" SG_ 899 FourDRadarObjSts37DistZStd 0;
BA_ "GenSigSendType" SG_ 899 FourDRadarObjSts37DynamicProperty 0;
BA_ "GenSigSendType" SG_ 899 FourDRadarObjSts37HeadingAngle 0;
BA_ "GenSigStartValue" SG_ 899 FourDRadarObjSts37HeadingAngle 2047.78157;
BA_ "GenSigSendType" SG_ 899 FourDRadarObjSts37ID 0;
BA_ "GenSigSendType" SG_ 899 FourDRadarObjSts37LifeCycles 0;
BA_ "GenSigSendType" SG_ 899 FourDRadarObjSts37ObjBoundingBoxHeight 0;
BA_ "GenSigSendType" SG_ 899 FourDRadarObjSts37ObjBoundingBoxLength 0;
BA_ "GenSigSendType" SG_ 899 FourDRadarObjSts37ObjBoundingBoxWidth 0;
BA_ "GenSigSendType" SG_ 899 FourDRadarObjSts37ObjNearestPtX 0;
BA_ "GenSigStartValue" SG_ 899 FourDRadarObjSts37ObjNearestPtX 32768;
BA_ "GenSigSendType" SG_ 899 FourDRadarObjSts37ObjNearestPtY 0;
BA_ "GenSigStartValue" SG_ 899 FourDRadarObjSts37ObjNearestPtY 4096;
BA_ "GenSigSendType" SG_ 899 FourDRadarObjSts37ObjNearestPtZ 0;
BA_ "GenSigStartValue" SG_ 899 FourDRadarObjSts37ObjNearestPtZ 4096;
BA_ "GenSigSendType" SG_ 899 FourDRadarObjSts37ObjSNR 0;
BA_ "GenSigSendType" SG_ 899 FourDRadarObjSts37ObjXAccRel 0;
BA_ "GenSigStartValue" SG_ 899 FourDRadarObjSts37ObjXAccRel 356;
BA_ "GenSigSendType" SG_ 899 FourDRadarObjSts37ObjYAccRel 0;
BA_ "GenSigStartValue" SG_ 899 FourDRadarObjSts37ObjYAccRel 356;
BA_ "GenSigSendType" SG_ 899 FourDRadarObjSts37ObstacleProbability 0;
BA_ "GenSigSendType" SG_ 899 FourDRadarObjSts37ProbabilityOfExistence 0;
BA_ "GenSigSendType" SG_ 899 FourDRadarObjSts37RCS 0;
BA_ "GenSigStartValue" SG_ 899 FourDRadarObjSts37RCS 1000;
BA_ "GenSigSendType" SG_ 899 FourDRadarObjSts37TargetClassificationConfidence 0;
BA_ "GenSigSendType" SG_ 899 FourDRadarObjSts37UpdateFlag 0;
BA_ "GenSigSendType" SG_ 899 FourDRadarObjSts37VabsX 0;
BA_ "GenSigStartValue" SG_ 899 FourDRadarObjSts37VabsX 1024;
BA_ "GenSigSendType" SG_ 899 FourDRadarObjSts37VabsXStd 0;
BA_ "GenSigSendType" SG_ 899 FourDRadarObjSts37VabsY 0;
BA_ "GenSigStartValue" SG_ 899 FourDRadarObjSts37VabsY 1024;
BA_ "GenSigSendType" SG_ 899 FourDRadarObjSts37VabsYStd 0;
BA_ "GenSigSendType" SG_ 899 FourDRadarObjSts37ValidFlag 0;
BA_ "GenSigDataID" SG_ 900 FourDRadarObjSts39Chks "0xE29";
BA_ "GenSigFuncType" SG_ 900 FourDRadarObjSts39Chks 15;
BA_ "GenSigSendType" SG_ 900 FourDRadarObjSts39Chks 0;
BA_ "GenSigSendType" SG_ 900 FourDRadarObjSts39Classification 0;
BA_ "GenSigFuncType" SG_ 900 FourDRadarObjSts39Cntr 16;
BA_ "GenSigSendType" SG_ 900 FourDRadarObjSts39Cntr 0;
BA_ "GenSigSendType" SG_ 900 FourDRadarObjSts39DistX 0;
BA_ "GenSigStartValue" SG_ 900 FourDRadarObjSts39DistX 32768;
BA_ "GenSigSendType" SG_ 900 FourDRadarObjSts39DistXStd 0;
BA_ "GenSigSendType" SG_ 900 FourDRadarObjSts39DistY 0;
BA_ "GenSigStartValue" SG_ 900 FourDRadarObjSts39DistY 4096;
BA_ "GenSigSendType" SG_ 900 FourDRadarObjSts39DistYStd 0;
BA_ "GenSigSendType" SG_ 900 FourDRadarObjSts39DistZ 0;
BA_ "GenSigStartValue" SG_ 900 FourDRadarObjSts39DistZ 4096;
BA_ "GenSigSendType" SG_ 900 FourDRadarObjSts39DistZStd 0;
BA_ "GenSigSendType" SG_ 900 FourDRadarObjSts39DynamicProperty 0;
BA_ "GenSigSendType" SG_ 900 FourDRadarObjSts39HeadingAngle 0;
BA_ "GenSigStartValue" SG_ 900 FourDRadarObjSts39HeadingAngle 2047.78157;
BA_ "GenSigSendType" SG_ 900 FourDRadarObjSts39ID 0;
BA_ "GenSigSendType" SG_ 900 FourDRadarObjSts39LifeCycles 0;
BA_ "GenSigSendType" SG_ 900 FourDRadarObjSts39ObjBoundingBoxHeight 0;
BA_ "GenSigSendType" SG_ 900 FourDRadarObjSts39ObjBoundingBoxLength 0;
BA_ "GenSigSendType" SG_ 900 FourDRadarObjSts39ObjBoundingBoxWidth 0;
BA_ "GenSigSendType" SG_ 900 FourDRadarObjSts39ObjNearestPtX 0;
BA_ "GenSigStartValue" SG_ 900 FourDRadarObjSts39ObjNearestPtX 32768;
BA_ "GenSigSendType" SG_ 900 FourDRadarObjSts39ObjNearestPtY 0;
BA_ "GenSigStartValue" SG_ 900 FourDRadarObjSts39ObjNearestPtY 4096;
BA_ "GenSigSendType" SG_ 900 FourDRadarObjSts39ObjNearestPtZ 0;
BA_ "GenSigStartValue" SG_ 900 FourDRadarObjSts39ObjNearestPtZ 4096;
BA_ "GenSigSendType" SG_ 900 FourDRadarObjSts39ObjSNR 0;
BA_ "GenSigSendType" SG_ 900 FourDRadarObjSts39ObjXAccRel 0;
BA_ "GenSigStartValue" SG_ 900 FourDRadarObjSts39ObjXAccRel 356;
BA_ "GenSigSendType" SG_ 900 FourDRadarObjSts39ObjYAccRel 0;
BA_ "GenSigStartValue" SG_ 900 FourDRadarObjSts39ObjYAccRel 356;
BA_ "GenSigSendType" SG_ 900 FourDRadarObjSts39ObstacleProbability 0;
BA_ "GenSigSendType" SG_ 900 FourDRadarObjSts39ProbabilityOfExistence 0;
BA_ "GenSigSendType" SG_ 900 FourDRadarObjSts39RCS 0;
BA_ "GenSigStartValue" SG_ 900 FourDRadarObjSts39RCS 1000;
BA_ "GenSigSendType" SG_ 900 FourDRadarObjSts39TargetClassificationConfidence 0;
BA_ "GenSigSendType" SG_ 900 FourDRadarObjSts39UpdateFlag 0;
BA_ "GenSigSendType" SG_ 900 FourDRadarObjSts39VabsX 0;
BA_ "GenSigStartValue" SG_ 900 FourDRadarObjSts39VabsX 1024;
BA_ "GenSigSendType" SG_ 900 FourDRadarObjSts39VabsXStd 0;
BA_ "GenSigSendType" SG_ 900 FourDRadarObjSts39VabsY 0;
BA_ "GenSigStartValue" SG_ 900 FourDRadarObjSts39VabsY 1024;
BA_ "GenSigSendType" SG_ 900 FourDRadarObjSts39VabsYStd 0;
BA_ "GenSigSendType" SG_ 900 FourDRadarObjSts39ValidFlag 0;
BA_ "GenSigDataID" SG_ 901 FourDRadarObjSts41Chks "0xE2B";
BA_ "GenSigFuncType" SG_ 901 FourDRadarObjSts41Chks 15;
BA_ "GenSigSendType" SG_ 901 FourDRadarObjSts41Chks 0;
BA_ "GenSigSendType" SG_ 901 FourDRadarObjSts41Classification 0;
BA_ "GenSigFuncType" SG_ 901 FourDRadarObjSts41Cntr 16;
BA_ "GenSigSendType" SG_ 901 FourDRadarObjSts41Cntr 0;
BA_ "GenSigSendType" SG_ 901 FourDRadarObjSts41DistX 0;
BA_ "GenSigStartValue" SG_ 901 FourDRadarObjSts41DistX 32768;
BA_ "GenSigSendType" SG_ 901 FourDRadarObjSts41DistXStd 0;
BA_ "GenSigSendType" SG_ 901 FourDRadarObjSts41DistY 0;
BA_ "GenSigStartValue" SG_ 901 FourDRadarObjSts41DistY 4096;
BA_ "GenSigSendType" SG_ 901 FourDRadarObjSts41DistYStd 0;
BA_ "GenSigSendType" SG_ 901 FourDRadarObjSts41DistZ 0;
BA_ "GenSigStartValue" SG_ 901 FourDRadarObjSts41DistZ 4096;
BA_ "GenSigSendType" SG_ 901 FourDRadarObjSts41DistZStd 0;
BA_ "GenSigSendType" SG_ 901 FourDRadarObjSts41DynamicProperty 0;
BA_ "GenSigSendType" SG_ 901 FourDRadarObjSts41HeadingAngle 0;
BA_ "GenSigStartValue" SG_ 901 FourDRadarObjSts41HeadingAngle 2047.78157;
BA_ "GenSigSendType" SG_ 901 FourDRadarObjSts41ID 0;
BA_ "GenSigSendType" SG_ 901 FourDRadarObjSts41LifeCycles 0;
BA_ "GenSigSendType" SG_ 901 FourDRadarObjSts41ObjBoundingBoxHeight 0;
BA_ "GenSigSendType" SG_ 901 FourDRadarObjSts41ObjBoundingBoxLength 0;
BA_ "GenSigSendType" SG_ 901 FourDRadarObjSts41ObjBoundingBoxWidth 0;
BA_ "GenSigSendType" SG_ 901 FourDRadarObjSts41ObjNearestPtX 0;
BA_ "GenSigStartValue" SG_ 901 FourDRadarObjSts41ObjNearestPtX 32768;
BA_ "GenSigSendType" SG_ 901 FourDRadarObjSts41ObjNearestPtY 0;
BA_ "GenSigStartValue" SG_ 901 FourDRadarObjSts41ObjNearestPtY 4096;
BA_ "GenSigSendType" SG_ 901 FourDRadarObjSts41ObjNearestPtZ 0;
BA_ "GenSigStartValue" SG_ 901 FourDRadarObjSts41ObjNearestPtZ 4096;
BA_ "GenSigSendType" SG_ 901 FourDRadarObjSts41ObjSNR 0;
BA_ "GenSigSendType" SG_ 901 FourDRadarObjSts41ObjXAccRel 0;
BA_ "GenSigStartValue" SG_ 901 FourDRadarObjSts41ObjXAccRel 356;
BA_ "GenSigSendType" SG_ 901 FourDRadarObjSts41ObjYAccRel 0;
BA_ "GenSigStartValue" SG_ 901 FourDRadarObjSts41ObjYAccRel 356;
BA_ "GenSigSendType" SG_ 901 FourDRadarObjSts41ObstacleProbability 0;
BA_ "GenSigSendType" SG_ 901 FourDRadarObjSts41ProbabilityOfExistence 0;
BA_ "GenSigSendType" SG_ 901 FourDRadarObjSts41RCS 0;
BA_ "GenSigStartValue" SG_ 901 FourDRadarObjSts41RCS 1000;
BA_ "GenSigSendType" SG_ 901 FourDRadarObjSts41TargetClassificationConfidence 0;
BA_ "GenSigSendType" SG_ 901 FourDRadarObjSts41UpdateFlag 0;
BA_ "GenSigSendType" SG_ 901 FourDRadarObjSts41VabsX 0;
BA_ "GenSigStartValue" SG_ 901 FourDRadarObjSts41VabsX 1024;
BA_ "GenSigSendType" SG_ 901 FourDRadarObjSts41VabsXStd 0;
BA_ "GenSigSendType" SG_ 901 FourDRadarObjSts41VabsY 0;
BA_ "GenSigStartValue" SG_ 901 FourDRadarObjSts41VabsY 1024;
BA_ "GenSigSendType" SG_ 901 FourDRadarObjSts41VabsYStd 0;
BA_ "GenSigSendType" SG_ 901 FourDRadarObjSts41ValidFlag 0;
BA_ "GenSigDataID" SG_ 863 FrontFourDRadarObjSts01Chks "0xDFF";
BA_ "GenSigFuncType" SG_ 863 FrontFourDRadarObjSts01Chks 15;
BA_ "GenSigSendType" SG_ 863 FrontFourDRadarObjSts01Chks 0;
BA_ "GenSigSendType" SG_ 863 FrontFourDRadarObjSts01Classification 0;
BA_ "GenSigFuncType" SG_ 863 FrontFourDRadarObjSts01Cntr 16;
BA_ "GenSigSendType" SG_ 863 FrontFourDRadarObjSts01Cntr 0;
BA_ "GenSigSendType" SG_ 863 FrontFourDRadarObjSts01DistX 0;
BA_ "GenSigStartValue" SG_ 863 FrontFourDRadarObjSts01DistX 32768;
BA_ "GenSigSendType" SG_ 863 FrontFourDRadarObjSts01DistXStd 0;
BA_ "GenSigSendType" SG_ 863 FrontFourDRadarObjSts01DistY 0;
BA_ "GenSigStartValue" SG_ 863 FrontFourDRadarObjSts01DistY 4096;
BA_ "GenSigSendType" SG_ 863 FrontFourDRadarObjSts01DistYStd 0;
BA_ "GenSigSendType" SG_ 863 FrontFourDRadarObjSts01DistZ 0;
BA_ "GenSigStartValue" SG_ 863 FrontFourDRadarObjSts01DistZ 4096;
BA_ "GenSigSendType" SG_ 863 FrontFourDRadarObjSts01DistZStd 0;
BA_ "GenSigSendType" SG_ 863 FrontFourDRadarObjSts01DynamicProperty 0;
BA_ "GenSigSendType" SG_ 863 FrontFourDRadarObjSts01HeadingAngle 0;
BA_ "GenSigStartValue" SG_ 863 FrontFourDRadarObjSts01HeadingAngle 2047.78157;
BA_ "GenSigSendType" SG_ 863 FrontFourDRadarObjSts01ID 0;
BA_ "GenSigSendType" SG_ 863 FrontFourDRadarObjSts01LifeCycles 0;
BA_ "GenSigSendType" SG_ 863 FrontFourDRadarObjSts01ObjBoundingBoxHeight 0;
BA_ "GenSigSendType" SG_ 863 FrontFourDRadarObjSts01ObjBoundingBoxLength 0;
BA_ "GenSigSendType" SG_ 863 FrontFourDRadarObjSts01ObjBoundingBoxWidth 0;
BA_ "GenSigSendType" SG_ 863 FrontFourDRadarObjSts01ObjNearestPtX 0;
BA_ "GenSigStartValue" SG_ 863 FrontFourDRadarObjSts01ObjNearestPtX 32768;
BA_ "GenSigSendType" SG_ 863 FrontFourDRadarObjSts01ObjNearestPtY 0;
BA_ "GenSigStartValue" SG_ 863 FrontFourDRadarObjSts01ObjNearestPtY 4096;
BA_ "GenSigSendType" SG_ 863 FrontFourDRadarObjSts01ObjNearestPtZ 0;
BA_ "GenSigStartValue" SG_ 863 FrontFourDRadarObjSts01ObjNearestPtZ 4096;
BA_ "GenSigSendType" SG_ 863 FrontFourDRadarObjSts01ObjSNR 0;
BA_ "GenSigSendType" SG_ 863 FrontFourDRadarObjSts01ObjXAccRel 0;
BA_ "GenSigStartValue" SG_ 863 FrontFourDRadarObjSts01ObjXAccRel 356;
BA_ "GenSigSendType" SG_ 863 FrontFourDRadarObjSts01ObjYAccRel 0;
BA_ "GenSigStartValue" SG_ 863 FrontFourDRadarObjSts01ObjYAccRel 356;
BA_ "GenSigSendType" SG_ 863 FrontFourDRadarObjSts01ObstacleProbability 0;
BA_ "GenSigSendType" SG_ 863 FrontFourDRadarObjSts01ProbabilityOfExistence 0;
BA_ "GenSigSendType" SG_ 863 FrontFourDRadarObjSts01RCS 0;
BA_ "GenSigStartValue" SG_ 863 FrontFourDRadarObjSts01RCS 1000;
BA_ "GenSigSendType" SG_ 863 FrontFourDRadarObjSts01TargetClassificationConfidence 0;
BA_ "GenSigSendType" SG_ 863 FrontFourDRadarObjSts01UpdateFlag 0;
BA_ "GenSigSendType" SG_ 863 FrontFourDRadarObjSts01VabsX 0;
BA_ "GenSigStartValue" SG_ 863 FrontFourDRadarObjSts01VabsX 1024;
BA_ "GenSigSendType" SG_ 863 FrontFourDRadarObjSts01VabsXStd 0;
BA_ "GenSigSendType" SG_ 863 FrontFourDRadarObjSts01VabsY 0;
BA_ "GenSigStartValue" SG_ 863 FrontFourDRadarObjSts01VabsY 1024;
BA_ "GenSigSendType" SG_ 863 FrontFourDRadarObjSts01VabsYStd 0;
BA_ "GenSigSendType" SG_ 863 FrontFourDRadarObjSts01ValidFlag 0;
VAL_ 898 FourDRadarObjSts35Classification 0 "EClassification_Point" 1 "EClassification_Car" 2 "EClassification_Truck" 3 "EClassification_Pedestrian" 4 "EClassification_Motorcycle" 5 "EClassification_Bicycle" 6 "EClassification_Wide" 7 "EClassification_Reserved1" 8 "EClassification_Reserved2" 9 "EClassification_Reserved3" 10 "EClassification_Unclassified" 11 "EClassification_Reserved4" 12 "EClassification_Reserved5" 13 "EClassification_Reserved6" 14 "EClassification_Reserved7" 15 "EClassification_Reserved8";
VAL_ 898 FourDRadarObjSts35DynamicProperty 0 "EDynamicProperty_Moving" 1 "EDynamicProperty_Stationary" 2 "EDynamicProperty_Oncoming" 3 "EDynamicProperty_CrossingLeftToRight" 4 "EDynamicProperty_CrossingRightToLeft" 5 "EDynamicProperty_Unknown" 6 "EDynamicProperty_Stopped" 7 "EDynamicProperty_Reserved1";
VAL_ 898 FourDRadarObjSts35UpdateFlag 0 "Boolean_FALSE" 1 "Boolean_TRUE";
VAL_ 898 FourDRadarObjSts35ValidFlag 0 "Validity_NotValid" 1 "Validity_Valid";
VAL_ 899 FourDRadarObjSts37Classification 0 "EClassification_Point" 1 "EClassification_Car" 2 "EClassification_Truck" 3 "EClassification_Pedestrian" 4 "EClassification_Motorcycle" 5 "EClassification_Bicycle" 6 "EClassification_Wide" 7 "EClassification_Reserved1" 8 "EClassification_Reserved2" 9 "EClassification_Reserved3" 10 "EClassification_Unclassified" 11 "EClassification_Reserved4" 12 "EClassification_Reserved5" 13 "EClassification_Reserved6" 14 "EClassification_Reserved7" 15 "EClassification_Reserved8";
VAL_ 899 FourDRadarObjSts37DynamicProperty 0 "EDynamicProperty_Moving" 1 "EDynamicProperty_Stationary" 2 "EDynamicProperty_Oncoming" 3 "EDynamicProperty_CrossingLeftToRight" 4 "EDynamicProperty_CrossingRightToLeft" 5 "EDynamicProperty_Unknown" 6 "EDynamicProperty_Stopped" 7 "EDynamicProperty_Reserved1";
VAL_ 899 FourDRadarObjSts37UpdateFlag 0 "Boolean_FALSE" 1 "Boolean_TRUE";
VAL_ 899 FourDRadarObjSts37ValidFlag 0 "Validity_NotValid" 1 "Validity_Valid";
VAL_ 900 FourDRadarObjSts39Classification 0 "EClassification_Point" 1 "EClassification_Car" 2 "EClassification_Truck" 3 "EClassification_Pedestrian" 4 "EClassification_Motorcycle" 5 "EClassification_Bicycle" 6 "EClassification_Wide" 7 "EClassification_Reserved1" 8 "EClassification_Reserved2" 9 "EClassification_Reserved3" 10 "EClassification_Unclassified" 11 "EClassification_Reserved4" 12 "EClassification_Reserved5" 13 "EClassification_Reserved6" 14 "EClassification_Reserved7" 15 "EClassification_Reserved8";
VAL_ 900 FourDRadarObjSts39DynamicProperty 0 "EDynamicProperty_Moving" 1 "EDynamicProperty_Stationary" 2 "EDynamicProperty_Oncoming" 3 "EDynamicProperty_CrossingLeftToRight" 4 "EDynamicProperty_CrossingRightToLeft" 5 "EDynamicProperty_Unknown" 6 "EDynamicProperty_Stopped" 7 "EDynamicProperty_Reserved1";
VAL_ 900 FourDRadarObjSts39UpdateFlag 0 "Boolean_FALSE" 1 "Boolean_TRUE";
VAL_ 900 FourDRadarObjSts39ValidFlag 0 "Validity_NotValid" 1 "Validity_Valid";
VAL_ 901 FourDRadarObjSts41Classification 0 "EClassification_Point" 1 "EClassification_Car" 2 "EClassification_Truck" 3 "EClassification_Pedestrian" 4 "EClassification_Motorcycle" 5 "EClassification_Bicycle" 6 "EClassification_Wide" 7 "EClassification_Reserved1" 8 "EClassification_Reserved2" 9 "EClassification_Reserved3" 10 "EClassification_Unclassified" 11 "EClassification_Reserved4" 12 "EClassification_Reserved5" 13 "EClassification_Reserved6" 14 "EClassification_Reserved7" 15 "EClassification_Reserved8";
VAL_ 901 FourDRadarObjSts41DynamicProperty 0 "EDynamicProperty_Moving" 1 "EDynamicProperty_Stationary" 2 "EDynamicProperty_Oncoming" 3 "EDynamicProperty_CrossingLeftToRight" 4 "EDynamicProperty_CrossingRightToLeft" 5 "EDynamicProperty_Unknown" 6 "EDynamicProperty_Stopped" 7 "EDynamicProperty_Reserved1";
VAL_ 901 FourDRadarObjSts41UpdateFlag 0 "Boolean_FALSE" 1 "Boolean_TRUE";
VAL_ 901 FourDRadarObjSts41ValidFlag 0 "Validity_NotValid" 1 "Validity_Valid";
VAL_ 863 FrontFourDRadarObjSts01Classification 0 "EClassification_Point" 1 "EClassification_Car" 2 "EClassification_Truck" 3 "EClassification_Pedestrian" 4 "EClassification_Motorcycle" 5 "EClassification_Bicycle" 6 "EClassification_Wide" 7 "EClassification_Reserved1" 8 "EClassification_Reserved2" 9 "EClassification_Reserved3" 10 "EClassification_Unclassified" 11 "EClassification_Reserved4" 12 "EClassification_Reserved5" 13 "EClassification_Reserved6" 14 "EClassification_Reserved7" 15 "EClassification_Reserved8";
VAL_ 863 FrontFourDRadarObjSts01DynamicProperty 0 "EDynamicProperty_Moving" 1 "EDynamicProperty_Stationary" 2 "EDynamicProperty_Oncoming" 3 "EDynamicProperty_CrossingLeftToRight" 4 "EDynamicProperty_CrossingRightToLeft" 5 "EDynamicProperty_Unknown" 6 "EDynamicProperty_Stopped" 7 "EDynamicProperty_Reserved1";
VAL_ 863 FrontFourDRadarObjSts01UpdateFlag 0 "Boolean_FALSE" 1 "Boolean_TRUE";
VAL_ 863 FrontFourDRadarObjSts01ValidFlag 0 "Validity_NotValid" 1 "Validity_Valid";
VAL_ 873 FourDRadarObjSts04Classification 0 "EClassification_Point" 1 "EClassification_Car" 2 "EClassification_Truck" 3 "EClassification_Pedestrian" 4 "EClassification_Motorcycle" 5 "EClassification_Bicycle" 6 "EClassification_Wide" 7 "EClassification_Reserved1" 8 "EClassification_Reserved2" 9 "EClassification_Reserved3" 10 "EClassification_Unclassified" 11 "EClassification_Reserved4" 12 "EClassification_Reserved5" 13 "EClassification_Reserved6" 14 "EClassification_Reserved7" 15 "EClassification_Reserved8";
VAL_ 873 FourDRadarObjSts04DynamicProperty 0 "EDynamicProperty_Moving" 1 "EDynamicProperty_Stationary" 2 "EDynamicProperty_Oncoming" 3 "EDynamicProperty_CrossingLeftToRight" 4 "EDynamicProperty_CrossingRightToLeft" 5 "EDynamicProperty_Unknown" 6 "EDynamicProperty_Stopped" 7 "EDynamicProperty_Reserved1";
VAL_ 873 FourDRadarObjSts04UpdateFlag 0 "Boolean_FALSE" 1 "Boolean_TRUE";
VAL_ 873 FourDRadarObjSts04ValidFlag 0 "Validity_NotValid" 1 "Validity_Valid";
VAL_ 951 FourDRadarObjSts06Classification 0 "EClassification_Point" 1 "EClassification_Car" 2 "EClassification_Truck" 3 "EClassification_Pedestrian" 4 "EClassification_Motorcycle" 5 "EClassification_Bicycle" 6 "EClassification_Wide" 7 "EClassification_Reserved1" 8 "EClassification_Reserved2" 9 "EClassification_Reserved3" 10 "EClassification_Unclassified" 11 "EClassification_Reserved4" 12 "EClassification_Reserved5" 13 "EClassification_Reserved6" 14 "EClassification_Reserved7" 15 "EClassification_Reserved8";
VAL_ 951 FourDRadarObjSts06DynamicProperty 0 "EDynamicProperty_Moving" 1 "EDynamicProperty_Stationary" 2 "EDynamicProperty_Oncoming" 3 "EDynamicProperty_CrossingLeftToRight" 4 "EDynamicProperty_CrossingRightToLeft" 5 "EDynamicProperty_Unknown" 6 "EDynamicProperty_Stopped" 7 "EDynamicProperty_Reserved1";
VAL_ 951 FourDRadarObjSts06UpdateFlag 0 "Boolean_FALSE" 1 "Boolean_TRUE";
VAL_ 951 FourDRadarObjSts06ValidFlag 0 "Validity_NotValid" 1 "Validity_Valid";
VAL_ 903 FourDRadarObjSts08Classification 0 "EClassification_Point" 1 "EClassification_Car" 2 "EClassification_Truck" 3 "EClassification_Pedestrian" 4 "EClassification_Motorcycle" 5 "EClassification_Bicycle" 6 "EClassification_Wide" 7 "EClassification_Reserved1" 8 "EClassification_Reserved2" 9 "EClassification_Reserved3" 10 "EClassification_Unclassified" 11 "EClassification_Reserved4" 12 "EClassification_Reserved5" 13 "EClassification_Reserved6" 14 "EClassification_Reserved7" 15 "EClassification_Reserved8";
VAL_ 903 FourDRadarObjSts08DynamicProperty 0 "EDynamicProperty_Moving" 1 "EDynamicProperty_Stationary" 2 "EDynamicProperty_Oncoming" 3 "EDynamicProperty_CrossingLeftToRight" 4 "EDynamicProperty_CrossingRightToLeft" 5 "EDynamicProperty_Unknown" 6 "EDynamicProperty_Stopped" 7 "EDynamicProperty_Reserved1";
VAL_ 903 FourDRadarObjSts08UpdateFlag 0 "Boolean_FALSE" 1 "Boolean_TRUE";
VAL_ 903 FourDRadarObjSts08ValidFlag 0 "Validity_NotValid" 1 "Validity_Valid";
VAL_ 913 FourDRadarObjSts10Classification 0 "EClassification_Point" 1 "EClassification_Car" 2 "EClassification_Truck" 3 "EClassification_Pedestrian" 4 "EClassification_Motorcycle" 5 "EClassification_Bicycle" 6 "EClassification_Wide" 7 "EClassification_Reserved1" 8 "EClassification_Reserved2" 9 "EClassification_Reserved3" 10 "EClassification_Unclassified" 11 "EClassification_Reserved4" 12 "EClassification_Reserved5" 13 "EClassification_Reserved6" 14 "EClassification_Reserved7" 15 "EClassification_Reserved8";
VAL_ 913 FourDRadarObjSts10DynamicProperty 0 "EDynamicProperty_Moving" 1 "EDynamicProperty_Stationary" 2 "EDynamicProperty_Oncoming" 3 "EDynamicProperty_CrossingLeftToRight" 4 "EDynamicProperty_CrossingRightToLeft" 5 "EDynamicProperty_Unknown" 6 "EDynamicProperty_Stopped" 7 "EDynamicProperty_Reserved1";
VAL_ 913 FourDRadarObjSts10UpdateFlag 0 "Boolean_FALSE" 1 "Boolean_TRUE";
VAL_ 913 FourDRadarObjSts10ValidFlag 0 "Validity_NotValid" 1 "Validity_Valid";
VAL_ 923 FourDRadarObjSts12Classification 0 "EClassification_Point" 1 "EClassification_Car" 2 "EClassification_Truck" 3 "EClassification_Pedestrian" 4 "EClassification_Motorcycle" 5 "EClassification_Bicycle" 6 "EClassification_Wide" 7 "EClassification_Reserved1" 8 "EClassification_Reserved2" 9 "EClassification_Reserved3" 10 "EClassification_Unclassified" 11 "EClassification_Reserved4" 12 "EClassification_Reserved5" 13 "EClassification_Reserved6" 14 "EClassification_Reserved7" 15 "EClassification_Reserved8";
VAL_ 923 FourDRadarObjSts12DynamicProperty 0 "EDynamicProperty_Moving" 1 "EDynamicProperty_Stationary" 2 "EDynamicProperty_Oncoming" 3 "EDynamicProperty_CrossingLeftToRight" 4 "EDynamicProperty_CrossingRightToLeft" 5 "EDynamicProperty_Unknown" 6 "EDynamicProperty_Stopped" 7 "EDynamicProperty_Reserved1";
VAL_ 923 FourDRadarObjSts12UpdateFlag 0 "Boolean_FALSE" 1 "Boolean_TRUE";
VAL_ 923 FourDRadarObjSts12ValidFlag 0 "Validity_NotValid" 1 "Validity_Valid";
VAL_ 952 FourDRadarObjSts14Classification 0 "EClassification_Point" 1 "EClassification_Car" 2 "EClassification_Truck" 3 "EClassification_Pedestrian" 4 "EClassification_Motorcycle" 5 "EClassification_Bicycle" 6 "EClassification_Wide" 7 "EClassification_Reserved1" 8 "EClassification_Reserved2" 9 "EClassification_Reserved3" 10 "EClassification_Unclassified" 11 "EClassification_Reserved4" 12 "EClassification_Reserved5" 13 "EClassification_Reserved6" 14 "EClassification_Reserved7" 15 "EClassification_Reserved8";
VAL_ 952 FourDRadarObjSts14DynamicProperty 0 "EDynamicProperty_Moving" 1 "EDynamicProperty_Stationary" 2 "EDynamicProperty_Oncoming" 3 "EDynamicProperty_CrossingLeftToRight" 4 "EDynamicProperty_CrossingRightToLeft" 5 "EDynamicProperty_Unknown" 6 "EDynamicProperty_Stopped" 7 "EDynamicProperty_Reserved1";
VAL_ 952 FourDRadarObjSts14UpdateFlag 0 "Boolean_FALSE" 1 "Boolean_TRUE";
VAL_ 952 FourDRadarObjSts14ValidFlag 0 "Validity_NotValid" 1 "Validity_Valid";
VAL_ 954 FourDRadarObjSts16Classification 0 "EClassification_Point" 1 "EClassification_Car" 2 "EClassification_Truck" 3 "EClassification_Pedestrian" 4 "EClassification_Motorcycle" 5 "EClassification_Bicycle" 6 "EClassification_Wide" 7 "EClassification_Reserved1" 8 "EClassification_Reserved2" 9 "EClassification_Reserved3" 10 "EClassification_Unclassified" 11 "EClassification_Reserved4" 12 "EClassification_Reserved5" 13 "EClassification_Reserved6" 14 "EClassification_Reserved7" 15 "EClassification_Reserved8";
VAL_ 954 FourDRadarObjSts16DynamicProperty 0 "EDynamicProperty_Moving" 1 "EDynamicProperty_Stationary" 2 "EDynamicProperty_Oncoming" 3 "EDynamicProperty_CrossingLeftToRight" 4 "EDynamicProperty_CrossingRightToLeft" 5 "EDynamicProperty_Unknown" 6 "EDynamicProperty_Stopped" 7 "EDynamicProperty_Reserved1";
VAL_ 954 FourDRadarObjSts16UpdateFlag 0 "Boolean_FALSE" 1 "Boolean_TRUE";
VAL_ 954 FourDRadarObjSts16ValidFlag 0 "Validity_NotValid" 1 "Validity_Valid";
VAL_ 953 FourDRadarObjSts18Classification 0 "EClassification_Point" 1 "EClassification_Car" 2 "EClassification_Truck" 3 "EClassification_Pedestrian" 4 "EClassification_Motorcycle" 5 "EClassification_Bicycle" 6 "EClassification_Wide" 7 "EClassification_Reserved1" 8 "EClassification_Reserved2" 9 "EClassification_Reserved3" 10 "EClassification_Unclassified" 11 "EClassification_Reserved4" 12 "EClassification_Reserved5" 13 "EClassification_Reserved6" 14 "EClassification_Reserved7" 15 "EClassification_Reserved8";
VAL_ 953 FourDRadarObjSts18DynamicProperty 0 "EDynamicProperty_Moving" 1 "EDynamicProperty_Stationary" 2 "EDynamicProperty_Oncoming" 3 "EDynamicProperty_CrossingLeftToRight" 4 "EDynamicProperty_CrossingRightToLeft" 5 "EDynamicProperty_Unknown" 6 "EDynamicProperty_Stopped" 7 "EDynamicProperty_Reserved1";
VAL_ 953 FourDRadarObjSts18UpdateFlag 0 "Boolean_FALSE" 1 "Boolean_TRUE";
VAL_ 953 FourDRadarObjSts18ValidFlag 0 "Validity_NotValid" 1 "Validity_Valid";
VAL_ 963 FourDRadarObjSts20Classification 0 "EClassification_Point" 1 "EClassification_Car" 2 "EClassification_Truck" 3 "EClassification_Pedestrian" 4 "EClassification_Motorcycle" 5 "EClassification_Bicycle" 6 "EClassification_Wide" 7 "EClassification_Reserved1" 8 "EClassification_Reserved2" 9 "EClassification_Reserved3" 10 "EClassification_Unclassified" 11 "EClassification_Reserved4" 12 "EClassification_Reserved5" 13 "EClassification_Reserved6" 14 "EClassification_Reserved7" 15 "EClassification_Reserved8";
VAL_ 963 FourDRadarObjSts20DynamicProperty 0 "EDynamicProperty_Moving" 1 "EDynamicProperty_Stationary" 2 "EDynamicProperty_Oncoming" 3 "EDynamicProperty_CrossingLeftToRight" 4 "EDynamicProperty_CrossingRightToLeft" 5 "EDynamicProperty_Unknown" 6 "EDynamicProperty_Stopped" 7 "EDynamicProperty_Reserved1";
VAL_ 963 FourDRadarObjSts20UpdateFlag 0 "Boolean_FALSE" 1 "Boolean_TRUE";
VAL_ 963 FourDRadarObjSts20ValidFlag 0 "Validity_NotValid" 1 "Validity_Valid";
VAL_ 973 FourDRadarObjSts22Classification 0 "EClassification_Point" 1 "EClassification_Car" 2 "EClassification_Truck" 3 "EClassification_Pedestrian" 4 "EClassification_Motorcycle" 5 "EClassification_Bicycle" 6 "EClassification_Wide" 7 "EClassification_Reserved1" 8 "EClassification_Reserved2" 9 "EClassification_Reserved3" 10 "EClassification_Unclassified" 11 "EClassification_Reserved4" 12 "EClassification_Reserved5" 13 "EClassification_Reserved6" 14 "EClassification_Reserved7" 15 "EClassification_Reserved8";
VAL_ 973 FourDRadarObjSts22DynamicProperty 0 "EDynamicProperty_Moving" 1 "EDynamicProperty_Stationary" 2 "EDynamicProperty_Oncoming" 3 "EDynamicProperty_CrossingLeftToRight" 4 "EDynamicProperty_CrossingRightToLeft" 5 "EDynamicProperty_Unknown" 6 "EDynamicProperty_Stopped" 7 "EDynamicProperty_Reserved1";
VAL_ 973 FourDRadarObjSts22UpdateFlag 0 "Boolean_FALSE" 1 "Boolean_TRUE";
VAL_ 973 FourDRadarObjSts22ValidFlag 0 "Validity_NotValid" 1 "Validity_Valid";
VAL_ 983 FourDRadarObjSts24Classification 0 "EClassification_Point" 1 "EClassification_Car" 2 "EClassification_Truck" 3 "EClassification_Pedestrian" 4 "EClassification_Motorcycle" 5 "EClassification_Bicycle" 6 "EClassification_Wide" 7 "EClassification_Reserved1" 8 "EClassification_Reserved2" 9 "EClassification_Reserved3" 10 "EClassification_Unclassified" 11 "EClassification_Reserved4" 12 "EClassification_Reserved5" 13 "EClassification_Reserved6" 14 "EClassification_Reserved7" 15 "EClassification_Reserved8";
VAL_ 983 FourDRadarObjSts24DynamicProperty 0 "EDynamicProperty_Moving" 1 "EDynamicProperty_Stationary" 2 "EDynamicProperty_Oncoming" 3 "EDynamicProperty_CrossingLeftToRight" 4 "EDynamicProperty_CrossingRightToLeft" 5 "EDynamicProperty_Unknown" 6 "EDynamicProperty_Stopped" 7 "EDynamicProperty_Reserved1";
VAL_ 983 FourDRadarObjSts24UpdateFlag 0 "Boolean_FALSE" 1 "Boolean_TRUE";
VAL_ 983 FourDRadarObjSts24ValidFlag 0 "Validity_NotValid" 1 "Validity_Valid";
VAL_ 993 FourDRadarObjSts26Classification 0 "EClassification_Point" 1 "EClassification_Car" 2 "EClassification_Truck" 3 "EClassification_Pedestrian" 4 "EClassification_Motorcycle" 5 "EClassification_Bicycle" 6 "EClassification_Wide" 7 "EClassification_Reserved1" 8 "EClassification_Reserved2" 9 "EClassification_Reserved3" 10 "EClassification_Unclassified" 11 "EClassification_Reserved4" 12 "EClassification_Reserved5" 13 "EClassification_Reserved6" 14 "EClassification_Reserved7" 15 "EClassification_Reserved8";
VAL_ 993 FourDRadarObjSts26DynamicProperty 0 "EDynamicProperty_Moving" 1 "EDynamicProperty_Stationary" 2 "EDynamicProperty_Oncoming" 3 "EDynamicProperty_CrossingLeftToRight" 4 "EDynamicProperty_CrossingRightToLeft" 5 "EDynamicProperty_Unknown" 6 "EDynamicProperty_Stopped" 7 "EDynamicProperty_Reserved1";
VAL_ 993 FourDRadarObjSts26UpdateFlag 0 "Boolean_FALSE" 1 "Boolean_TRUE";
VAL_ 993 FourDRadarObjSts26ValidFlag 0 "Validity_NotValid" 1 "Validity_Valid";
SIG_GROUP_ 873 FourDRadarObjSts04 1 : FourDRadarObjSts04Chks FourDRadarObjSts04Classification FourDRadarObjSts04Cntr FourDRadarObjSts04DistX FourDRadarObjSts04DistXStd FourDRadarObjSts04DistY FourDRadarObjSts04DistYStd FourDRadarObjSts04DistZ FourDRadarObjSts04DistZStd FourDRadarObjSts04DynamicProperty FourDRadarObjSts04HeadingAngle FourDRadarObjSts04ID FourDRadarObjSts04LifeCycles FourDRadarObjSts04ObjBoundingBoxHeight FourDRadarObjSts04ObjBoundingBoxLength FourDRadarObjSts04ObjBoundingBoxWidth FourDRadarObjSts04ObjNearestPtX FourDRadarObjSts04ObjNearestPtY FourDRadarObjSts04ObjNearestPtZ FourDRadarObjSts04ObjSNR FourDRadarObjSts04ObjXAccRel FourDRadarObjSts04ObjYAccRel FourDRadarObjSts04ObstacleProbability FourDRadarObjSts04ProbabilityOfExistence FourDRadarObjSts04RCS FourDRadarObjSts04TargetClassificationConfidence FourDRadarObjSts04UpdateFlag FourDRadarObjSts04VabsX FourDRadarObjSts04VabsXStd FourDRadarObjSts04VabsY FourDRadarObjSts04VabsYStd FourDRadarObjSts04ValidFlag;
SIG_GROUP_ 951 FourDRadarObjSts06 1 : FourDRadarObjSts06Chks FourDRadarObjSts06Classification FourDRadarObjSts06Cntr FourDRadarObjSts06DistX FourDRadarObjSts06DistXStd FourDRadarObjSts06DistY FourDRadarObjSts06DistYStd FourDRadarObjSts06DistZ FourDRadarObjSts06DistZStd FourDRadarObjSts06DynamicProperty FourDRadarObjSts06HeadingAngle FourDRadarObjSts06ID FourDRadarObjSts06LifeCycles FourDRadarObjSts06ObjBoundingBoxHeight FourDRadarObjSts06ObjBoundingBoxLength FourDRadarObjSts06ObjBoundingBoxWidth FourDRadarObjSts06ObjNearestPtX FourDRadarObjSts06ObjNearestPtY FourDRadarObjSts06ObjNearestPtZ FourDRadarObjSts06ObjSNR FourDRadarObjSts06ObjXAccRel FourDRadarObjSts06ObjYAccRel FourDRadarObjSts06ObstacleProbability FourDRadarObjSts06ProbabilityOfExistence FourDRadarObjSts06RCS FourDRadarObjSts06TargetClassificationConfidence FourDRadarObjSts06UpdateFlag FourDRadarObjSts06VabsX FourDRadarObjSts06VabsXStd FourDRadarObjSts06VabsY FourDRadarObjSts06VabsYStd FourDRadarObjSts06ValidFlag;
SIG_GROUP_ 903 FourDRadarObjSts08 1 : FourDRadarObjSts08Chks FourDRadarObjSts08Classification FourDRadarObjSts08Cntr FourDRadarObjSts08DistX FourDRadarObjSts08DistXStd FourDRadarObjSts08DistY FourDRadarObjSts08DistYStd FourDRadarObjSts08DistZ FourDRadarObjSts08DistZStd FourDRadarObjSts08DynamicProperty FourDRadarObjSts08HeadingAngle FourDRadarObjSts08ID FourDRadarObjSts08LifeCycles FourDRadarObjSts08ObjBoundingBoxHeight FourDRadarObjSts08ObjBoundingBoxLength FourDRadarObjSts08ObjBoundingBoxWidth FourDRadarObjSts08ObjNearestPtX FourDRadarObjSts08ObjNearestPtY FourDRadarObjSts08ObjNearestPtZ FourDRadarObjSts08ObjSNR FourDRadarObjSts08ObjXAccRel FourDRadarObjSts08ObjYAccRel FourDRadarObjSts08ObstacleProbability FourDRadarObjSts08ProbabilityOfExistence FourDRadarObjSts08RCS FourDRadarObjSts08TargetClassificationConfidence FourDRadarObjSts08UpdateFlag FourDRadarObjSts08VabsX FourDRadarObjSts08VabsXStd FourDRadarObjSts08VabsY FourDRadarObjSts08VabsYStd FourDRadarObjSts08ValidFlag;
SIG_GROUP_ 913 FourDRadarObjSts10 1 : FourDRadarObjSts10Chks FourDRadarObjSts10Classification FourDRadarObjSts10Cntr FourDRadarObjSts10DistX FourDRadarObjSts10DistXStd FourDRadarObjSts10DistY FourDRadarObjSts10DistYStd FourDRadarObjSts10DistZ FourDRadarObjSts10DistZStd FourDRadarObjSts10DynamicProperty FourDRadarObjSts10HeadingAngle FourDRadarObjSts10ID FourDRadarObjSts10LifeCycles FourDRadarObjSts10ObjBoundingBoxHeight FourDRadarObjSts10ObjBoundingBoxLength FourDRadarObjSts10ObjBoundingBoxWidth FourDRadarObjSts10ObjNearestPtX FourDRadarObjSts10ObjNearestPtY FourDRadarObjSts10ObjNearestPtZ FourDRadarObjSts10ObjSNR FourDRadarObjSts10ObjXAccRel FourDRadarObjSts10ObjYAccRel FourDRadarObjSts10ObstacleProbability FourDRadarObjSts10ProbabilityOfExistence FourDRadarObjSts10RCS FourDRadarObjSts10TargetClassificationConfidence FourDRadarObjSts10UpdateFlag FourDRadarObjSts10VabsX FourDRadarObjSts10VabsXStd FourDRadarObjSts10VabsY FourDRadarObjSts10VabsYStd FourDRadarObjSts10ValidFlag;
SIG_GROUP_ 923 FourDRadarObjSts12 1 : FourDRadarObjSts12Chks FourDRadarObjSts12Classification FourDRadarObjSts12Cntr FourDRadarObjSts12DistX FourDRadarObjSts12DistXStd FourDRadarObjSts12DistY FourDRadarObjSts12DistYStd FourDRadarObjSts12DistZ FourDRadarObjSts12DistZStd FourDRadarObjSts12DynamicProperty FourDRadarObjSts12HeadingAngle FourDRadarObjSts12ID FourDRadarObjSts12LifeCycles FourDRadarObjSts12ObjBoundingBoxHeight FourDRadarObjSts12ObjBoundingBoxLength FourDRadarObjSts12ObjBoundingBoxWidth FourDRadarObjSts12ObjNearestPtX FourDRadarObjSts12ObjNearestPtY FourDRadarObjSts12ObjNearestPtZ FourDRadarObjSts12ObjSNR FourDRadarObjSts12ObjXAccRel FourDRadarObjSts12ObjYAccRel FourDRadarObjSts12ObstacleProbability FourDRadarObjSts12ProbabilityOfExistence FourDRadarObjSts12RCS FourDRadarObjSts12TargetClassificationConfidence FourDRadarObjSts12UpdateFlag FourDRadarObjSts12VabsX FourDRadarObjSts12VabsXStd FourDRadarObjSts12VabsY FourDRadarObjSts12VabsYStd FourDRadarObjSts12ValidFlag;
SIG_GROUP_ 952 FourDRadarObjSts14 1 : FourDRadarObjSts14Chks FourDRadarObjSts14Classification FourDRadarObjSts14Cntr FourDRadarObjSts14DistX FourDRadarObjSts14DistXStd FourDRadarObjSts14DistY FourDRadarObjSts14DistYStd FourDRadarObjSts14DistZ FourDRadarObjSts14DistZStd FourDRadarObjSts14DynamicProperty FourDRadarObjSts14HeadingAngle FourDRadarObjSts14ID FourDRadarObjSts14LifeCycles FourDRadarObjSts14ObjBoundingBoxHeight FourDRadarObjSts14ObjBoundingBoxLength FourDRadarObjSts14ObjBoundingBoxWidth FourDRadarObjSts14ObjNearestPtX FourDRadarObjSts14ObjNearestPtY FourDRadarObjSts14ObjNearestPtZ FourDRadarObjSts14ObjSNR FourDRadarObjSts14ObjXAccRel FourDRadarObjSts14ObjYAccRel FourDRadarObjSts14ObstacleProbability FourDRadarObjSts14ProbabilityOfExistence FourDRadarObjSts14RCS FourDRadarObjSts14TargetClassificationConfidence FourDRadarObjSts14UpdateFlag FourDRadarObjSts14VabsX FourDRadarObjSts14VabsXStd FourDRadarObjSts14VabsY FourDRadarObjSts14VabsYStd FourDRadarObjSts14ValidFlag;
SIG_GROUP_ 954 FourDRadarObjSts16 1 : FourDRadarObjSts16Chks FourDRadarObjSts16Classification FourDRadarObjSts16Cntr FourDRadarObjSts16DistX FourDRadarObjSts16DistXStd FourDRadarObjSts16DistY FourDRadarObjSts16DistYStd FourDRadarObjSts16DistZ FourDRadarObjSts16DistZStd FourDRadarObjSts16DynamicProperty FourDRadarObjSts16HeadingAngle FourDRadarObjSts16ID FourDRadarObjSts16LifeCycles FourDRadarObjSts16ObjBoundingBoxHeight FourDRadarObjSts16ObjBoundingBoxLength FourDRadarObjSts16ObjBoundingBoxWidth FourDRadarObjSts16ObjNearestPtX FourDRadarObjSts16ObjNearestPtY FourDRadarObjSts16ObjNearestPtZ FourDRadarObjSts16ObjSNR FourDRadarObjSts16ObjXAccRel FourDRadarObjSts16ObjYAccRel FourDRadarObjSts16ObstacleProbability FourDRadarObjSts16ProbabilityOfExistence FourDRadarObjSts16RCS FourDRadarObjSts16TargetClassificationConfidence FourDRadarObjSts16UpdateFlag FourDRadarObjSts16VabsX FourDRadarObjSts16VabsXStd FourDRadarObjSts16VabsY FourDRadarObjSts16VabsYStd FourDRadarObjSts16ValidFlag;
SIG_GROUP_ 953 FourDRadarObjSts18 1 : FourDRadarObjSts18Chks FourDRadarObjSts18Classification FourDRadarObjSts18Cntr FourDRadarObjSts18DistX FourDRadarObjSts18DistXStd FourDRadarObjSts18DistY FourDRadarObjSts18DistYStd FourDRadarObjSts18DistZ FourDRadarObjSts18DistZStd FourDRadarObjSts18DynamicProperty FourDRadarObjSts18HeadingAngle FourDRadarObjSts18ID FourDRadarObjSts18LifeCycles FourDRadarObjSts18ObjBoundingBoxHeight FourDRadarObjSts18ObjBoundingBoxLength FourDRadarObjSts18ObjBoundingBoxWidth FourDRadarObjSts18ObjNearestPtX FourDRadarObjSts18ObjNearestPtY FourDRadarObjSts18ObjNearestPtZ FourDRadarObjSts18ObjSNR FourDRadarObjSts18ObjXAccRel FourDRadarObjSts18ObjYAccRel FourDRadarObjSts18ObstacleProbability FourDRadarObjSts18ProbabilityOfExistence FourDRadarObjSts18RCS FourDRadarObjSts18TargetClassificationConfidence FourDRadarObjSts18UpdateFlag FourDRadarObjSts18VabsX FourDRadarObjSts18VabsXStd FourDRadarObjSts18VabsY FourDRadarObjSts18VabsYStd FourDRadarObjSts18ValidFlag;
SIG_GROUP_ 963 FourDRadarObjSts20 1 : FourDRadarObjSts20Chks FourDRadarObjSts20Classification FourDRadarObjSts20Cntr FourDRadarObjSts20DistX FourDRadarObjSts20DistXStd FourDRadarObjSts20DistY FourDRadarObjSts20DistYStd FourDRadarObjSts20DistZ FourDRadarObjSts20DistZStd FourDRadarObjSts20DynamicProperty FourDRadarObjSts20HeadingAngle FourDRadarObjSts20ID FourDRadarObjSts20LifeCycles FourDRadarObjSts20ObjBoundingBoxHeight FourDRadarObjSts20ObjBoundingBoxLength FourDRadarObjSts20ObjBoundingBoxWidth FourDRadarObjSts20ObjNearestPtX FourDRadarObjSts20ObjNearestPtY FourDRadarObjSts20ObjNearestPtZ FourDRadarObjSts20ObjSNR FourDRadarObjSts20ObjXAccRel FourDRadarObjSts20ObjYAccRel FourDRadarObjSts20ObstacleProbability FourDRadarObjSts20ProbabilityOfExistence FourDRadarObjSts20RCS FourDRadarObjSts20TargetClassificationConfidence FourDRadarObjSts20UpdateFlag FourDRadarObjSts20VabsX FourDRadarObjSts20VabsXStd FourDRadarObjSts20VabsY FourDRadarObjSts20VabsYStd FourDRadarObjSts20ValidFlag;
SIG_GROUP_ 973 FourDRadarObjSts22 1 : FourDRadarObjSts22Chks FourDRadarObjSts22Classification FourDRadarObjSts22Cntr FourDRadarObjSts22DistX FourDRadarObjSts22DistXStd FourDRadarObjSts22DistY FourDRadarObjSts22DistYStd FourDRadarObjSts22DistZ FourDRadarObjSts22DistZStd FourDRadarObjSts22DynamicProperty FourDRadarObjSts22HeadingAngle FourDRadarObjSts22ID FourDRadarObjSts22LifeCycles FourDRadarObjSts22ObjBoundingBoxHeight FourDRadarObjSts22ObjBoundingBoxLength FourDRadarObjSts22ObjBoundingBoxWidth FourDRadarObjSts22ObjNearestPtX FourDRadarObjSts22ObjNearestPtY FourDRadarObjSts22ObjNearestPtZ FourDRadarObjSts22ObjSNR FourDRadarObjSts22ObjXAccRel FourDRadarObjSts22ObjYAccRel FourDRadarObjSts22ObstacleProbability FourDRadarObjSts22ProbabilityOfExistence FourDRadarObjSts22RCS FourDRadarObjSts22TargetClassificationConfidence FourDRadarObjSts22UpdateFlag FourDRadarObjSts22VabsX FourDRadarObjSts22VabsXStd FourDRadarObjSts22VabsY FourDRadarObjSts22VabsYStd FourDRadarObjSts22ValidFlag;
SIG_GROUP_ 983 FourDRadarObjSts24 1 : FourDRadarObjSts24Chks FourDRadarObjSts24Classification FourDRadarObjSts24Cntr FourDRadarObjSts24DistX FourDRadarObjSts24DistXStd FourDRadarObjSts24DistY FourDRadarObjSts24DistYStd FourDRadarObjSts24DistZ FourDRadarObjSts24DistZStd FourDRadarObjSts24DynamicProperty FourDRadarObjSts24HeadingAngle FourDRadarObjSts24ID FourDRadarObjSts24LifeCycles FourDRadarObjSts24ObjBoundingBoxHeight FourDRadarObjSts24ObjBoundingBoxLength FourDRadarObjSts24ObjBoundingBoxWidth FourDRadarObjSts24ObjNearestPtX FourDRadarObjSts24ObjNearestPtY FourDRadarObjSts24ObjNearestPtZ FourDRadarObjSts24ObjSNR FourDRadarObjSts24ObjXAccRel FourDRadarObjSts24ObjYAccRel FourDRadarObjSts24ObstacleProbability FourDRadarObjSts24ProbabilityOfExistence FourDRadarObjSts24RCS FourDRadarObjSts24TargetClassificationConfidence FourDRadarObjSts24UpdateFlag FourDRadarObjSts24VabsX FourDRadarObjSts24VabsXStd FourDRadarObjSts24VabsY FourDRadarObjSts24VabsYStd FourDRadarObjSts24ValidFlag;
SIG_GROUP_ 993 FourDRadarObjSts26 1 : FourDRadarObjSts26Chks FourDRadarObjSts26Classification FourDRadarObjSts26Cntr FourDRadarObjSts26DistX FourDRadarObjSts26DistXStd FourDRadarObjSts26DistY FourDRadarObjSts26DistYStd FourDRadarObjSts26DistZ FourDRadarObjSts26DistZStd FourDRadarObjSts26DynamicProperty FourDRadarObjSts26HeadingAngle FourDRadarObjSts26ID FourDRadarObjSts26LifeCycles FourDRadarObjSts26ObjBoundingBoxHeight FourDRadarObjSts26ObjBoundingBoxLength FourDRadarObjSts26ObjBoundingBoxWidth FourDRadarObjSts26ObjNearestPtX FourDRadarObjSts26ObjNearestPtY FourDRadarObjSts26ObjNearestPtZ FourDRadarObjSts26ObjSNR FourDRadarObjSts26ObjXAccRel FourDRadarObjSts26ObjYAccRel FourDRadarObjSts26ObstacleProbability FourDRadarObjSts26ProbabilityOfExistence FourDRadarObjSts26RCS FourDRadarObjSts26TargetClassificationConfidence FourDRadarObjSts26UpdateFlag FourDRadarObjSts26VabsX FourDRadarObjSts26VabsXStd FourDRadarObjSts26VabsY FourDRadarObjSts26VabsYStd FourDRadarObjSts26ValidFlag;
SIG_GROUP_ 898 FourDRadarObjSts35 1 : FourDRadarObjSts35Chks FourDRadarObjSts35Classification FourDRadarObjSts35Cntr FourDRadarObjSts35DistX FourDRadarObjSts35DistXStd FourDRadarObjSts35DistY FourDRadarObjSts35DistYStd FourDRadarObjSts35DistZ FourDRadarObjSts35DistZStd FourDRadarObjSts35DynamicProperty FourDRadarObjSts35HeadingAngle FourDRadarObjSts35ID FourDRadarObjSts35LifeCycles FourDRadarObjSts35ObjBoundingBoxHeight FourDRadarObjSts35ObjBoundingBoxLength FourDRadarObjSts35ObjBoundingBoxWidth FourDRadarObjSts35ObjNearestPtX FourDRadarObjSts35ObjNearestPtY FourDRadarObjSts35ObjNearestPtZ FourDRadarObjSts35ObjSNR FourDRadarObjSts35ObjXAccRel FourDRadarObjSts35ObjYAccRel FourDRadarObjSts35ObstacleProbability FourDRadarObjSts35ProbabilityOfExistence FourDRadarObjSts35RCS FourDRadarObjSts35TargetClassificationConfidence FourDRadarObjSts35UpdateFlag FourDRadarObjSts35VabsX FourDRadarObjSts35VabsXStd FourDRadarObjSts35VabsY FourDRadarObjSts35VabsYStd FourDRadarObjSts35ValidFlag;
SIG_GROUP_ 899 FourDRadarObjSts37 1 : FourDRadarObjSts37Chks FourDRadarObjSts37Classification FourDRadarObjSts37Cntr FourDRadarObjSts37DistX FourDRadarObjSts37DistXStd FourDRadarObjSts37DistY FourDRadarObjSts37DistYStd FourDRadarObjSts37DistZ FourDRadarObjSts37DistZStd FourDRadarObjSts37DynamicProperty FourDRadarObjSts37HeadingAngle FourDRadarObjSts37ID FourDRadarObjSts37LifeCycles FourDRadarObjSts37ObjBoundingBoxHeight FourDRadarObjSts37ObjBoundingBoxLength FourDRadarObjSts37ObjBoundingBoxWidth FourDRadarObjSts37ObjNearestPtX FourDRadarObjSts37ObjNearestPtY FourDRadarObjSts37ObjNearestPtZ FourDRadarObjSts37ObjSNR FourDRadarObjSts37ObjXAccRel FourDRadarObjSts37ObjYAccRel FourDRadarObjSts37ObstacleProbability FourDRadarObjSts37ProbabilityOfExistence FourDRadarObjSts37RCS FourDRadarObjSts37TargetClassificationConfidence FourDRadarObjSts37UpdateFlag FourDRadarObjSts37VabsX FourDRadarObjSts37VabsXStd FourDRadarObjSts37VabsY FourDRadarObjSts37VabsYStd FourDRadarObjSts37ValidFlag;
SIG_GROUP_ 900 FourDRadarObjSts39 1 : FourDRadarObjSts39Chks FourDRadarObjSts39Classification FourDRadarObjSts39Cntr FourDRadarObjSts39DistX FourDRadarObjSts39DistXStd FourDRadarObjSts39DistY FourDRadarObjSts39DistYStd FourDRadarObjSts39DistZ FourDRadarObjSts39DistZStd FourDRadarObjSts39DynamicProperty FourDRadarObjSts39HeadingAngle FourDRadarObjSts39ID FourDRadarObjSts39LifeCycles FourDRadarObjSts39ObjBoundingBoxHeight FourDRadarObjSts39ObjBoundingBoxLength FourDRadarObjSts39ObjBoundingBoxWidth FourDRadarObjSts39ObjNearestPtX FourDRadarObjSts39ObjNearestPtY FourDRadarObjSts39ObjNearestPtZ FourDRadarObjSts39ObjSNR FourDRadarObjSts39ObjXAccRel FourDRadarObjSts39ObjYAccRel FourDRadarObjSts39ObstacleProbability FourDRadarObjSts39ProbabilityOfExistence FourDRadarObjSts39RCS FourDRadarObjSts39TargetClassificationConfidence FourDRadarObjSts39UpdateFlag FourDRadarObjSts39VabsX FourDRadarObjSts39VabsXStd FourDRadarObjSts39VabsY FourDRadarObjSts39VabsYStd FourDRadarObjSts39ValidFlag;
SIG_GROUP_ 901 FourDRadarObjSts41 1 : FourDRadarObjSts41Chks FourDRadarObjSts41Classification FourDRadarObjSts41Cntr FourDRadarObjSts41DistX FourDRadarObjSts41DistXStd FourDRadarObjSts41DistY FourDRadarObjSts41DistYStd FourDRadarObjSts41DistZ FourDRadarObjSts41DistZStd FourDRadarObjSts41DynamicProperty FourDRadarObjSts41HeadingAngle FourDRadarObjSts41ID FourDRadarObjSts41LifeCycles FourDRadarObjSts41ObjBoundingBoxHeight FourDRadarObjSts41ObjBoundingBoxLength FourDRadarObjSts41ObjBoundingBoxWidth FourDRadarObjSts41ObjNearestPtX FourDRadarObjSts41ObjNearestPtY FourDRadarObjSts41ObjNearestPtZ FourDRadarObjSts41ObjSNR FourDRadarObjSts41ObjXAccRel FourDRadarObjSts41ObjYAccRel FourDRadarObjSts41ObstacleProbability FourDRadarObjSts41ProbabilityOfExistence FourDRadarObjSts41RCS FourDRadarObjSts41TargetClassificationConfidence FourDRadarObjSts41UpdateFlag FourDRadarObjSts41VabsX FourDRadarObjSts41VabsXStd FourDRadarObjSts41VabsY FourDRadarObjSts41VabsYStd FourDRadarObjSts41ValidFlag;
SIG_GROUP_ 863 FrontFourDRadarObjSts01 1 : FrontFourDRadarObjSts01Chks FrontFourDRadarObjSts01Classification FrontFourDRadarObjSts01Cntr FrontFourDRadarObjSts01DistX FrontFourDRadarObjSts01DistXStd FrontFourDRadarObjSts01DistY FrontFourDRadarObjSts01DistYStd FrontFourDRadarObjSts01DistZ FrontFourDRadarObjSts01DistZStd FrontFourDRadarObjSts01DynamicProperty FrontFourDRadarObjSts01HeadingAngle FrontFourDRadarObjSts01ID FrontFourDRadarObjSts01LifeCycles FrontFourDRadarObjSts01ObjBoundingBoxHeight FrontFourDRadarObjSts01ObjBoundingBoxLength FrontFourDRadarObjSts01ObjBoundingBoxWidth FrontFourDRadarObjSts01ObjNearestPtX FrontFourDRadarObjSts01ObjNearestPtY FrontFourDRadarObjSts01ObjNearestPtZ FrontFourDRadarObjSts01ObjSNR FrontFourDRadarObjSts01ObjXAccRel FrontFourDRadarObjSts01ObjYAccRel FrontFourDRadarObjSts01ObstacleProbability FrontFourDRadarObjSts01ProbabilityOfExistence FrontFourDRadarObjSts01RCS FrontFourDRadarObjSts01TargetClassificationConfidence FrontFourDRadarObjSts01UpdateFlag FrontFourDRadarObjSts01VabsX FrontFourDRadarObjSts01VabsXStd FrontFourDRadarObjSts01VabsY FrontFourDRadarObjSts01VabsYStd FrontFourDRadarObjSts01ValidFlag;

// *************************************************************************** *
// *                                                                           *
// * Description:         CANDB File                                           *
// * Generated at:        2023-03-04 22:47                                     *
// * System:              SDB23100                                             *
// * Variant:             DX11_VDDM_CDD3_ADCU3                                 *
// * Network:             SafetyCANFD1                                         *
// *                                                                           *
// *************************************************************************** *
VERSION "SafetyCANFD1"

NS_ :

BS_ :

BU_ :  ASDM ETC FSRL FSRR

BO_ 352 FSRLSafetyCANFD1Frame25 : 64 FSRL
 SG_ FrntSideRdrLeObj3_UB : 319|1@0+ (1,0) [0|1] "" ASDM
 SG_ FrntSideRdrLeObj3Heading : 287|12@0+ (0.1,-180.0) [-180.0|180.0] "Deg" ASDM
 SG_ FrntSideRdrLeObj3ObjBoxCenterLat : 23|9@0+ (0.1,-25.0) [-25.0|25.0] "m" ASDM
 SG_ FrntSideRdrLeObj3ObjBoxCenterLgt : 30|9@0+ (0.1,-25.0) [-25.0|25.0] "m" ASDM
 SG_ FrntSideRdrLeObj3ObservationHist : 63|32@0+ (1.0,0.0) [0.0|4294967295.0] "Unitless" ASDM
 SG_ FrntSideRdrLeObj3QualityBits : 289|18@0+ (1.0,0.0) [0.0|262143.0] "Unitless" ASDM
 SG_ FrntSideRdrLeObj3RdrObjAx : 7|8@0- (0.1,0.0) [-12.8|12.700000000000001] "m/s^2" ASDM
 SG_ FrntSideRdrLeObj3RdrObjAy : 15|8@0- (0.1,0.0) [-12.8|12.700000000000001] "m/s^2" ASDM
 SG_ FrntSideRdrLeObj3RdrObjBoxLength : 37|9@0+ (0.1,0.0) [0.0|50.0] "m" ASDM
 SG_ FrntSideRdrLeObj3RdrObjBoxWidth : 44|9@0+ (0.1,0.0) [0.0|50.0] "m" ASDM
 SG_ FrntSideRdrLeObj3RdrObjChks : 95|8@0+ (1.0,0.0) [0.0|255.0] "Unitless" ASDM
 SG_ FrntSideRdrLeObj3RdrObjCntr : 103|4@0+ (1.0,0.0) [0.0|15.0] "Unitless" ASDM
 SG_ FrntSideRdrLeObj3RdrObjCoastCnt : 279|5@0+ (1.0,0.0) [0.0|31.0] "Unitless" ASDM
 SG_ FrntSideRdrLeObj3RdrObjConf : 99|4@0+ (7.0,0.0) [0.0|105.0] "%" ASDM
 SG_ FrntSideRdrLeObj3RdrObjDx : 191|13@0+ (0.05,-200.0) [-200.0|200.0] "m" ASDM
 SG_ FrntSideRdrLeObj3RdrObjDxStdDe : 111|8@0+ (0.05,0.0) [0.0|12.700000000000001] "m" ASDM
 SG_ FrntSideRdrLeObj3RdrObjDy : 119|13@0+ (0.05,-200.0) [-200.0|200.0] "m" ASDM
 SG_ FrntSideRdrLeObj3RdrObjDyStdDe : 183|8@0+ (0.05,0.0) [0.0|12.700000000000001] "m" ASDM
 SG_ FrntSideRdrLeObj3RdrObjElevnConf : 223|4@0+ (7.0,0.0) [0.0|105.0] "%" ASDM
 SG_ FrntSideRdrLeObj3RdrObjElevnSts : 153|2@0+ (1,0) [0|3] "" ASDM
 SG_ FrntSideRdrLeObj3RdrObjID : 167|8@0+ (1.0,0.0) [0.0|255.0] "Unitless" ASDM
 SG_ FrntSideRdrLeObj3RdrObjIsInFreeSpace : 192|1@0+ (1,0) [0|1] "" ASDM
 SG_ FrntSideRdrLeObj3RdrObjMirrProblty : 219|4@0+ (7.0,0.0) [0.0|105.0] "%" ASDM
 SG_ FrntSideRdrLeObj3RdrObjMtnPat : 122|3@0+ (1,0) [0|7] "" ASDM
 SG_ FrntSideRdrLeObj3RdrObjNotRealProblty : 231|4@0+ (7.0,0.0) [0.0|105.0] "%" ASDM
 SG_ FrntSideRdrLeObj3RdrObjStatyCnt : 239|7@0+ (1.0,0.0) [0.0|127.0] "Unitless" ASDM
 SG_ FrntSideRdrLeObj3RdrObjTiAlv : 247|7@0+ (1.0,0.0) [0.0|127.0] "Unitless" ASDM
 SG_ FrntSideRdrLeObj3RdrObjTrackSts : 194|2@0+ (1,0) [0|3] "" ASDM
 SG_ FrntSideRdrLeObj3RdrObjTyp : 51|4@0+ (1,0) [0|15] "" ASDM
 SG_ FrntSideRdrLeObj3RdrObjTypConfBike : 175|4@0+ (7.0,0.0) [0.0|105.0] "%" ASDM
 SG_ FrntSideRdrLeObj3RdrObjTypConfPed : 171|4@0+ (7.0,0.0) [0.0|105.0] "%" ASDM
 SG_ FrntSideRdrLeObj3RdrObjTypConfVeh : 227|4@0+ (7.0,0.0) [0.0|105.0] "%" ASDM
 SG_ FrntSideRdrLeObj3RdrObjUsedTracker : 291|2@0+ (1,0) [0|3] "" ASDM
 SG_ FrntSideRdrLeObj3RdrObjVx : 255|14@0+ (0.02,-128.0) [-128.0|128.0] "m/s" ASDM
 SG_ FrntSideRdrLeObj3RdrObjVxStdDe : 271|6@0+ (0.05,0.0) [0.0|2.0] "m/s" ASDM
 SG_ FrntSideRdrLeObj3RdrObjVy : 207|14@0+ (0.02,-128.0) [-128.0|128.0] "m/s" ASDM
 SG_ FrntSideRdrLeObj3RdrObjVyStdDe : 159|6@0+ (0.05,0.0) [0.0|2.0] "m/s" ASDM
 SG_ FrntSideRdrLeObj3RelVx : 135|12@0+ (0.02,-35.6) [-35.6|35.6] "m/s" ASDM
 SG_ FrntSideRdrLeObj3RelVy : 139|12@0+ (0.02,-35.6) [-35.6|35.6] "m/s" ASDM

BO_ 354 FSRLSafetyCANFD1Frame26 : 64 FSRL
 SG_ FrntSideRdrLeObj4_UB : 319|1@0+ (1,0) [0|1] "" ASDM
 SG_ FrntSideRdrLeObj4Heading : 287|12@0+ (0.1,-180.0) [-180.0|180.0] "Deg" ASDM
 SG_ FrntSideRdrLeObj4ObjBoxCenterLat : 23|9@0+ (0.1,-25.0) [-25.0|25.0] "m" ASDM
 SG_ FrntSideRdrLeObj4ObjBoxCenterLgt : 30|9@0+ (0.1,-25.0) [-25.0|25.0] "m" ASDM
 SG_ FrntSideRdrLeObj4ObservationHist : 63|32@0+ (1.0,0.0) [0.0|4294967295.0] "Unitless" ASDM
 SG_ FrntSideRdrLeObj4QualityBits : 289|18@0+ (1.0,0.0) [0.0|262143.0] "Unitless" ASDM
 SG_ FrntSideRdrLeObj4RdrObjAx : 7|8@0- (0.1,0.0) [-12.8|12.700000000000001] "m/s^2" ASDM
 SG_ FrntSideRdrLeObj4RdrObjAy : 15|8@0- (0.1,0.0) [-12.8|12.700000000000001] "m/s^2" ASDM
 SG_ FrntSideRdrLeObj4RdrObjBoxLength : 37|9@0+ (0.1,0.0) [0.0|50.0] "m" ASDM
 SG_ FrntSideRdrLeObj4RdrObjBoxWidth : 44|9@0+ (0.1,0.0) [0.0|50.0] "m" ASDM
 SG_ FrntSideRdrLeObj4RdrObjChks : 95|8@0+ (1.0,0.0) [0.0|255.0] "Unitless" ASDM
 SG_ FrntSideRdrLeObj4RdrObjCntr : 103|4@0+ (1.0,0.0) [0.0|15.0] "Unitless" ASDM
 SG_ FrntSideRdrLeObj4RdrObjCoastCnt : 279|5@0+ (1.0,0.0) [0.0|31.0] "Unitless" ASDM
 SG_ FrntSideRdrLeObj4RdrObjConf : 99|4@0+ (7.0,0.0) [0.0|105.0] "%" ASDM
 SG_ FrntSideRdrLeObj4RdrObjDx : 191|13@0+ (0.05,-200.0) [-200.0|200.0] "m" ASDM
 SG_ FrntSideRdrLeObj4RdrObjDxStdDe : 111|8@0+ (0.05,0.0) [0.0|12.700000000000001] "m" ASDM
 SG_ FrntSideRdrLeObj4RdrObjDy : 119|13@0+ (0.05,-200.0) [-200.0|200.0] "m" ASDM
 SG_ FrntSideRdrLeObj4RdrObjDyStdDe : 183|8@0+ (0.05,0.0) [0.0|12.700000000000001] "m" ASDM
 SG_ FrntSideRdrLeObj4RdrObjElevnConf : 223|4@0+ (7.0,0.0) [0.0|105.0] "%" ASDM
 SG_ FrntSideRdrLeObj4RdrObjElevnSts : 153|2@0+ (1,0) [0|3] "" ASDM
 SG_ FrntSideRdrLeObj4RdrObjID : 167|8@0+ (1.0,0.0) [0.0|255.0] "Unitless" ASDM
 SG_ FrntSideRdrLeObj4RdrObjIsInFreeSpace : 192|1@0+ (1,0) [0|1] "" ASDM
 SG_ FrntSideRdrLeObj4RdrObjMirrProblty : 219|4@0+ (7.0,0.0) [0.0|105.0] "%" ASDM
 SG_ FrntSideRdrLeObj4RdrObjMtnPat : 122|3@0+ (1,0) [0|7] "" ASDM
 SG_ FrntSideRdrLeObj4RdrObjNotRealProblty : 231|4@0+ (7.0,0.0) [0.0|105.0] "%" ASDM
 SG_ FrntSideRdrLeObj4RdrObjStatyCnt : 239|7@0+ (1.0,0.0) [0.0|127.0] "Unitless" ASDM
 SG_ FrntSideRdrLeObj4RdrObjTiAlv : 247|7@0+ (1.0,0.0) [0.0|127.0] "Unitless" ASDM
 SG_ FrntSideRdrLeObj4RdrObjTrackSts : 194|2@0+ (1,0) [0|3] "" ASDM
 SG_ FrntSideRdrLeObj4RdrObjTyp : 51|4@0+ (1,0) [0|15] "" ASDM
 SG_ FrntSideRdrLeObj4RdrObjTypConfBike : 175|4@0+ (7.0,0.0) [0.0|105.0] "%" ASDM
 SG_ FrntSideRdrLeObj4RdrObjTypConfPed : 171|4@0+ (7.0,0.0) [0.0|105.0] "%" ASDM
 SG_ FrntSideRdrLeObj4RdrObjTypConfVeh : 227|4@0+ (7.0,0.0) [0.0|105.0] "%" ASDM
 SG_ FrntSideRdrLeObj4RdrObjUsedTracker : 291|2@0+ (1,0) [0|3] "" ASDM
 SG_ FrntSideRdrLeObj4RdrObjVx : 255|14@0+ (0.02,-128.0) [-128.0|128.0] "m/s" ASDM
 SG_ FrntSideRdrLeObj4RdrObjVxStdDe : 271|6@0+ (0.05,0.0) [0.0|2.0] "m/s" ASDM
 SG_ FrntSideRdrLeObj4RdrObjVy : 207|14@0+ (0.02,-128.0) [-128.0|128.0] "m/s" ASDM
 SG_ FrntSideRdrLeObj4RdrObjVyStdDe : 159|6@0+ (0.05,0.0) [0.0|2.0] "m/s" ASDM
 SG_ FrntSideRdrLeObj4RelVx : 135|12@0+ (0.02,-35.6) [-35.6|35.6] "m/s" ASDM
 SG_ FrntSideRdrLeObj4RelVy : 139|12@0+ (0.02,-35.6) [-35.6|35.6] "m/s" ASDM

BO_ 356 FSRLSafetyCANFD1Frame27 : 64 FSRL
 SG_ FrntSideRdrLeObj5_UB : 319|1@0+ (1,0) [0|1] "" ASDM
 SG_ FrntSideRdrLeObj5Heading : 287|12@0+ (0.1,-180.0) [-180.0|180.0] "Deg" ASDM
 SG_ FrntSideRdrLeObj5ObjBoxCenterLat : 23|9@0+ (0.1,-25.0) [-25.0|25.0] "m" ASDM
 SG_ FrntSideRdrLeObj5ObjBoxCenterLgt : 30|9@0+ (0.1,-25.0) [-25.0|25.0] "m" ASDM
 SG_ FrntSideRdrLeObj5ObservationHist : 63|32@0+ (1.0,0.0) [0.0|4294967295.0] "Unitless" ASDM
 SG_ FrntSideRdrLeObj5QualityBits : 289|18@0+ (1.0,0.0) [0.0|262143.0] "Unitless" ASDM
 SG_ FrntSideRdrLeObj5RdrObjAx : 7|8@0- (0.1,0.0) [-12.8|12.700000000000001] "m/s^2" ASDM
 SG_ FrntSideRdrLeObj5RdrObjAy : 15|8@0- (0.1,0.0) [-12.8|12.700000000000001] "m/s^2" ASDM
 SG_ FrntSideRdrLeObj5RdrObjBoxLength : 37|9@0+ (0.1,0.0) [0.0|50.0] "m" ASDM
 SG_ FrntSideRdrLeObj5RdrObjBoxWidth : 44|9@0+ (0.1,0.0) [0.0|50.0] "m" ASDM
 SG_ FrntSideRdrLeObj5RdrObjChks : 95|8@0+ (1.0,0.0) [0.0|255.0] "Unitless" ASDM
 SG_ FrntSideRdrLeObj5RdrObjCntr : 103|4@0+ (1.0,0.0) [0.0|15.0] "Unitless" ASDM
 SG_ FrntSideRdrLeObj5RdrObjCoastCnt : 279|5@0+ (1.0,0.0) [0.0|31.0] "Unitless" ASDM
 SG_ FrntSideRdrLeObj5RdrObjConf : 99|4@0+ (7.0,0.0) [0.0|105.0] "%" ASDM
 SG_ FrntSideRdrLeObj5RdrObjDx : 191|13@0+ (0.05,-200.0) [-200.0|200.0] "m" ASDM
 SG_ FrntSideRdrLeObj5RdrObjDxStdDe : 111|8@0+ (0.05,0.0) [0.0|12.700000000000001] "m" ASDM
 SG_ FrntSideRdrLeObj5RdrObjDy : 119|13@0+ (0.05,-200.0) [-200.0|200.0] "m" ASDM
 SG_ FrntSideRdrLeObj5RdrObjDyStdDe : 183|8@0+ (0.05,0.0) [0.0|12.700000000000001] "m" ASDM
 SG_ FrntSideRdrLeObj5RdrObjElevnConf : 223|4@0+ (7.0,0.0) [0.0|105.0] "%" ASDM
 SG_ FrntSideRdrLeObj5RdrObjElevnSts : 153|2@0+ (1,0) [0|3] "" ASDM
 SG_ FrntSideRdrLeObj5RdrObjID : 167|8@0+ (1.0,0.0) [0.0|255.0] "Unitless" ASDM
 SG_ FrntSideRdrLeObj5RdrObjIsInFreeSpace : 192|1@0+ (1,0) [0|1] "" ASDM
 SG_ FrntSideRdrLeObj5RdrObjMirrProblty : 219|4@0+ (7.0,0.0) [0.0|105.0] "%" ASDM
 SG_ FrntSideRdrLeObj5RdrObjMtnPat : 122|3@0+ (1,0) [0|7] "" ASDM
 SG_ FrntSideRdrLeObj5RdrObjNotRealProblty : 231|4@0+ (7.0,0.0) [0.0|105.0] "%" ASDM
 SG_ FrntSideRdrLeObj5RdrObjStatyCnt : 239|7@0+ (1.0,0.0) [0.0|127.0] "Unitless" ASDM
 SG_ FrntSideRdrLeObj5RdrObjTiAlv : 247|7@0+ (1.0,0.0) [0.0|127.0] "Unitless" ASDM
 SG_ FrntSideRdrLeObj5RdrObjTrackSts : 194|2@0+ (1,0) [0|3] "" ASDM
 SG_ FrntSideRdrLeObj5RdrObjTyp : 51|4@0+ (1,0) [0|15] "" ASDM
 SG_ FrntSideRdrLeObj5RdrObjTypConfBike : 175|4@0+ (7.0,0.0) [0.0|105.0] "%" ASDM
 SG_ FrntSideRdrLeObj5RdrObjTypConfPed : 171|4@0+ (7.0,0.0) [0.0|105.0] "%" ASDM
 SG_ FrntSideRdrLeObj5RdrObjTypConfVeh : 227|4@0+ (7.0,0.0) [0.0|105.0] "%" ASDM
 SG_ FrntSideRdrLeObj5RdrObjUsedTracker : 291|2@0+ (1,0) [0|3] "" ASDM
 SG_ FrntSideRdrLeObj5RdrObjVx : 255|14@0+ (0.02,-128.0) [-128.0|128.0] "m/s" ASDM
 SG_ FrntSideRdrLeObj5RdrObjVxStdDe : 271|6@0+ (0.05,0.0) [0.0|2.0] "m/s" ASDM
 SG_ FrntSideRdrLeObj5RdrObjVy : 207|14@0+ (0.02,-128.0) [-128.0|128.0] "m/s" ASDM
 SG_ FrntSideRdrLeObj5RdrObjVyStdDe : 159|6@0+ (0.05,0.0) [0.0|2.0] "m/s" ASDM
 SG_ FrntSideRdrLeObj5RelVx : 135|12@0+ (0.02,-35.6) [-35.6|35.6] "m/s" ASDM
 SG_ FrntSideRdrLeObj5RelVy : 139|12@0+ (0.02,-35.6) [-35.6|35.6] "m/s" ASDM

BO_ 358 FSRLSafetyCANFD1Frame28 : 64 FSRL
 SG_ FrntSideRdrLeObj6_UB : 319|1@0+ (1,0) [0|1] "" ASDM
 SG_ FrntSideRdrLeObj6Heading : 287|12@0+ (0.1,-180.0) [-180.0|180.0] "Deg" ASDM
 SG_ FrntSideRdrLeObj6ObjBoxCenterLat : 23|9@0+ (0.1,-25.0) [-25.0|25.0] "m" ASDM
 SG_ FrntSideRdrLeObj6ObjBoxCenterLgt : 30|9@0+ (0.1,-25.0) [-25.0|25.0] "m" ASDM
 SG_ FrntSideRdrLeObj6ObservationHist : 63|32@0+ (1.0,0.0) [0.0|4294967295.0] "Unitless" ASDM
 SG_ FrntSideRdrLeObj6QualityBits : 289|18@0+ (1.0,0.0) [0.0|262143.0] "Unitless" ASDM
 SG_ FrntSideRdrLeObj6RdrObjAx : 7|8@0- (0.1,0.0) [-12.8|12.700000000000001] "m/s^2" ASDM
 SG_ FrntSideRdrLeObj6RdrObjAy : 15|8@0- (0.1,0.0) [-12.8|12.700000000000001] "m/s^2" ASDM
 SG_ FrntSideRdrLeObj6RdrObjBoxLength : 37|9@0+ (0.1,0.0) [0.0|50.0] "m" ASDM
 SG_ FrntSideRdrLeObj6RdrObjBoxWidth : 44|9@0+ (0.1,0.0) [0.0|50.0] "m" ASDM
 SG_ FrntSideRdrLeObj6RdrObjChks : 95|8@0+ (1.0,0.0) [0.0|255.0] "Unitless" ASDM
 SG_ FrntSideRdrLeObj6RdrObjCntr : 103|4@0+ (1.0,0.0) [0.0|15.0] "Unitless" ASDM
 SG_ FrntSideRdrLeObj6RdrObjCoastCnt : 279|5@0+ (1.0,0.0) [0.0|31.0] "Unitless" ASDM
 SG_ FrntSideRdrLeObj6RdrObjConf : 99|4@0+ (7.0,0.0) [0.0|105.0] "%" ASDM
 SG_ FrntSideRdrLeObj6RdrObjDx : 191|13@0+ (0.05,-200.0) [-200.0|200.0] "m" ASDM
 SG_ FrntSideRdrLeObj6RdrObjDxStdDe : 111|8@0+ (0.05,0.0) [0.0|12.700000000000001] "m" ASDM
 SG_ FrntSideRdrLeObj6RdrObjDy : 119|13@0+ (0.05,-200.0) [-200.0|200.0] "m" ASDM
 SG_ FrntSideRdrLeObj6RdrObjDyStdDe : 183|8@0+ (0.05,0.0) [0.0|12.700000000000001] "m" ASDM
 SG_ FrntSideRdrLeObj6RdrObjElevnConf : 223|4@0+ (7.0,0.0) [0.0|105.0] "%" ASDM
 SG_ FrntSideRdrLeObj6RdrObjElevnSts : 153|2@0+ (1,0) [0|3] "" ASDM
 SG_ FrntSideRdrLeObj6RdrObjID : 167|8@0+ (1.0,0.0) [0.0|255.0] "Unitless" ASDM
 SG_ FrntSideRdrLeObj6RdrObjIsInFreeSpace : 192|1@0+ (1,0) [0|1] "" ASDM
 SG_ FrntSideRdrLeObj6RdrObjMirrProblty : 219|4@0+ (7.0,0.0) [0.0|105.0] "%" ASDM
 SG_ FrntSideRdrLeObj6RdrObjMtnPat : 122|3@0+ (1,0) [0|7] "" ASDM
 SG_ FrntSideRdrLeObj6RdrObjNotRealProblty : 231|4@0+ (7.0,0.0) [0.0|105.0] "%" ASDM
 SG_ FrntSideRdrLeObj6RdrObjStatyCnt : 239|7@0+ (1.0,0.0) [0.0|127.0] "Unitless" ASDM
 SG_ FrntSideRdrLeObj6RdrObjTiAlv : 247|7@0+ (1.0,0.0) [0.0|127.0] "Unitless" ASDM
 SG_ FrntSideRdrLeObj6RdrObjTrackSts : 194|2@0+ (1,0) [0|3] "" ASDM
 SG_ FrntSideRdrLeObj6RdrObjTyp : 51|4@0+ (1,0) [0|15] "" ASDM
 SG_ FrntSideRdrLeObj6RdrObjTypConfBike : 175|4@0+ (7.0,0.0) [0.0|105.0] "%" ASDM
 SG_ FrntSideRdrLeObj6RdrObjTypConfPed : 171|4@0+ (7.0,0.0) [0.0|105.0] "%" ASDM
 SG_ FrntSideRdrLeObj6RdrObjTypConfVeh : 227|4@0+ (7.0,0.0) [0.0|105.0] "%" ASDM
 SG_ FrntSideRdrLeObj6RdrObjUsedTracker : 291|2@0+ (1,0) [0|3] "" ASDM
 SG_ FrntSideRdrLeObj6RdrObjVx : 255|14@0+ (0.02,-128.0) [-128.0|128.0] "m/s" ASDM
 SG_ FrntSideRdrLeObj6RdrObjVxStdDe : 271|6@0+ (0.05,0.0) [0.0|2.0] "m/s" ASDM
 SG_ FrntSideRdrLeObj6RdrObjVy : 207|14@0+ (0.02,-128.0) [-128.0|128.0] "m/s" ASDM
 SG_ FrntSideRdrLeObj6RdrObjVyStdDe : 159|6@0+ (0.05,0.0) [0.0|2.0] "m/s" ASDM
 SG_ FrntSideRdrLeObj6RelVx : 135|12@0+ (0.02,-35.6) [-35.6|35.6] "m/s" ASDM
 SG_ FrntSideRdrLeObj6RelVy : 139|12@0+ (0.02,-35.6) [-35.6|35.6] "m/s" ASDM

BO_ 360 FSRLSafetyCANFD1Frame29 : 64 FSRL
 SG_ FrntSideRdrLeObj7_UB : 319|1@0+ (1,0) [0|1] "" ASDM
 SG_ FrntSideRdrLeObj7Heading : 287|12@0+ (0.1,-180.0) [-180.0|180.0] "Deg" ASDM
 SG_ FrntSideRdrLeObj7ObjBoxCenterLat : 23|9@0+ (0.1,-25.0) [-25.0|25.0] "m" ASDM
 SG_ FrntSideRdrLeObj7ObjBoxCenterLgt : 30|9@0+ (0.1,-25.0) [-25.0|25.0] "m" ASDM
 SG_ FrntSideRdrLeObj7ObservationHist : 63|32@0+ (1.0,0.0) [0.0|4294967295.0] "Unitless" ASDM
 SG_ FrntSideRdrLeObj7QualityBits : 289|18@0+ (1.0,0.0) [0.0|262143.0] "Unitless" ASDM
 SG_ FrntSideRdrLeObj7RdrObjAx : 7|8@0- (0.1,0.0) [-12.8|12.700000000000001] "m/s^2" ASDM
 SG_ FrntSideRdrLeObj7RdrObjAy : 15|8@0- (0.1,0.0) [-12.8|12.700000000000001] "m/s^2" ASDM
 SG_ FrntSideRdrLeObj7RdrObjBoxLength : 37|9@0+ (0.1,0.0) [0.0|50.0] "m" ASDM
 SG_ FrntSideRdrLeObj7RdrObjBoxWidth : 44|9@0+ (0.1,0.0) [0.0|50.0] "m" ASDM
 SG_ FrntSideRdrLeObj7RdrObjChks : 95|8@0+ (1.0,0.0) [0.0|255.0] "Unitless" ASDM
 SG_ FrntSideRdrLeObj7RdrObjCntr : 103|4@0+ (1.0,0.0) [0.0|15.0] "Unitless" ASDM
 SG_ FrntSideRdrLeObj7RdrObjCoastCnt : 279|5@0+ (1.0,0.0) [0.0|31.0] "Unitless" ASDM
 SG_ FrntSideRdrLeObj7RdrObjConf : 99|4@0+ (7.0,0.0) [0.0|105.0] "%" ASDM
 SG_ FrntSideRdrLeObj7RdrObjDx : 191|13@0+ (0.05,-200.0) [-200.0|200.0] "m" ASDM
 SG_ FrntSideRdrLeObj7RdrObjDxStdDe : 111|8@0+ (0.05,0.0) [0.0|12.700000000000001] "m" ASDM
 SG_ FrntSideRdrLeObj7RdrObjDy : 119|13@0+ (0.05,-200.0) [-200.0|200.0] "m" ASDM
 SG_ FrntSideRdrLeObj7RdrObjDyStdDe : 183|8@0+ (0.05,0.0) [0.0|12.700000000000001] "m" ASDM
 SG_ FrntSideRdrLeObj7RdrObjElevnConf : 223|4@0+ (7.0,0.0) [0.0|105.0] "%" ASDM
 SG_ FrntSideRdrLeObj7RdrObjElevnSts : 153|2@0+ (1,0) [0|3] "" ASDM
 SG_ FrntSideRdrLeObj7RdrObjID : 167|8@0+ (1.0,0.0) [0.0|255.0] "Unitless" ASDM
 SG_ FrntSideRdrLeObj7RdrObjIsInFreeSpace : 192|1@0+ (1,0) [0|1] "" ASDM
 SG_ FrntSideRdrLeObj7RdrObjMirrProblty : 219|4@0+ (7.0,0.0) [0.0|105.0] "%" ASDM
 SG_ FrntSideRdrLeObj7RdrObjMtnPat : 122|3@0+ (1,0) [0|7] "" ASDM
 SG_ FrntSideRdrLeObj7RdrObjNotRealProblty : 231|4@0+ (7.0,0.0) [0.0|105.0] "%" ASDM
 SG_ FrntSideRdrLeObj7RdrObjStatyCnt : 239|7@0+ (1.0,0.0) [0.0|127.0] "Unitless" ASDM
 SG_ FrntSideRdrLeObj7RdrObjTiAlv : 247|7@0+ (1.0,0.0) [0.0|127.0] "Unitless" ASDM
 SG_ FrntSideRdrLeObj7RdrObjTrackSts : 194|2@0+ (1,0) [0|3] "" ASDM
 SG_ FrntSideRdrLeObj7RdrObjTyp : 51|4@0+ (1,0) [0|15] "" ASDM
 SG_ FrntSideRdrLeObj7RdrObjTypConfBike : 175|4@0+ (7.0,0.0) [0.0|105.0] "%" ASDM
 SG_ FrntSideRdrLeObj7RdrObjTypConfPed : 171|4@0+ (7.0,0.0) [0.0|105.0] "%" ASDM
 SG_ FrntSideRdrLeObj7RdrObjTypConfVeh : 227|4@0+ (7.0,0.0) [0.0|105.0] "%" ASDM
 SG_ FrntSideRdrLeObj7RdrObjUsedTracker : 291|2@0+ (1,0) [0|3] "" ASDM
 SG_ FrntSideRdrLeObj7RdrObjVx : 255|14@0+ (0.02,-128.0) [-128.0|128.0] "m/s" ASDM
 SG_ FrntSideRdrLeObj7RdrObjVxStdDe : 271|6@0+ (0.05,0.0) [0.0|2.0] "m/s" ASDM
 SG_ FrntSideRdrLeObj7RdrObjVy : 207|14@0+ (0.02,-128.0) [-128.0|128.0] "m/s" ASDM
 SG_ FrntSideRdrLeObj7RdrObjVyStdDe : 159|6@0+ (0.05,0.0) [0.0|2.0] "m/s" ASDM
 SG_ FrntSideRdrLeObj7RelVx : 135|12@0+ (0.02,-35.6) [-35.6|35.6] "m/s" ASDM
 SG_ FrntSideRdrLeObj7RelVy : 139|12@0+ (0.02,-35.6) [-35.6|35.6] "m/s" ASDM

BO_ 362 FSRLSafetyCANFD1Frame30 : 64 FSRL
 SG_ FrntSideRdrLeObj8_UB : 319|1@0+ (1,0) [0|1] "" ASDM
 SG_ FrntSideRdrLeObj8Heading : 287|12@0+ (0.1,-180.0) [-180.0|180.0] "Deg" ASDM
 SG_ FrntSideRdrLeObj8ObjBoxCenterLat : 23|9@0+ (0.1,-25.0) [-25.0|25.0] "m" ASDM
 SG_ FrntSideRdrLeObj8ObjBoxCenterLgt : 30|9@0+ (0.1,-25.0) [-25.0|25.0] "m" ASDM
 SG_ FrntSideRdrLeObj8ObservationHist : 63|32@0+ (1.0,0.0) [0.0|4294967295.0] "Unitless" ASDM
 SG_ FrntSideRdrLeObj8QualityBits : 289|18@0+ (1.0,0.0) [0.0|262143.0] "Unitless" ASDM
 SG_ FrntSideRdrLeObj8RdrObjAx : 7|8@0- (0.1,0.0) [-12.8|12.700000000000001] "m/s^2" ASDM
 SG_ FrntSideRdrLeObj8RdrObjAy : 15|8@0- (0.1,0.0) [-12.8|12.700000000000001] "m/s^2" ASDM
 SG_ FrntSideRdrLeObj8RdrObjBoxLength : 37|9@0+ (0.1,0.0) [0.0|50.0] "m" ASDM
 SG_ FrntSideRdrLeObj8RdrObjBoxWidth : 44|9@0+ (0.1,0.0) [0.0|50.0] "m" ASDM
 SG_ FrntSideRdrLeObj8RdrObjChks : 95|8@0+ (1.0,0.0) [0.0|255.0] "Unitless" ASDM
 SG_ FrntSideRdrLeObj8RdrObjCntr : 103|4@0+ (1.0,0.0) [0.0|15.0] "Unitless" ASDM
 SG_ FrntSideRdrLeObj8RdrObjCoastCnt : 279|5@0+ (1.0,0.0) [0.0|31.0] "Unitless" ASDM
 SG_ FrntSideRdrLeObj8RdrObjConf : 99|4@0+ (7.0,0.0) [0.0|105.0] "%" ASDM
 SG_ FrntSideRdrLeObj8RdrObjDx : 191|13@0+ (0.05,-200.0) [-200.0|200.0] "m" ASDM
 SG_ FrntSideRdrLeObj8RdrObjDxStdDe : 111|8@0+ (0.05,0.0) [0.0|12.700000000000001] "m" ASDM
 SG_ FrntSideRdrLeObj8RdrObjDy : 119|13@0+ (0.05,-200.0) [-200.0|200.0] "m" ASDM
 SG_ FrntSideRdrLeObj8RdrObjDyStdDe : 183|8@0+ (0.05,0.0) [0.0|12.700000000000001] "m" ASDM
 SG_ FrntSideRdrLeObj8RdrObjElevnConf : 223|4@0+ (7.0,0.0) [0.0|105.0] "%" ASDM
 SG_ FrntSideRdrLeObj8RdrObjElevnSts : 153|2@0+ (1,0) [0|3] "" ASDM
 SG_ FrntSideRdrLeObj8RdrObjID : 167|8@0+ (1.0,0.0) [0.0|255.0] "Unitless" ASDM
 SG_ FrntSideRdrLeObj8RdrObjIsInFreeSpace : 192|1@0+ (1,0) [0|1] "" ASDM
 SG_ FrntSideRdrLeObj8RdrObjMirrProblty : 219|4@0+ (7.0,0.0) [0.0|105.0] "%" ASDM
 SG_ FrntSideRdrLeObj8RdrObjMtnPat : 122|3@0+ (1,0) [0|7] "" ASDM
 SG_ FrntSideRdrLeObj8RdrObjNotRealProblty : 231|4@0+ (7.0,0.0) [0.0|105.0] "%" ASDM
 SG_ FrntSideRdrLeObj8RdrObjStatyCnt : 239|7@0+ (1.0,0.0) [0.0|127.0] "Unitless" ASDM
 SG_ FrntSideRdrLeObj8RdrObjTiAlv : 247|7@0+ (1.0,0.0) [0.0|127.0] "Unitless" ASDM
 SG_ FrntSideRdrLeObj8RdrObjTrackSts : 194|2@0+ (1,0) [0|3] "" ASDM
 SG_ FrntSideRdrLeObj8RdrObjTyp : 51|4@0+ (1,0) [0|15] "" ASDM
 SG_ FrntSideRdrLeObj8RdrObjTypConfBike : 175|4@0+ (7.0,0.0) [0.0|105.0] "%" ASDM
 SG_ FrntSideRdrLeObj8RdrObjTypConfPed : 171|4@0+ (7.0,0.0) [0.0|105.0] "%" ASDM
 SG_ FrntSideRdrLeObj8RdrObjTypConfVeh : 227|4@0+ (7.0,0.0) [0.0|105.0] "%" ASDM
 SG_ FrntSideRdrLeObj8RdrObjUsedTracker : 291|2@0+ (1,0) [0|3] "" ASDM
 SG_ FrntSideRdrLeObj8RdrObjVx : 255|14@0+ (0.02,-128.0) [-128.0|128.0] "m/s" ASDM
 SG_ FrntSideRdrLeObj8RdrObjVxStdDe : 271|6@0+ (0.05,0.0) [0.0|2.0] "m/s" ASDM
 SG_ FrntSideRdrLeObj8RdrObjVy : 207|14@0+ (0.02,-128.0) [-128.0|128.0] "m/s" ASDM
 SG_ FrntSideRdrLeObj8RdrObjVyStdDe : 159|6@0+ (0.05,0.0) [0.0|2.0] "m/s" ASDM
 SG_ FrntSideRdrLeObj8RelVx : 135|12@0+ (0.02,-35.6) [-35.6|35.6] "m/s" ASDM
 SG_ FrntSideRdrLeObj8RelVy : 139|12@0+ (0.02,-35.6) [-35.6|35.6] "m/s" ASDM

BO_ 364 FSRLSafetyCANFD1Frame31 : 64 FSRL
 SG_ FrntSideRdrLeObj9_UB : 319|1@0+ (1,0) [0|1] "" ASDM
 SG_ FrntSideRdrLeObj9Heading : 287|12@0+ (0.1,-180.0) [-180.0|180.0] "Deg" ASDM
 SG_ FrntSideRdrLeObj9ObjBoxCenterLat : 23|9@0+ (0.1,-25.0) [-25.0|25.0] "m" ASDM
 SG_ FrntSideRdrLeObj9ObjBoxCenterLgt : 30|9@0+ (0.1,-25.0) [-25.0|25.0] "m" ASDM
 SG_ FrntSideRdrLeObj9ObservationHist : 63|32@0+ (1.0,0.0) [0.0|4294967295.0] "Unitless" ASDM
 SG_ FrntSideRdrLeObj9QualityBits : 289|18@0+ (1.0,0.0) [0.0|262143.0] "Unitless" ASDM
 SG_ FrntSideRdrLeObj9RdrObjAx : 7|8@0- (0.1,0.0) [-12.8|12.700000000000001] "m/s^2" ASDM
 SG_ FrntSideRdrLeObj9RdrObjAy : 15|8@0- (0.1,0.0) [-12.8|12.700000000000001] "m/s^2" ASDM
 SG_ FrntSideRdrLeObj9RdrObjBoxLength : 37|9@0+ (0.1,0.0) [0.0|50.0] "m" ASDM
 SG_ FrntSideRdrLeObj9RdrObjBoxWidth : 44|9@0+ (0.1,0.0) [0.0|50.0] "m" ASDM
 SG_ FrntSideRdrLeObj9RdrObjChks : 95|8@0+ (1.0,0.0) [0.0|255.0] "Unitless" ASDM
 SG_ FrntSideRdrLeObj9RdrObjCntr : 103|4@0+ (1.0,0.0) [0.0|15.0] "Unitless" ASDM
 SG_ FrntSideRdrLeObj9RdrObjCoastCnt : 279|5@0+ (1.0,0.0) [0.0|31.0] "Unitless" ASDM
 SG_ FrntSideRdrLeObj9RdrObjConf : 99|4@0+ (7.0,0.0) [0.0|105.0] "%" ASDM
 SG_ FrntSideRdrLeObj9RdrObjDx : 191|13@0+ (0.05,-200.0) [-200.0|200.0] "m" ASDM
 SG_ FrntSideRdrLeObj9RdrObjDxStdDe : 111|8@0+ (0.05,0.0) [0.0|12.700000000000001] "m" ASDM
 SG_ FrntSideRdrLeObj9RdrObjDy : 119|13@0+ (0.05,-200.0) [-200.0|200.0] "m" ASDM
 SG_ FrntSideRdrLeObj9RdrObjDyStdDe : 183|8@0+ (0.05,0.0) [0.0|12.700000000000001] "m" ASDM
 SG_ FrntSideRdrLeObj9RdrObjElevnConf : 223|4@0+ (7.0,0.0) [0.0|105.0] "%" ASDM
 SG_ FrntSideRdrLeObj9RdrObjElevnSts : 153|2@0+ (1,0) [0|3] "" ASDM
 SG_ FrntSideRdrLeObj9RdrObjID : 167|8@0+ (1.0,0.0) [0.0|255.0] "Unitless" ASDM
 SG_ FrntSideRdrLeObj9RdrObjIsInFreeSpace : 192|1@0+ (1,0) [0|1] "" ASDM
 SG_ FrntSideRdrLeObj9RdrObjMirrProblty : 219|4@0+ (7.0,0.0) [0.0|105.0] "%" ASDM
 SG_ FrntSideRdrLeObj9RdrObjMtnPat : 122|3@0+ (1,0) [0|7] "" ASDM
 SG_ FrntSideRdrLeObj9RdrObjNotRealProblty : 231|4@0+ (7.0,0.0) [0.0|105.0] "%" ASDM
 SG_ FrntSideRdrLeObj9RdrObjStatyCnt : 239|7@0+ (1.0,0.0) [0.0|127.0] "Unitless" ASDM
 SG_ FrntSideRdrLeObj9RdrObjTiAlv : 247|7@0+ (1.0,0.0) [0.0|127.0] "Unitless" ASDM
 SG_ FrntSideRdrLeObj9RdrObjTrackSts : 194|2@0+ (1,0) [0|3] "" ASDM
 SG_ FrntSideRdrLeObj9RdrObjTyp : 51|4@0+ (1,0) [0|15] "" ASDM
 SG_ FrntSideRdrLeObj9RdrObjTypConfBike : 175|4@0+ (7.0,0.0) [0.0|105.0] "%" ASDM
 SG_ FrntSideRdrLeObj9RdrObjTypConfPed : 171|4@0+ (7.0,0.0) [0.0|105.0] "%" ASDM
 SG_ FrntSideRdrLeObj9RdrObjTypConfVeh : 227|4@0+ (7.0,0.0) [0.0|105.0] "%" ASDM
 SG_ FrntSideRdrLeObj9RdrObjUsedTracker : 291|2@0+ (1,0) [0|3] "" ASDM
 SG_ FrntSideRdrLeObj9RdrObjVx : 255|14@0+ (0.02,-128.0) [-128.0|128.0] "m/s" ASDM
 SG_ FrntSideRdrLeObj9RdrObjVxStdDe : 271|6@0+ (0.05,0.0) [0.0|2.0] "m/s" ASDM
 SG_ FrntSideRdrLeObj9RdrObjVy : 207|14@0+ (0.02,-128.0) [-128.0|128.0] "m/s" ASDM
 SG_ FrntSideRdrLeObj9RdrObjVyStdDe : 159|6@0+ (0.05,0.0) [0.0|2.0] "m/s" ASDM
 SG_ FrntSideRdrLeObj9RelVx : 135|12@0+ (0.02,-35.6) [-35.6|35.6] "m/s" ASDM
 SG_ FrntSideRdrLeObj9RelVy : 139|12@0+ (0.02,-35.6) [-35.6|35.6] "m/s" ASDM

BO_ 366 FSRLSafetyCANFD1Frame32 : 64 FSRL
 SG_ FrntSideRdrLeObj10_UB : 319|1@0+ (1,0) [0|1] "" ASDM
 SG_ FrntSideRdrLeObj10Heading : 287|12@0+ (0.1,-180.0) [-180.0|180.0] "Deg" ASDM
 SG_ FrntSideRdrLeObj10ObjBoxCenterLat : 23|9@0+ (0.1,-25.0) [-25.0|25.0] "m" ASDM
 SG_ FrntSideRdrLeObj10ObjBoxCenterLgt : 30|9@0+ (0.1,-25.0) [-25.0|25.0] "m" ASDM
 SG_ FrntSideRdrLeObj10ObservationHist : 63|32@0+ (1.0,0.0) [0.0|4294967295.0] "Unitless" ASDM
 SG_ FrntSideRdrLeObj10QualityBits : 289|18@0+ (1.0,0.0) [0.0|262143.0] "Unitless" ASDM
 SG_ FrntSideRdrLeObj10RdrObjAx : 7|8@0- (0.1,0.0) [-12.8|12.700000000000001] "m/s^2" ASDM
 SG_ FrntSideRdrLeObj10RdrObjAy : 15|8@0- (0.1,0.0) [-12.8|12.700000000000001] "m/s^2" ASDM
 SG_ FrntSideRdrLeObj10RdrObjBoxLength : 37|9@0+ (0.1,0.0) [0.0|50.0] "m" ASDM
 SG_ FrntSideRdrLeObj10RdrObjBoxWidth : 44|9@0+ (0.1,0.0) [0.0|50.0] "m" ASDM
 SG_ FrntSideRdrLeObj10RdrObjChks : 95|8@0+ (1.0,0.0) [0.0|255.0] "Unitless" ASDM
 SG_ FrntSideRdrLeObj10RdrObjCntr : 103|4@0+ (1.0,0.0) [0.0|15.0] "Unitless" ASDM
 SG_ FrntSideRdrLeObj10RdrObjCoastCnt : 279|5@0+ (1.0,0.0) [0.0|31.0] "Unitless" ASDM
 SG_ FrntSideRdrLeObj10RdrObjConf : 99|4@0+ (7.0,0.0) [0.0|105.0] "%" ASDM
 SG_ FrntSideRdrLeObj10RdrObjDx : 191|13@0+ (0.05,-200.0) [-200.0|200.0] "m" ASDM
 SG_ FrntSideRdrLeObj10RdrObjDxStdDe : 111|8@0+ (0.05,0.0) [0.0|12.700000000000001] "m" ASDM
 SG_ FrntSideRdrLeObj10RdrObjDy : 119|13@0+ (0.05,-200.0) [-200.0|200.0] "m" ASDM
 SG_ FrntSideRdrLeObj10RdrObjDyStdDe : 183|8@0+ (0.05,0.0) [0.0|12.700000000000001] "m" ASDM
 SG_ FrntSideRdrLeObj10RdrObjElevnConf : 223|4@0+ (7.0,0.0) [0.0|105.0] "%" ASDM
 SG_ FrntSideRdrLeObj10RdrObjElevnSts : 153|2@0+ (1,0) [0|3] "" ASDM
 SG_ FrntSideRdrLeObj10RdrObjID : 167|8@0+ (1.0,0.0) [0.0|255.0] "Unitless" ASDM
 SG_ FrntSideRdrLeObj10RdrObjIsInFreeSpace : 192|1@0+ (1,0) [0|1] "" ASDM
 SG_ FrntSideRdrLeObj10RdrObjMirrProblty : 219|4@0+ (7.0,0.0) [0.0|105.0] "%" ASDM
 SG_ FrntSideRdrLeObj10RdrObjMtnPat : 122|3@0+ (1,0) [0|7] "" ASDM
 SG_ FrntSideRdrLeObj10RdrObjNotRealProblty : 231|4@0+ (7.0,0.0) [0.0|105.0] "%" ASDM
 SG_ FrntSideRdrLeObj10RdrObjStatyCnt : 239|7@0+ (1.0,0.0) [0.0|127.0] "Unitless" ASDM
 SG_ FrntSideRdrLeObj10RdrObjTiAlv : 247|7@0+ (1.0,0.0) [0.0|127.0] "Unitless" ASDM
 SG_ FrntSideRdrLeObj10RdrObjTrackSts : 194|2@0+ (1,0) [0|3] "" ASDM
 SG_ FrntSideRdrLeObj10RdrObjTyp : 51|4@0+ (1,0) [0|15] "" ASDM
 SG_ FrntSideRdrLeObj10RdrObjTypConfBike : 175|4@0+ (7.0,0.0) [0.0|105.0] "%" ASDM
 SG_ FrntSideRdrLeObj10RdrObjTypConfPed : 171|4@0+ (7.0,0.0) [0.0|105.0] "%" ASDM
 SG_ FrntSideRdrLeObj10RdrObjTypConfVeh : 227|4@0+ (7.0,0.0) [0.0|105.0] "%" ASDM
 SG_ FrntSideRdrLeObj10RdrObjUsedTracker : 291|2@0+ (1,0) [0|3] "" ASDM
 SG_ FrntSideRdrLeObj10RdrObjVx : 255|14@0+ (0.02,-128.0) [-128.0|128.0] "m/s" ASDM
 SG_ FrntSideRdrLeObj10RdrObjVxStdDe : 271|6@0+ (0.05,0.0) [0.0|2.0] "m/s" ASDM
 SG_ FrntSideRdrLeObj10RdrObjVy : 207|14@0+ (0.02,-128.0) [-128.0|128.0] "m/s" ASDM
 SG_ FrntSideRdrLeObj10RdrObjVyStdDe : 159|6@0+ (0.05,0.0) [0.0|2.0] "m/s" ASDM
 SG_ FrntSideRdrLeObj10RelVx : 135|12@0+ (0.02,-35.6) [-35.6|35.6] "m/s" ASDM
 SG_ FrntSideRdrLeObj10RelVy : 139|12@0+ (0.02,-35.6) [-35.6|35.6] "m/s" ASDM

BO_ 368 FSRLSafetyCANFD1Frame33 : 64 FSRL
 SG_ FrntSideRdrLeObj11_UB : 319|1@0+ (1,0) [0|1] "" ASDM
 SG_ FrntSideRdrLeObj11Heading : 287|12@0+ (0.1,-180.0) [-180.0|180.0] "Deg" ASDM
 SG_ FrntSideRdrLeObj11ObjBoxCenterLat : 23|9@0+ (0.1,-25.0) [-25.0|25.0] "m" ASDM
 SG_ FrntSideRdrLeObj11ObjBoxCenterLgt : 30|9@0+ (0.1,-25.0) [-25.0|25.0] "m" ASDM
 SG_ FrntSideRdrLeObj11ObservationHist : 63|32@0+ (1.0,0.0) [0.0|4294967295.0] "Unitless" ASDM
 SG_ FrntSideRdrLeObj11QualityBits : 289|18@0+ (1.0,0.0) [0.0|262143.0] "Unitless" ASDM
 SG_ FrntSideRdrLeObj11RdrObjAx : 7|8@0- (0.1,0.0) [-12.8|12.700000000000001] "m/s^2" ASDM
 SG_ FrntSideRdrLeObj11RdrObjAy : 15|8@0- (0.1,0.0) [-12.8|12.700000000000001] "m/s^2" ASDM
 SG_ FrntSideRdrLeObj11RdrObjBoxLength : 37|9@0+ (0.1,0.0) [0.0|50.0] "m" ASDM
 SG_ FrntSideRdrLeObj11RdrObjBoxWidth : 44|9@0+ (0.1,0.0) [0.0|50.0] "m" ASDM
 SG_ FrntSideRdrLeObj11RdrObjChks : 95|8@0+ (1.0,0.0) [0.0|255.0] "Unitless" ASDM
 SG_ FrntSideRdrLeObj11RdrObjCntr : 103|4@0+ (1.0,0.0) [0.0|15.0] "Unitless" ASDM
 SG_ FrntSideRdrLeObj11RdrObjCoastCnt : 279|5@0+ (1.0,0.0) [0.0|31.0] "Unitless" ASDM
 SG_ FrntSideRdrLeObj11RdrObjConf : 99|4@0+ (7.0,0.0) [0.0|105.0] "%" ASDM
 SG_ FrntSideRdrLeObj11RdrObjDx : 191|13@0+ (0.05,-200.0) [-200.0|200.0] "m" ASDM
 SG_ FrntSideRdrLeObj11RdrObjDxStdDe : 111|8@0+ (0.05,0.0) [0.0|12.700000000000001] "m" ASDM
 SG_ FrntSideRdrLeObj11RdrObjDy : 119|13@0+ (0.05,-200.0) [-200.0|200.0] "m" ASDM
 SG_ FrntSideRdrLeObj11RdrObjDyStdDe : 183|8@0+ (0.05,0.0) [0.0|12.700000000000001] "m" ASDM
 SG_ FrntSideRdrLeObj11RdrObjElevnConf : 223|4@0+ (7.0,0.0) [0.0|105.0] "%" ASDM
 SG_ FrntSideRdrLeObj11RdrObjElevnSts : 153|2@0+ (1,0) [0|3] "" ASDM
 SG_ FrntSideRdrLeObj11RdrObjID : 167|8@0+ (1.0,0.0) [0.0|255.0] "Unitless" ASDM
 SG_ FrntSideRdrLeObj11RdrObjIsInFreeSpace : 192|1@0+ (1,0) [0|1] "" ASDM
 SG_ FrntSideRdrLeObj11RdrObjMirrProblty : 219|4@0+ (7.0,0.0) [0.0|105.0] "%" ASDM
 SG_ FrntSideRdrLeObj11RdrObjMtnPat : 122|3@0+ (1,0) [0|7] "" ASDM
 SG_ FrntSideRdrLeObj11RdrObjNotRealProblty : 231|4@0+ (7.0,0.0) [0.0|105.0] "%" ASDM
 SG_ FrntSideRdrLeObj11RdrObjStatyCnt : 239|7@0+ (1.0,0.0) [0.0|127.0] "Unitless" ASDM
 SG_ FrntSideRdrLeObj11RdrObjTiAlv : 247|7@0+ (1.0,0.0) [0.0|127.0] "Unitless" ASDM
 SG_ FrntSideRdrLeObj11RdrObjTrackSts : 194|2@0+ (1,0) [0|3] "" ASDM
 SG_ FrntSideRdrLeObj11RdrObjTyp : 51|4@0+ (1,0) [0|15] "" ASDM
 SG_ FrntSideRdrLeObj11RdrObjTypConfBike : 175|4@0+ (7.0,0.0) [0.0|105.0] "%" ASDM
 SG_ FrntSideRdrLeObj11RdrObjTypConfPed : 171|4@0+ (7.0,0.0) [0.0|105.0] "%" ASDM
 SG_ FrntSideRdrLeObj11RdrObjTypConfVeh : 227|4@0+ (7.0,0.0) [0.0|105.0] "%" ASDM
 SG_ FrntSideRdrLeObj11RdrObjUsedTracker : 291|2@0+ (1,0) [0|3] "" ASDM
 SG_ FrntSideRdrLeObj11RdrObjVx : 255|14@0+ (0.02,-128.0) [-128.0|128.0] "m/s" ASDM
 SG_ FrntSideRdrLeObj11RdrObjVxStdDe : 271|6@0+ (0.05,0.0) [0.0|2.0] "m/s" ASDM
 SG_ FrntSideRdrLeObj11RdrObjVy : 207|14@0+ (0.02,-128.0) [-128.0|128.0] "m/s" ASDM
 SG_ FrntSideRdrLeObj11RdrObjVyStdDe : 159|6@0+ (0.05,0.0) [0.0|2.0] "m/s" ASDM
 SG_ FrntSideRdrLeObj11RelVx : 135|12@0+ (0.02,-35.6) [-35.6|35.6] "m/s" ASDM
 SG_ FrntSideRdrLeObj11RelVy : 139|12@0+ (0.02,-35.6) [-35.6|35.6] "m/s" ASDM

BO_ 370 FSRLSafetyCANFD1Frame34 : 64 FSRL
 SG_ FrntSideRdrLeObj12_UB : 319|1@0+ (1,0) [0|1] "" ASDM
 SG_ FrntSideRdrLeObj12Heading : 287|12@0+ (0.1,-180.0) [-180.0|180.0] "Deg" ASDM
 SG_ FrntSideRdrLeObj12ObjBoxCenterLat : 23|9@0+ (0.1,-25.0) [-25.0|25.0] "m" ASDM
 SG_ FrntSideRdrLeObj12ObjBoxCenterLgt : 30|9@0+ (0.1,-25.0) [-25.0|25.0] "m" ASDM
 SG_ FrntSideRdrLeObj12ObservationHist : 63|32@0+ (1.0,0.0) [0.0|4294967295.0] "Unitless" ASDM
 SG_ FrntSideRdrLeObj12QualityBits : 289|18@0+ (1.0,0.0) [0.0|262143.0] "Unitless" ASDM
 SG_ FrntSideRdrLeObj12RdrObjAx : 7|8@0- (0.1,0.0) [-12.8|12.700000000000001] "m/s^2" ASDM
 SG_ FrntSideRdrLeObj12RdrObjAy : 15|8@0- (0.1,0.0) [-12.8|12.700000000000001] "m/s^2" ASDM
 SG_ FrntSideRdrLeObj12RdrObjBoxLength : 37|9@0+ (0.1,0.0) [0.0|50.0] "m" ASDM
 SG_ FrntSideRdrLeObj12RdrObjBoxWidth : 44|9@0+ (0.1,0.0) [0.0|50.0] "m" ASDM
 SG_ FrntSideRdrLeObj12RdrObjChks : 95|8@0+ (1.0,0.0) [0.0|255.0] "Unitless" ASDM
 SG_ FrntSideRdrLeObj12RdrObjCntr : 103|4@0+ (1.0,0.0) [0.0|15.0] "Unitless" ASDM
 SG_ FrntSideRdrLeObj12RdrObjCoastCnt : 279|5@0+ (1.0,0.0) [0.0|31.0] "Unitless" ASDM
 SG_ FrntSideRdrLeObj12RdrObjConf : 99|4@0+ (7.0,0.0) [0.0|105.0] "%" ASDM
 SG_ FrntSideRdrLeObj12RdrObjDx : 191|13@0+ (0.05,-200.0) [-200.0|200.0] "m" ASDM
 SG_ FrntSideRdrLeObj12RdrObjDxStdDe : 111|8@0+ (0.05,0.0) [0.0|12.700000000000001] "m" ASDM
 SG_ FrntSideRdrLeObj12RdrObjDy : 119|13@0+ (0.05,-200.0) [-200.0|200.0] "m" ASDM
 SG_ FrntSideRdrLeObj12RdrObjDyStdDe : 183|8@0+ (0.05,0.0) [0.0|12.700000000000001] "m" ASDM
 SG_ FrntSideRdrLeObj12RdrObjElevnConf : 223|4@0+ (7.0,0.0) [0.0|105.0] "%" ASDM
 SG_ FrntSideRdrLeObj12RdrObjElevnSts : 153|2@0+ (1,0) [0|3] "" ASDM
 SG_ FrntSideRdrLeObj12RdrObjID : 167|8@0+ (1.0,0.0) [0.0|255.0] "Unitless" ASDM
 SG_ FrntSideRdrLeObj12RdrObjIsInFreeSpace : 192|1@0+ (1,0) [0|1] "" ASDM
 SG_ FrntSideRdrLeObj12RdrObjMirrProblty : 219|4@0+ (7.0,0.0) [0.0|105.0] "%" ASDM
 SG_ FrntSideRdrLeObj12RdrObjMtnPat : 122|3@0+ (1,0) [0|7] "" ASDM
 SG_ FrntSideRdrLeObj12RdrObjNotRealProblty : 231|4@0+ (7.0,0.0) [0.0|105.0] "%" ASDM
 SG_ FrntSideRdrLeObj12RdrObjStatyCnt : 239|7@0+ (1.0,0.0) [0.0|127.0] "Unitless" ASDM
 SG_ FrntSideRdrLeObj12RdrObjTiAlv : 247|7@0+ (1.0,0.0) [0.0|127.0] "Unitless" ASDM
 SG_ FrntSideRdrLeObj12RdrObjTrackSts : 194|2@0+ (1,0) [0|3] "" ASDM
 SG_ FrntSideRdrLeObj12RdrObjTyp : 51|4@0+ (1,0) [0|15] "" ASDM
 SG_ FrntSideRdrLeObj12RdrObjTypConfBike : 175|4@0+ (7.0,0.0) [0.0|105.0] "%" ASDM
 SG_ FrntSideRdrLeObj12RdrObjTypConfPed : 171|4@0+ (7.0,0.0) [0.0|105.0] "%" ASDM
 SG_ FrntSideRdrLeObj12RdrObjTypConfVeh : 227|4@0+ (7.0,0.0) [0.0|105.0] "%" ASDM
 SG_ FrntSideRdrLeObj12RdrObjUsedTracker : 291|2@0+ (1,0) [0|3] "" ASDM
 SG_ FrntSideRdrLeObj12RdrObjVx : 255|14@0+ (0.02,-128.0) [-128.0|128.0] "m/s" ASDM
 SG_ FrntSideRdrLeObj12RdrObjVxStdDe : 271|6@0+ (0.05,0.0) [0.0|2.0] "m/s" ASDM
 SG_ FrntSideRdrLeObj12RdrObjVy : 207|14@0+ (0.02,-128.0) [-128.0|128.0] "m/s" ASDM
 SG_ FrntSideRdrLeObj12RdrObjVyStdDe : 159|6@0+ (0.05,0.0) [0.0|2.0] "m/s" ASDM
 SG_ FrntSideRdrLeObj12RelVx : 135|12@0+ (0.02,-35.6) [-35.6|35.6] "m/s" ASDM
 SG_ FrntSideRdrLeObj12RelVy : 139|12@0+ (0.02,-35.6) [-35.6|35.6] "m/s" ASDM

BO_ 372 FSRLSafetyCANFD1Frame35 : 64 FSRL
 SG_ FrntSideRdrLeObj13_UB : 319|1@0+ (1,0) [0|1] "" ASDM
 SG_ FrntSideRdrLeObj13Heading : 287|12@0+ (0.1,-180.0) [-180.0|180.0] "Deg" ASDM
 SG_ FrntSideRdrLeObj13ObjBoxCenterLat : 23|9@0+ (0.1,-25.0) [-25.0|25.0] "m" ASDM
 SG_ FrntSideRdrLeObj13ObjBoxCenterLgt : 30|9@0+ (0.1,-25.0) [-25.0|25.0] "m" ASDM
 SG_ FrntSideRdrLeObj13ObservationHist : 63|32@0+ (1.0,0.0) [0.0|4294967295.0] "Unitless" ASDM
 SG_ FrntSideRdrLeObj13QualityBits : 289|18@0+ (1.0,0.0) [0.0|262143.0] "Unitless" ASDM
 SG_ FrntSideRdrLeObj13RdrObjAx : 7|8@0- (0.1,0.0) [-12.8|12.700000000000001] "m/s^2" ASDM
 SG_ FrntSideRdrLeObj13RdrObjAy : 15|8@0- (0.1,0.0) [-12.8|12.700000000000001] "m/s^2" ASDM
 SG_ FrntSideRdrLeObj13RdrObjBoxLength : 37|9@0+ (0.1,0.0) [0.0|50.0] "m" ASDM
 SG_ FrntSideRdrLeObj13RdrObjBoxWidth : 44|9@0+ (0.1,0.0) [0.0|50.0] "m" ASDM
 SG_ FrntSideRdrLeObj13RdrObjChks : 95|8@0+ (1.0,0.0) [0.0|255.0] "Unitless" ASDM
 SG_ FrntSideRdrLeObj13RdrObjCntr : 103|4@0+ (1.0,0.0) [0.0|15.0] "Unitless" ASDM
 SG_ FrntSideRdrLeObj13RdrObjCoastCnt : 279|5@0+ (1.0,0.0) [0.0|31.0] "Unitless" ASDM
 SG_ FrntSideRdrLeObj13RdrObjConf : 99|4@0+ (7.0,0.0) [0.0|105.0] "%" ASDM
 SG_ FrntSideRdrLeObj13RdrObjDx : 191|13@0+ (0.05,-200.0) [-200.0|200.0] "m" ASDM
 SG_ FrntSideRdrLeObj13RdrObjDxStdDe : 111|8@0+ (0.05,0.0) [0.0|12.700000000000001] "m" ASDM
 SG_ FrntSideRdrLeObj13RdrObjDy : 119|13@0+ (0.05,-200.0) [-200.0|200.0] "m" ASDM
 SG_ FrntSideRdrLeObj13RdrObjDyStdDe : 183|8@0+ (0.05,0.0) [0.0|12.700000000000001] "m" ASDM
 SG_ FrntSideRdrLeObj13RdrObjElevnConf : 223|4@0+ (7.0,0.0) [0.0|105.0] "%" ASDM
 SG_ FrntSideRdrLeObj13RdrObjElevnSts : 153|2@0+ (1,0) [0|3] "" ASDM
 SG_ FrntSideRdrLeObj13RdrObjID : 167|8@0+ (1.0,0.0) [0.0|255.0] "Unitless" ASDM
 SG_ FrntSideRdrLeObj13RdrObjIsInFreeSpace : 192|1@0+ (1,0) [0|1] "" ASDM
 SG_ FrntSideRdrLeObj13RdrObjMirrProblty : 219|4@0+ (7.0,0.0) [0.0|105.0] "%" ASDM
 SG_ FrntSideRdrLeObj13RdrObjMtnPat : 122|3@0+ (1,0) [0|7] "" ASDM
 SG_ FrntSideRdrLeObj13RdrObjNotRealProblty : 231|4@0+ (7.0,0.0) [0.0|105.0] "%" ASDM
 SG_ FrntSideRdrLeObj13RdrObjStatyCnt : 239|7@0+ (1.0,0.0) [0.0|127.0] "Unitless" ASDM
 SG_ FrntSideRdrLeObj13RdrObjTiAlv : 247|7@0+ (1.0,0.0) [0.0|127.0] "Unitless" ASDM
 SG_ FrntSideRdrLeObj13RdrObjTrackSts : 194|2@0+ (1,0) [0|3] "" ASDM
 SG_ FrntSideRdrLeObj13RdrObjTyp : 51|4@0+ (1,0) [0|15] "" ASDM
 SG_ FrntSideRdrLeObj13RdrObjTypConfBike : 175|4@0+ (7.0,0.0) [0.0|105.0] "%" ASDM
 SG_ FrntSideRdrLeObj13RdrObjTypConfPed : 171|4@0+ (7.0,0.0) [0.0|105.0] "%" ASDM
 SG_ FrntSideRdrLeObj13RdrObjTypConfVeh : 227|4@0+ (7.0,0.0) [0.0|105.0] "%" ASDM
 SG_ FrntSideRdrLeObj13RdrObjUsedTracker : 291|2@0+ (1,0) [0|3] "" ASDM
 SG_ FrntSideRdrLeObj13RdrObjVx : 255|14@0+ (0.02,-128.0) [-128.0|128.0] "m/s" ASDM
 SG_ FrntSideRdrLeObj13RdrObjVxStdDe : 271|6@0+ (0.05,0.0) [0.0|2.0] "m/s" ASDM
 SG_ FrntSideRdrLeObj13RdrObjVy : 207|14@0+ (0.02,-128.0) [-128.0|128.0] "m/s" ASDM
 SG_ FrntSideRdrLeObj13RdrObjVyStdDe : 159|6@0+ (0.05,0.0) [0.0|2.0] "m/s" ASDM
 SG_ FrntSideRdrLeObj13RelVx : 135|12@0+ (0.02,-35.6) [-35.6|35.6] "m/s" ASDM
 SG_ FrntSideRdrLeObj13RelVy : 139|12@0+ (0.02,-35.6) [-35.6|35.6] "m/s" ASDM

BO_ 374 FSRLSafetyCANFD1Frame36 : 64 FSRL
 SG_ FrntSideRdrLeObj14_UB : 319|1@0+ (1,0) [0|1] "" ASDM
 SG_ FrntSideRdrLeObj14Heading : 287|12@0+ (0.1,-180.0) [-180.0|180.0] "Deg" ASDM
 SG_ FrntSideRdrLeObj14ObjBoxCenterLat : 23|9@0+ (0.1,-25.0) [-25.0|25.0] "m" ASDM
 SG_ FrntSideRdrLeObj14ObjBoxCenterLgt : 30|9@0+ (0.1,-25.0) [-25.0|25.0] "m" ASDM
 SG_ FrntSideRdrLeObj14ObservationHist : 63|32@0+ (1.0,0.0) [0.0|4294967295.0] "Unitless" ASDM
 SG_ FrntSideRdrLeObj14QualityBits : 289|18@0+ (1.0,0.0) [0.0|262143.0] "Unitless" ASDM
 SG_ FrntSideRdrLeObj14RdrObjAx : 7|8@0- (0.1,0.0) [-12.8|12.700000000000001] "m/s^2" ASDM
 SG_ FrntSideRdrLeObj14RdrObjAy : 15|8@0- (0.1,0.0) [-12.8|12.700000000000001] "m/s^2" ASDM
 SG_ FrntSideRdrLeObj14RdrObjBoxLength : 37|9@0+ (0.1,0.0) [0.0|50.0] "m" ASDM
 SG_ FrntSideRdrLeObj14RdrObjBoxWidth : 44|9@0+ (0.1,0.0) [0.0|50.0] "m" ASDM
 SG_ FrntSideRdrLeObj14RdrObjChks : 95|8@0+ (1.0,0.0) [0.0|255.0] "Unitless" ASDM
 SG_ FrntSideRdrLeObj14RdrObjCntr : 103|4@0+ (1.0,0.0) [0.0|15.0] "Unitless" ASDM
 SG_ FrntSideRdrLeObj14RdrObjCoastCnt : 279|5@0+ (1.0,0.0) [0.0|31.0] "Unitless" ASDM
 SG_ FrntSideRdrLeObj14RdrObjConf : 99|4@0+ (7.0,0.0) [0.0|105.0] "%" ASDM
 SG_ FrntSideRdrLeObj14RdrObjDx : 191|13@0+ (0.05,-200.0) [-200.0|200.0] "m" ASDM
 SG_ FrntSideRdrLeObj14RdrObjDxStdDe : 111|8@0+ (0.05,0.0) [0.0|12.700000000000001] "m" ASDM
 SG_ FrntSideRdrLeObj14RdrObjDy : 119|13@0+ (0.05,-200.0) [-200.0|200.0] "m" ASDM
 SG_ FrntSideRdrLeObj14RdrObjDyStdDe : 183|8@0+ (0.05,0.0) [0.0|12.700000000000001] "m" ASDM
 SG_ FrntSideRdrLeObj14RdrObjElevnConf : 223|4@0+ (7.0,0.0) [0.0|105.0] "%" ASDM
 SG_ FrntSideRdrLeObj14RdrObjElevnSts : 153|2@0+ (1,0) [0|3] "" ASDM
 SG_ FrntSideRdrLeObj14RdrObjID : 167|8@0+ (1.0,0.0) [0.0|255.0] "Unitless" ASDM
 SG_ FrntSideRdrLeObj14RdrObjIsInFreeSpace : 192|1@0+ (1,0) [0|1] "" ASDM
 SG_ FrntSideRdrLeObj14RdrObjMirrProblty : 219|4@0+ (7.0,0.0) [0.0|105.0] "%" ASDM
 SG_ FrntSideRdrLeObj14RdrObjMtnPat : 122|3@0+ (1,0) [0|7] "" ASDM
 SG_ FrntSideRdrLeObj14RdrObjNotRealProblty : 231|4@0+ (7.0,0.0) [0.0|105.0] "%" ASDM
 SG_ FrntSideRdrLeObj14RdrObjStatyCnt : 239|7@0+ (1.0,0.0) [0.0|127.0] "Unitless" ASDM
 SG_ FrntSideRdrLeObj14RdrObjTiAlv : 247|7@0+ (1.0,0.0) [0.0|127.0] "Unitless" ASDM
 SG_ FrntSideRdrLeObj14RdrObjTrackSts : 194|2@0+ (1,0) [0|3] "" ASDM
 SG_ FrntSideRdrLeObj14RdrObjTyp : 51|4@0+ (1,0) [0|15] "" ASDM
 SG_ FrntSideRdrLeObj14RdrObjTypConfBike : 175|4@0+ (7.0,0.0) [0.0|105.0] "%" ASDM
 SG_ FrntSideRdrLeObj14RdrObjTypConfPed : 171|4@0+ (7.0,0.0) [0.0|105.0] "%" ASDM
 SG_ FrntSideRdrLeObj14RdrObjTypConfVeh : 227|4@0+ (7.0,0.0) [0.0|105.0] "%" ASDM
 SG_ FrntSideRdrLeObj14RdrObjUsedTracker : 291|2@0+ (1,0) [0|3] "" ASDM
 SG_ FrntSideRdrLeObj14RdrObjVx : 255|14@0+ (0.02,-128.0) [-128.0|128.0] "m/s" ASDM
 SG_ FrntSideRdrLeObj14RdrObjVxStdDe : 271|6@0+ (0.05,0.0) [0.0|2.0] "m/s" ASDM
 SG_ FrntSideRdrLeObj14RdrObjVy : 207|14@0+ (0.02,-128.0) [-128.0|128.0] "m/s" ASDM
 SG_ FrntSideRdrLeObj14RdrObjVyStdDe : 159|6@0+ (0.05,0.0) [0.0|2.0] "m/s" ASDM
 SG_ FrntSideRdrLeObj14RelVx : 135|12@0+ (0.02,-35.6) [-35.6|35.6] "m/s" ASDM
 SG_ FrntSideRdrLeObj14RelVy : 139|12@0+ (0.02,-35.6) [-35.6|35.6] "m/s" ASDM

BO_ 376 FSRLSafetyCANFD1Frame37 : 64 FSRL
 SG_ FrntSideRdrLeObj15_UB : 319|1@0+ (1,0) [0|1] "" ASDM
 SG_ FrntSideRdrLeObj15Heading : 287|12@0+ (0.1,-180.0) [-180.0|180.0] "Deg" ASDM
 SG_ FrntSideRdrLeObj15ObjBoxCenterLat : 23|9@0+ (0.1,-25.0) [-25.0|25.0] "m" ASDM
 SG_ FrntSideRdrLeObj15ObjBoxCenterLgt : 30|9@0+ (0.1,-25.0) [-25.0|25.0] "m" ASDM
 SG_ FrntSideRdrLeObj15ObservationHist : 63|32@0+ (1.0,0.0) [0.0|4294967295.0] "Unitless" ASDM
 SG_ FrntSideRdrLeObj15QualityBits : 289|18@0+ (1.0,0.0) [0.0|262143.0] "Unitless" ASDM
 SG_ FrntSideRdrLeObj15RdrObjAx : 7|8@0- (0.1,0.0) [-12.8|12.700000000000001] "m/s^2" ASDM
 SG_ FrntSideRdrLeObj15RdrObjAy : 15|8@0- (0.1,0.0) [-12.8|12.700000000000001] "m/s^2" ASDM
 SG_ FrntSideRdrLeObj15RdrObjBoxLength : 37|9@0+ (0.1,0.0) [0.0|50.0] "m" ASDM
 SG_ FrntSideRdrLeObj15RdrObjBoxWidth : 44|9@0+ (0.1,0.0) [0.0|50.0] "m" ASDM
 SG_ FrntSideRdrLeObj15RdrObjChks : 95|8@0+ (1.0,0.0) [0.0|255.0] "Unitless" ASDM
 SG_ FrntSideRdrLeObj15RdrObjCntr : 103|4@0+ (1.0,0.0) [0.0|15.0] "Unitless" ASDM
 SG_ FrntSideRdrLeObj15RdrObjCoastCnt : 279|5@0+ (1.0,0.0) [0.0|31.0] "Unitless" ASDM
 SG_ FrntSideRdrLeObj15RdrObjConf : 99|4@0+ (7.0,0.0) [0.0|105.0] "%" ASDM
 SG_ FrntSideRdrLeObj15RdrObjDx : 191|13@0+ (0.05,-200.0) [-200.0|200.0] "m" ASDM
 SG_ FrntSideRdrLeObj15RdrObjDxStdDe : 111|8@0+ (0.05,0.0) [0.0|12.700000000000001] "m" ASDM
 SG_ FrntSideRdrLeObj15RdrObjDy : 119|13@0+ (0.05,-200.0) [-200.0|200.0] "m" ASDM
 SG_ FrntSideRdrLeObj15RdrObjDyStdDe : 183|8@0+ (0.05,0.0) [0.0|12.700000000000001] "m" ASDM
 SG_ FrntSideRdrLeObj15RdrObjElevnConf : 223|4@0+ (7.0,0.0) [0.0|105.0] "%" ASDM
 SG_ FrntSideRdrLeObj15RdrObjElevnSts : 153|2@0+ (1,0) [0|3] "" ASDM
 SG_ FrntSideRdrLeObj15RdrObjID : 167|8@0+ (1.0,0.0) [0.0|255.0] "Unitless" ASDM
 SG_ FrntSideRdrLeObj15RdrObjIsInFreeSpace : 192|1@0+ (1,0) [0|1] "" ASDM
 SG_ FrntSideRdrLeObj15RdrObjMirrProblty : 219|4@0+ (7.0,0.0) [0.0|105.0] "%" ASDM
 SG_ FrntSideRdrLeObj15RdrObjMtnPat : 122|3@0+ (1,0) [0|7] "" ASDM
 SG_ FrntSideRdrLeObj15RdrObjNotRealProblty : 231|4@0+ (7.0,0.0) [0.0|105.0] "%" ASDM
 SG_ FrntSideRdrLeObj15RdrObjStatyCnt : 239|7@0+ (1.0,0.0) [0.0|127.0] "Unitless" ASDM
 SG_ FrntSideRdrLeObj15RdrObjTiAlv : 247|7@0+ (1.0,0.0) [0.0|127.0] "Unitless" ASDM
 SG_ FrntSideRdrLeObj15RdrObjTrackSts : 194|2@0+ (1,0) [0|3] "" ASDM
 SG_ FrntSideRdrLeObj15RdrObjTyp : 51|4@0+ (1,0) [0|15] "" ASDM
 SG_ FrntSideRdrLeObj15RdrObjTypConfBike : 175|4@0+ (7.0,0.0) [0.0|105.0] "%" ASDM
 SG_ FrntSideRdrLeObj15RdrObjTypConfPed : 171|4@0+ (7.0,0.0) [0.0|105.0] "%" ASDM
 SG_ FrntSideRdrLeObj15RdrObjTypConfVeh : 227|4@0+ (7.0,0.0) [0.0|105.0] "%" ASDM
 SG_ FrntSideRdrLeObj15RdrObjUsedTracker : 291|2@0+ (1,0) [0|3] "" ASDM
 SG_ FrntSideRdrLeObj15RdrObjVx : 255|14@0+ (0.02,-128.0) [-128.0|128.0] "m/s" ASDM
 SG_ FrntSideRdrLeObj15RdrObjVxStdDe : 271|6@0+ (0.05,0.0) [0.0|2.0] "m/s" ASDM
 SG_ FrntSideRdrLeObj15RdrObjVy : 207|14@0+ (0.02,-128.0) [-128.0|128.0] "m/s" ASDM
 SG_ FrntSideRdrLeObj15RdrObjVyStdDe : 159|6@0+ (0.05,0.0) [0.0|2.0] "m/s" ASDM
 SG_ FrntSideRdrLeObj15RelVx : 135|12@0+ (0.02,-35.6) [-35.6|35.6] "m/s" ASDM
 SG_ FrntSideRdrLeObj15RelVy : 139|12@0+ (0.02,-35.6) [-35.6|35.6] "m/s" ASDM

BO_ 1283 FsrlSafetyCanFD1NMFr : 8 FSRL
 SG_ PNC16_FSRL : 16|1@0+ (1,0) [0|0] "" ASDM
 SG_ PNC17_FSRL : 17|1@0+ (1,0) [0|0] "" ASDM
 SG_ PNC18_FSRL : 18|1@0+ (1,0) [0|0] "" ASDM
 SG_ PNC19_FSRL : 19|1@0+ (1,0) [0|0] "" ASDM
 SG_ PNC20_FSRL : 20|1@0+ (1,0) [0|0] "" ASDM
 SG_ PNC21_FSRL : 21|1@0+ (1,0) [0|0] "" ASDM
 SG_ PNC22_FSRL : 22|1@0+ (1,0) [0|0] "" ASDM
 SG_ PNC23_FSRL : 23|1@0+ (1,0) [0|0] "" ASDM
 SG_ PNC24_FSRL : 24|1@0+ (1,0) [0|0] "" ASDM
 SG_ PNC25_FSRL : 25|1@0+ (1,0) [0|0] "" ASDM
 SG_ PNC26_FSRL : 26|1@0+ (1,0) [0|0] "" ASDM
 SG_ PNC27_FSRL : 27|1@0+ (1,0) [0|0] "" ASDM
 SG_ PNC28_FSRL : 28|1@0+ (1,0) [0|0] "" ASDM
 SG_ PNC29_FSRL : 29|1@0+ (1,0) [0|0] "" ASDM
 SG_ PNC30_FSRL : 30|1@0+ (1,0) [0|0] "" ASDM
 SG_ PNC31_FSRL : 31|1@0+ (1,0) [0|0] "" ASDM
 SG_ PNC32_FSRL : 32|1@0+ (1,0) [0|0] "" ASDM
 SG_ PNC33_FSRL : 33|1@0+ (1,0) [0|0] "" ASDM
 SG_ PNC34_FSRL : 34|1@0+ (1,0) [0|0] "" ASDM
 SG_ PNC35_FSRL : 35|1@0+ (1,0) [0|0] "" ASDM
 SG_ PNC36_FSRL : 36|1@0+ (1,0) [0|0] "" ASDM
 SG_ PNC37_FSRL : 37|1@0+ (1,0) [0|0] "" ASDM
 SG_ PNC38_FSRL : 38|1@0+ (1,0) [0|0] "" ASDM
 SG_ PNC39_FSRL : 39|1@0+ (1,0) [0|0] "" ASDM
 SG_ PNC40_FSRL : 40|1@0+ (1,0) [0|0] "" ASDM
 SG_ PNC41_FSRL : 41|1@0+ (1,0) [0|0] "" ASDM
 SG_ PNC42_FSRL : 42|1@0+ (1,0) [0|0] "" ASDM
 SG_ NM_PNI_FSRL : 14|1@0+ (1,0) [0|0] "" ASDM
 SG_ NM_AW_FSRL : 12|1@0+ (1,0) [0|0] "" ASDM
 SG_ NM_CS_FSRL : 11|1@0+ (1,0) [0|0] "" ASDM
 SG_ NM_RMR_FSRL : 8|1@0+ (1,0) [0|0] "" ASDM
 SG_ NM_NodeID_FSRL : 7|8@0+ (1,0) [0|0] "" ASDM

CM_ SG_ 352 FrntSideRdrLeObj3Heading "Refer to the data element description in ReSideRdrRiObj1 with the same data element name";
CM_ SG_ 352 FrntSideRdrLeObj3ObjBoxCenterLat "Box center y coordinate (relative closest point)";
CM_ SG_ 352 FrntSideRdrLeObj3ObjBoxCenterLgt "Box center x coordinate (relative closest point)";
CM_ SG_ 352 FrntSideRdrLeObj3ObservationHist "Refer to the data element description in ReSideRdrRiObj1 with the same data element name";
CM_ SG_ 352 FrntSideRdrLeObj3QualityBits "Refer to the data element description in FrntSideRdrLeObj1 with the same data element name.";
CM_ SG_ 352 FrntSideRdrLeObj3RdrObjAx "Refer to the data element description in FrntSideRdrLeObj1 with the same data element name.";
CM_ SG_ 352 FrntSideRdrLeObj3RdrObjAy "Refer to the data element description in FrntSideRdrLeObj1 with the same data element name.";
CM_ SG_ 352 FrntSideRdrLeObj3RdrObjBoxLength "Box length (box extent that is parallel to objects heading angle)";
CM_ SG_ 352 FrntSideRdrLeObj3RdrObjBoxWidth "Box width (box extent that is perpendicular to objects heading angle)";
CM_ SG_ 352 FrntSideRdrLeObj3RdrObjChks "Refer to the data element description in FrntSideRdrLeObj1 with the same data element name.";
CM_ SG_ 352 FrntSideRdrLeObj3RdrObjCntr "Refer to the data element description in FrntSideRdrLeObj1 with the same data element name.";
CM_ SG_ 352 FrntSideRdrLeObj3RdrObjCoastCnt "Refer to the data element description in FrntSideRdrLeObj1 with the same data element name.";
CM_ SG_ 352 FrntSideRdrLeObj3RdrObjConf "Refer to the data element description in FrntSideRdrLeObj1 with the same data element name.";
CM_ SG_ 352 FrntSideRdrLeObj3RdrObjDx "Refer to the data element description in FrntSideRdrLeObj1 with the same data element name.";
CM_ SG_ 352 FrntSideRdrLeObj3RdrObjDxStdDe "Refer to the data element description in FrntSideRdrLeObj1 with the same data element name.";
CM_ SG_ 352 FrntSideRdrLeObj3RdrObjDy "Refer to the data element description in FrntSideRdrLeObj1 with the same data element name.";
CM_ SG_ 352 FrntSideRdrLeObj3RdrObjDyStdDe "Refer to the data element description in FrntSideRdrLeObj1 with the same data element name.";
CM_ SG_ 352 FrntSideRdrLeObj3RdrObjElevnConf "Refer to the data element description in FrntSideRdrLeObj1 with the same data element name.";
CM_ SG_ 352 FrntSideRdrLeObj3RdrObjElevnSts "Refer to the data element description in FrntSideRdrLeObj1 with the same data element name.";
CM_ SG_ 352 FrntSideRdrLeObj3RdrObjID "Refer to the data element description in FrntSideRdrLeObj1 with the same data element name.";
CM_ SG_ 352 FrntSideRdrLeObj3RdrObjIsInFreeSpace "Refer to the data element description in FrntSideRdrLeObj1 with the same data element name.";
CM_ SG_ 352 FrntSideRdrLeObj3RdrObjMirrProblty "Refer to the data element description in FrntSideRdrLeObj1 with the same data element name.";
CM_ SG_ 352 FrntSideRdrLeObj3RdrObjMtnPat "Refer to the data element description in FrntSideRdrLeObj1 with the same data element name.";
CM_ SG_ 352 FrntSideRdrLeObj3RdrObjNotRealProblty "Refer to the data element description in FrntSideRdrLeObj1 with the same data element name.";
CM_ SG_ 352 FrntSideRdrLeObj3RdrObjStatyCnt "Refer to the data element description in FrntSideRdrLeObj1 with the same data element name.";
CM_ SG_ 352 FrntSideRdrLeObj3RdrObjTiAlv "Refer to the data element description in FrntSideRdrLeObj1 with the same data element name.";
CM_ SG_ 352 FrntSideRdrLeObj3RdrObjTrackSts "Refer to the data element description in FrntSideRdrLeObj1 with the same data element name.";
CM_ SG_ 352 FrntSideRdrLeObj3RdrObjTyp "Refer to the data element description in FrntSideRdrLeObj1 with the same data element name.";
CM_ SG_ 352 FrntSideRdrLeObj3RdrObjTypConfBike "Refer to the data element description in FrntSideRdrLeObj1 with the same data element name.";
CM_ SG_ 352 FrntSideRdrLeObj3RdrObjTypConfPed "Refer to the data element description in FrntSideRdrLeObj1 with the same data element name.";
CM_ SG_ 352 FrntSideRdrLeObj3RdrObjTypConfVeh "Refer to the data element description in FrntSideRdrLeObj1 with the same data element name.";
CM_ SG_ 352 FrntSideRdrLeObj3RdrObjUsedTracker "Refer to the data element description in FrntSideRdrLeObj1 with the same data element name.";
CM_ SG_ 352 FrntSideRdrLeObj3RdrObjVx "Refer to the data element description in FrntSideRdrLeObj1 with the same data element name.";
CM_ SG_ 352 FrntSideRdrLeObj3RdrObjVxStdDe "Refer to the data element description in FrntSideRdrLeObj1 with the same data element name.";
CM_ SG_ 352 FrntSideRdrLeObj3RdrObjVy "Refer to the data element description in FrntSideRdrLeObj1 with the same data element name.";
CM_ SG_ 352 FrntSideRdrLeObj3RdrObjVyStdDe "Refer to the data element description in FrntSideRdrLeObj1 with the same data element name.";
CM_ SG_ 352 FrntSideRdrLeObj3RelVx "Refer to the data element description in ReSideRdrRiObj1 with the same data element name";
CM_ SG_ 352 FrntSideRdrLeObj3RelVy "Refer to the data element description in ReSideRdrRiObj1 with the same data element name";
CM_ SG_ 354 FrntSideRdrLeObj4Heading "Refer to the data element description in ReSideRdrRiObj1 with the same data element name";
CM_ SG_ 354 FrntSideRdrLeObj4ObjBoxCenterLat "Box center y coordinate (relative closest point)";
CM_ SG_ 354 FrntSideRdrLeObj4ObjBoxCenterLgt "Box center x coordinate (relative closest point)";
CM_ SG_ 354 FrntSideRdrLeObj4ObservationHist "Refer to the data element description in ReSideRdrRiObj1 with the same data element name";
CM_ SG_ 354 FrntSideRdrLeObj4QualityBits "Refer to the data element description in FrntSideRdrLeObj1 with the same data element name.";
CM_ SG_ 354 FrntSideRdrLeObj4RdrObjAx "Refer to the data element description in FrntSideRdrLeObj1 with the same data element name.";
CM_ SG_ 354 FrntSideRdrLeObj4RdrObjAy "Refer to the data element description in FrntSideRdrLeObj1 with the same data element name.";
CM_ SG_ 354 FrntSideRdrLeObj4RdrObjBoxLength "Box length (box extent that is parallel to objects heading angle)";
CM_ SG_ 354 FrntSideRdrLeObj4RdrObjBoxWidth "Box width (box extent that is perpendicular to objects heading angle)";
CM_ SG_ 354 FrntSideRdrLeObj4RdrObjChks "Refer to the data element description in FrntSideRdrLeObj1 with the same data element name.";
CM_ SG_ 354 FrntSideRdrLeObj4RdrObjCntr "Refer to the data element description in FrntSideRdrLeObj1 with the same data element name.";
CM_ SG_ 354 FrntSideRdrLeObj4RdrObjCoastCnt "Refer to the data element description in FrntSideRdrLeObj1 with the same data element name.";
CM_ SG_ 354 FrntSideRdrLeObj4RdrObjConf "Refer to the data element description in FrntSideRdrLeObj1 with the same data element name.";
CM_ SG_ 354 FrntSideRdrLeObj4RdrObjDx "Refer to the data element description in FrntSideRdrLeObj1 with the same data element name.";
CM_ SG_ 354 FrntSideRdrLeObj4RdrObjDxStdDe "Refer to the data element description in FrntSideRdrLeObj1 with the same data element name.";
CM_ SG_ 354 FrntSideRdrLeObj4RdrObjDy "Refer to the data element description in FrntSideRdrLeObj1 with the same data element name.";
CM_ SG_ 354 FrntSideRdrLeObj4RdrObjDyStdDe "Refer to the data element description in FrntSideRdrLeObj1 with the same data element name.";
CM_ SG_ 354 FrntSideRdrLeObj4RdrObjElevnConf "Refer to the data element description in FrntSideRdrLeObj1 with the same data element name.";
CM_ SG_ 354 FrntSideRdrLeObj4RdrObjElevnSts "Refer to the data element description in FrntSideRdrLeObj1 with the same data element name.";
CM_ SG_ 354 FrntSideRdrLeObj4RdrObjID "Refer to the data element description in FrntSideRdrLeObj1 with the same data element name.";
CM_ SG_ 354 FrntSideRdrLeObj4RdrObjIsInFreeSpace "Refer to the data element description in FrntSideRdrLeObj1 with the same data element name.";
CM_ SG_ 354 FrntSideRdrLeObj4RdrObjMirrProblty "Refer to the data element description in FrntSideRdrLeObj1 with the same data element name.";
CM_ SG_ 354 FrntSideRdrLeObj4RdrObjMtnPat "Refer to the data element description in FrntSideRdrLeObj1 with the same data element name.";
CM_ SG_ 354 FrntSideRdrLeObj4RdrObjNotRealProblty "Refer to the data element description in FrntSideRdrLeObj1 with the same data element name.";
CM_ SG_ 354 FrntSideRdrLeObj4RdrObjStatyCnt "Refer to the data element description in FrntSideRdrLeObj1 with the same data element name.";
CM_ SG_ 354 FrntSideRdrLeObj4RdrObjTiAlv "Refer to the data element description in FrntSideRdrLeObj1 with the same data element name.";
CM_ SG_ 354 FrntSideRdrLeObj4RdrObjTrackSts "Refer to the data element description in FrntSideRdrLeObj1 with the same data element name.";
CM_ SG_ 354 FrntSideRdrLeObj4RdrObjTyp "Refer to the data element description in FrntSideRdrLeObj1 with the same data element name.";
CM_ SG_ 354 FrntSideRdrLeObj4RdrObjTypConfBike "Refer to the data element description in FrntSideRdrLeObj1 with the same data element name.";
CM_ SG_ 354 FrntSideRdrLeObj4RdrObjTypConfPed "Refer to the data element description in FrntSideRdrLeObj1 with the same data element name.";
CM_ SG_ 354 FrntSideRdrLeObj4RdrObjTypConfVeh "Refer to the data element description in FrntSideRdrLeObj1 with the same data element name.";
CM_ SG_ 354 FrntSideRdrLeObj4RdrObjUsedTracker "Refer to the data element description in FrntSideRdrLeObj1 with the same data element name.";
CM_ SG_ 354 FrntSideRdrLeObj4RdrObjVx "Refer to the data element description in FrntSideRdrLeObj1 with the same data element name.";
CM_ SG_ 354 FrntSideRdrLeObj4RdrObjVxStdDe "Refer to the data element description in FrntSideRdrLeObj1 with the same data element name.";
CM_ SG_ 354 FrntSideRdrLeObj4RdrObjVy "Refer to the data element description in FrntSideRdrLeObj1 with the same data element name.";
CM_ SG_ 354 FrntSideRdrLeObj4RdrObjVyStdDe "Refer to the data element description in FrntSideRdrLeObj1 with the same data element name.";
CM_ SG_ 354 FrntSideRdrLeObj4RelVx "Refer to the data element description in ReSideRdrRiObj1 with the same data element name";
CM_ SG_ 354 FrntSideRdrLeObj4RelVy "Refer to the data element description in ReSideRdrRiObj1 with the same data element name";
CM_ SG_ 356 FrntSideRdrLeObj5Heading "Refer to the data element description in ReSideRdrRiObj1 with the same data element name";
CM_ SG_ 356 FrntSideRdrLeObj5ObjBoxCenterLat "Box center y coordinate (relative closest point)";
CM_ SG_ 356 FrntSideRdrLeObj5ObjBoxCenterLgt "Box center x coordinate (relative closest point)";
CM_ SG_ 356 FrntSideRdrLeObj5ObservationHist "Refer to the data element description in ReSideRdrRiObj1 with the same data element name";
CM_ SG_ 356 FrntSideRdrLeObj5QualityBits "Refer to the data element description in FrntSideRdrLeObj1 with the same data element name.";
CM_ SG_ 356 FrntSideRdrLeObj5RdrObjAx "Refer to the data element description in FrntSideRdrLeObj1 with the same data element name.";
CM_ SG_ 356 FrntSideRdrLeObj5RdrObjAy "Refer to the data element description in FrntSideRdrLeObj1 with the same data element name.";
CM_ SG_ 356 FrntSideRdrLeObj5RdrObjBoxLength "Box length (box extent that is parallel to objects heading angle)";
CM_ SG_ 356 FrntSideRdrLeObj5RdrObjBoxWidth "Box width (box extent that is perpendicular to objects heading angle)";
CM_ SG_ 356 FrntSideRdrLeObj5RdrObjChks "Refer to the data element description in FrntSideRdrLeObj1 with the same data element name.";
CM_ SG_ 356 FrntSideRdrLeObj5RdrObjCntr "Refer to the data element description in FrntSideRdrLeObj1 with the same data element name.";
CM_ SG_ 356 FrntSideRdrLeObj5RdrObjCoastCnt "Refer to the data element description in FrntSideRdrLeObj1 with the same data element name.";
CM_ SG_ 356 FrntSideRdrLeObj5RdrObjConf "Refer to the data element description in FrntSideRdrLeObj1 with the same data element name.";
CM_ SG_ 356 FrntSideRdrLeObj5RdrObjDx "Refer to the data element description in FrntSideRdrLeObj1 with the same data element name.";
CM_ SG_ 356 FrntSideRdrLeObj5RdrObjDxStdDe "Refer to the data element description in FrntSideRdrLeObj1 with the same data element name.";
CM_ SG_ 356 FrntSideRdrLeObj5RdrObjDy "Refer to the data element description in FrntSideRdrLeObj1 with the same data element name.";
CM_ SG_ 356 FrntSideRdrLeObj5RdrObjDyStdDe "Refer to the data element description in FrntSideRdrLeObj1 with the same data element name.";
CM_ SG_ 356 FrntSideRdrLeObj5RdrObjElevnConf "Refer to the data element description in FrntSideRdrLeObj1 with the same data element name.";
CM_ SG_ 356 FrntSideRdrLeObj5RdrObjElevnSts "Refer to the data element description in FrntSideRdrLeObj1 with the same data element name.";
CM_ SG_ 356 FrntSideRdrLeObj5RdrObjID "Refer to the data element description in FrntSideRdrLeObj1 with the same data element name.";
CM_ SG_ 356 FrntSideRdrLeObj5RdrObjIsInFreeSpace "Refer to the data element description in FrntSideRdrLeObj1 with the same data element name.";
CM_ SG_ 356 FrntSideRdrLeObj5RdrObjMirrProblty "Refer to the data element description in FrntSideRdrLeObj1 with the same data element name.";
CM_ SG_ 356 FrntSideRdrLeObj5RdrObjMtnPat "Refer to the data element description in FrntSideRdrLeObj1 with the same data element name.";
CM_ SG_ 356 FrntSideRdrLeObj5RdrObjNotRealProblty "Refer to the data element description in FrntSideRdrLeObj1 with the same data element name.";
CM_ SG_ 356 FrntSideRdrLeObj5RdrObjStatyCnt "Refer to the data element description in FrntSideRdrLeObj1 with the same data element name.";
CM_ SG_ 356 FrntSideRdrLeObj5RdrObjTiAlv "Refer to the data element description in FrntSideRdrLeObj1 with the same data element name.";
CM_ SG_ 356 FrntSideRdrLeObj5RdrObjTrackSts "Refer to the data element description in FrntSideRdrLeObj1 with the same data element name.";
CM_ SG_ 356 FrntSideRdrLeObj5RdrObjTyp "Refer to the data element description in FrntSideRdrLeObj1 with the same data element name.";
CM_ SG_ 356 FrntSideRdrLeObj5RdrObjTypConfBike "Refer to the data element description in FrntSideRdrLeObj1 with the same data element name.";
CM_ SG_ 356 FrntSideRdrLeObj5RdrObjTypConfPed "Refer to the data element description in FrntSideRdrLeObj1 with the same data element name.";
CM_ SG_ 356 FrntSideRdrLeObj5RdrObjTypConfVeh "Refer to the data element description in FrntSideRdrLeObj1 with the same data element name.";
CM_ SG_ 356 FrntSideRdrLeObj5RdrObjUsedTracker "Refer to the data element description in FrntSideRdrLeObj1 with the same data element name.";
CM_ SG_ 356 FrntSideRdrLeObj5RdrObjVx "Refer to the data element description in FrntSideRdrLeObj1 with the same data element name.";
CM_ SG_ 356 FrntSideRdrLeObj5RdrObjVxStdDe "Refer to the data element description in FrntSideRdrLeObj1 with the same data element name.";
CM_ SG_ 356 FrntSideRdrLeObj5RdrObjVy "Refer to the data element description in FrntSideRdrLeObj1 with the same data element name.";
CM_ SG_ 356 FrntSideRdrLeObj5RdrObjVyStdDe "Refer to the data element description in FrntSideRdrLeObj1 with the same data element name.";
CM_ SG_ 356 FrntSideRdrLeObj5RelVx "Refer to the data element description in ReSideRdrRiObj1 with the same data element name";
CM_ SG_ 356 FrntSideRdrLeObj5RelVy "Refer to the data element description in ReSideRdrRiObj1 with the same data element name";
CM_ SG_ 358 FrntSideRdrLeObj6Heading "Refer to the data element description in ReSideRdrRiObj1 with the same data element name";
CM_ SG_ 358 FrntSideRdrLeObj6ObjBoxCenterLat "Box center y coordinate (relative closest point)";
CM_ SG_ 358 FrntSideRdrLeObj6ObjBoxCenterLgt "Box center x coordinate (relative closest point)";
CM_ SG_ 358 FrntSideRdrLeObj6ObservationHist "Refer to the data element description in ReSideRdrRiObj1 with the same data element name";
CM_ SG_ 358 FrntSideRdrLeObj6QualityBits "Refer to the data element description in FrntSideRdrLeObj1 with the same data element name.";
CM_ SG_ 358 FrntSideRdrLeObj6RdrObjAx "Refer to the data element description in FrntSideRdrLeObj1 with the same data element name.";
CM_ SG_ 358 FrntSideRdrLeObj6RdrObjAy "Refer to the data element description in FrntSideRdrLeObj1 with the same data element name.";
CM_ SG_ 358 FrntSideRdrLeObj6RdrObjBoxLength "Box length (box extent that is parallel to objects heading angle)";
CM_ SG_ 358 FrntSideRdrLeObj6RdrObjBoxWidth "Box width (box extent that is perpendicular to objects heading angle)";
CM_ SG_ 358 FrntSideRdrLeObj6RdrObjChks "Refer to the data element description in FrntSideRdrLeObj1 with the same data element name.";
CM_ SG_ 358 FrntSideRdrLeObj6RdrObjCntr "Refer to the data element description in FrntSideRdrLeObj1 with the same data element name.";
CM_ SG_ 358 FrntSideRdrLeObj6RdrObjCoastCnt "Refer to the data element description in FrntSideRdrLeObj1 with the same data element name.";
CM_ SG_ 358 FrntSideRdrLeObj6RdrObjConf "Refer to the data element description in FrntSideRdrLeObj1 with the same data element name.";
CM_ SG_ 358 FrntSideRdrLeObj6RdrObjDx "Refer to the data element description in FrntSideRdrLeObj1 with the same data element name.";
CM_ SG_ 358 FrntSideRdrLeObj6RdrObjDxStdDe "Refer to the data element description in FrntSideRdrLeObj1 with the same data element name.";
CM_ SG_ 358 FrntSideRdrLeObj6RdrObjDy "Refer to the data element description in FrntSideRdrLeObj1 with the same data element name.";
CM_ SG_ 358 FrntSideRdrLeObj6RdrObjDyStdDe "Refer to the data element description in FrntSideRdrLeObj1 with the same data element name.";
CM_ SG_ 358 FrntSideRdrLeObj6RdrObjElevnConf "Refer to the data element description in FrntSideRdrLeObj1 with the same data element name.";
CM_ SG_ 358 FrntSideRdrLeObj6RdrObjElevnSts "Refer to the data element description in FrntSideRdrLeObj1 with the same data element name.";
CM_ SG_ 358 FrntSideRdrLeObj6RdrObjID "Refer to the data element description in FrntSideRdrLeObj1 with the same data element name.";
CM_ SG_ 358 FrntSideRdrLeObj6RdrObjIsInFreeSpace "Refer to the data element description in FrntSideRdrLeObj1 with the same data element name.";
CM_ SG_ 358 FrntSideRdrLeObj6RdrObjMirrProblty "Refer to the data element description in FrntSideRdrLeObj1 with the same data element name.";
CM_ SG_ 358 FrntSideRdrLeObj6RdrObjMtnPat "Refer to the data element description in FrntSideRdrLeObj1 with the same data element name.";
CM_ SG_ 358 FrntSideRdrLeObj6RdrObjNotRealProblty "Refer to the data element description in FrntSideRdrLeObj1 with the same data element name.";
CM_ SG_ 358 FrntSideRdrLeObj6RdrObjStatyCnt "Refer to the data element description in FrntSideRdrLeObj1 with the same data element name.";
CM_ SG_ 358 FrntSideRdrLeObj6RdrObjTiAlv "Refer to the data element description in FrntSideRdrLeObj1 with the same data element name.";
CM_ SG_ 358 FrntSideRdrLeObj6RdrObjTrackSts "Refer to the data element description in FrntSideRdrLeObj1 with the same data element name.";
CM_ SG_ 358 FrntSideRdrLeObj6RdrObjTyp "Refer to the data element description in FrntSideRdrLeObj1 with the same data element name.";
CM_ SG_ 358 FrntSideRdrLeObj6RdrObjTypConfBike "Refer to the data element description in FrntSideRdrLeObj1 with the same data element name.";
CM_ SG_ 358 FrntSideRdrLeObj6RdrObjTypConfPed "Refer to the data element description in FrntSideRdrLeObj1 with the same data element name.";
CM_ SG_ 358 FrntSideRdrLeObj6RdrObjTypConfVeh "Refer to the data element description in FrntSideRdrLeObj1 with the same data element name.";
CM_ SG_ 358 FrntSideRdrLeObj6RdrObjUsedTracker "Refer to the data element description in FrntSideRdrLeObj1 with the same data element name.";
CM_ SG_ 358 FrntSideRdrLeObj6RdrObjVx "Refer to the data element description in FrntSideRdrLeObj1 with the same data element name.";
CM_ SG_ 358 FrntSideRdrLeObj6RdrObjVxStdDe "Refer to the data element description in FrntSideRdrLeObj1 with the same data element name.";
CM_ SG_ 358 FrntSideRdrLeObj6RdrObjVy "Refer to the data element description in FrntSideRdrLeObj1 with the same data element name.";
CM_ SG_ 358 FrntSideRdrLeObj6RdrObjVyStdDe "Refer to the data element description in FrntSideRdrLeObj1 with the same data element name.";
CM_ SG_ 358 FrntSideRdrLeObj6RelVx "Refer to the data element description in ReSideRdrRiObj1 with the same data element name";
CM_ SG_ 358 FrntSideRdrLeObj6RelVy "Refer to the data element description in ReSideRdrRiObj1 with the same data element name";
CM_ SG_ 360 FrntSideRdrLeObj7Heading "Refer to the data element description in ReSideRdrRiObj1 with the same data element name";
CM_ SG_ 360 FrntSideRdrLeObj7ObjBoxCenterLat "Box center y coordinate (relative closest point)";
CM_ SG_ 360 FrntSideRdrLeObj7ObjBoxCenterLgt "Box center x coordinate (relative closest point)";
CM_ SG_ 360 FrntSideRdrLeObj7ObservationHist "Refer to the data element description in ReSideRdrRiObj1 with the same data element name";
CM_ SG_ 360 FrntSideRdrLeObj7QualityBits "Refer to the data element description in FrntSideRdrLeObj1 with the same data element name.";
CM_ SG_ 360 FrntSideRdrLeObj7RdrObjAx "Refer to the data element description in FrntSideRdrLeObj1 with the same data element name.";
CM_ SG_ 360 FrntSideRdrLeObj7RdrObjAy "Refer to the data element description in FrntSideRdrLeObj1 with the same data element name.";
CM_ SG_ 360 FrntSideRdrLeObj7RdrObjBoxLength "Box length (box extent that is parallel to objects heading angle)";
CM_ SG_ 360 FrntSideRdrLeObj7RdrObjBoxWidth "Box width (box extent that is perpendicular to objects heading angle)";
CM_ SG_ 360 FrntSideRdrLeObj7RdrObjChks "Refer to the data element description in FrntSideRdrLeObj1 with the same data element name.";
CM_ SG_ 360 FrntSideRdrLeObj7RdrObjCntr "Refer to the data element description in FrntSideRdrLeObj1 with the same data element name.";
CM_ SG_ 360 FrntSideRdrLeObj7RdrObjCoastCnt "Refer to the data element description in FrntSideRdrLeObj1 with the same data element name.";
CM_ SG_ 360 FrntSideRdrLeObj7RdrObjConf "Refer to the data element description in FrntSideRdrLeObj1 with the same data element name.";
CM_ SG_ 360 FrntSideRdrLeObj7RdrObjDx "Refer to the data element description in FrntSideRdrLeObj1 with the same data element name.";
CM_ SG_ 360 FrntSideRdrLeObj7RdrObjDxStdDe "Refer to the data element description in FrntSideRdrLeObj1 with the same data element name.";
CM_ SG_ 360 FrntSideRdrLeObj7RdrObjDy "Refer to the data element description in FrntSideRdrLeObj1 with the same data element name.";
CM_ SG_ 360 FrntSideRdrLeObj7RdrObjDyStdDe "Refer to the data element description in FrntSideRdrLeObj1 with the same data element name.";
CM_ SG_ 360 FrntSideRdrLeObj7RdrObjElevnConf "Refer to the data element description in FrntSideRdrLeObj1 with the same data element name.";
CM_ SG_ 360 FrntSideRdrLeObj7RdrObjElevnSts "Refer to the data element description in FrntSideRdrLeObj1 with the same data element name.";
CM_ SG_ 360 FrntSideRdrLeObj7RdrObjID "Refer to the data element description in FrntSideRdrLeObj1 with the same data element name.";
CM_ SG_ 360 FrntSideRdrLeObj7RdrObjIsInFreeSpace "Refer to the data element description in FrntSideRdrLeObj1 with the same data element name.";
CM_ SG_ 360 FrntSideRdrLeObj7RdrObjMirrProblty "Refer to the data element description in FrntSideRdrLeObj1 with the same data element name.";
CM_ SG_ 360 FrntSideRdrLeObj7RdrObjMtnPat "Refer to the data element description in FrntSideRdrLeObj1 with the same data element name.";
CM_ SG_ 360 FrntSideRdrLeObj7RdrObjNotRealProblty "Refer to the data element description in FrntSideRdrLeObj1 with the same data element name.";
CM_ SG_ 360 FrntSideRdrLeObj7RdrObjStatyCnt "Refer to the data element description in FrntSideRdrLeObj1 with the same data element name.";
CM_ SG_ 360 FrntSideRdrLeObj7RdrObjTiAlv "Refer to the data element description in FrntSideRdrLeObj1 with the same data element name.";
CM_ SG_ 360 FrntSideRdrLeObj7RdrObjTrackSts "Refer to the data element description in FrntSideRdrLeObj1 with the same data element name.";
CM_ SG_ 360 FrntSideRdrLeObj7RdrObjTyp "Refer to the data element description in FrntSideRdrLeObj1 with the same data element name.";
CM_ SG_ 360 FrntSideRdrLeObj7RdrObjTypConfBike "Refer to the data element description in FrntSideRdrLeObj1 with the same data element name.";
CM_ SG_ 360 FrntSideRdrLeObj7RdrObjTypConfPed "Refer to the data element description in FrntSideRdrLeObj1 with the same data element name.";
CM_ SG_ 360 FrntSideRdrLeObj7RdrObjTypConfVeh "Refer to the data element description in FrntSideRdrLeObj1 with the same data element name.";
CM_ SG_ 360 FrntSideRdrLeObj7RdrObjUsedTracker "Refer to the data element description in FrntSideRdrLeObj1 with the same data element name.";
CM_ SG_ 360 FrntSideRdrLeObj7RdrObjVx "Refer to the data element description in FrntSideRdrLeObj1 with the same data element name.";
CM_ SG_ 360 FrntSideRdrLeObj7RdrObjVxStdDe "Refer to the data element description in FrntSideRdrLeObj1 with the same data element name.";
CM_ SG_ 360 FrntSideRdrLeObj7RdrObjVy "Refer to the data element description in FrntSideRdrLeObj1 with the same data element name.";
CM_ SG_ 360 FrntSideRdrLeObj7RdrObjVyStdDe "Refer to the data element description in FrntSideRdrLeObj1 with the same data element name.";
CM_ SG_ 360 FrntSideRdrLeObj7RelVx "Refer to the data element description in ReSideRdrRiObj1 with the same data element name";
CM_ SG_ 360 FrntSideRdrLeObj7RelVy "Refer to the data element description in ReSideRdrRiObj1 with the same data element name";
CM_ SG_ 362 FrntSideRdrLeObj8Heading "Refer to the data element description in ReSideRdrRiObj1 with the same data element name";
CM_ SG_ 362 FrntSideRdrLeObj8ObjBoxCenterLat "Box center y coordinate (relative closest point)";
CM_ SG_ 362 FrntSideRdrLeObj8ObjBoxCenterLgt "Box center x coordinate (relative closest point)";
CM_ SG_ 362 FrntSideRdrLeObj8ObservationHist "Refer to the data element description in ReSideRdrRiObj1 with the same data element name";
CM_ SG_ 362 FrntSideRdrLeObj8QualityBits "Refer to the data element description in FrntSideRdrLeObj1 with the same data element name.";
CM_ SG_ 362 FrntSideRdrLeObj8RdrObjAx "Refer to the data element description in FrntSideRdrLeObj1 with the same data element name.";
CM_ SG_ 362 FrntSideRdrLeObj8RdrObjAy "Refer to the data element description in FrntSideRdrLeObj1 with the same data element name.";
CM_ SG_ 362 FrntSideRdrLeObj8RdrObjBoxLength "Box length (box extent that is parallel to objects heading angle)";
CM_ SG_ 362 FrntSideRdrLeObj8RdrObjBoxWidth "Box width (box extent that is perpendicular to objects heading angle)";
CM_ SG_ 362 FrntSideRdrLeObj8RdrObjChks "Refer to the data element description in FrntSideRdrLeObj1 with the same data element name.";
CM_ SG_ 362 FrntSideRdrLeObj8RdrObjCntr "Refer to the data element description in FrntSideRdrLeObj1 with the same data element name.";
CM_ SG_ 362 FrntSideRdrLeObj8RdrObjCoastCnt "Refer to the data element description in FrntSideRdrLeObj1 with the same data element name.";
CM_ SG_ 362 FrntSideRdrLeObj8RdrObjConf "Refer to the data element description in FrntSideRdrLeObj1 with the same data element name.";
CM_ SG_ 362 FrntSideRdrLeObj8RdrObjDx "Refer to the data element description in FrntSideRdrLeObj1 with the same data element name.";
CM_ SG_ 362 FrntSideRdrLeObj8RdrObjDxStdDe "Refer to the data element description in FrntSideRdrLeObj1 with the same data element name.";
CM_ SG_ 362 FrntSideRdrLeObj8RdrObjDy "Refer to the data element description in FrntSideRdrLeObj1 with the same data element name.";
CM_ SG_ 362 FrntSideRdrLeObj8RdrObjDyStdDe "Refer to the data element description in FrntSideRdrLeObj1 with the same data element name.";
CM_ SG_ 362 FrntSideRdrLeObj8RdrObjElevnConf "Refer to the data element description in FrntSideRdrLeObj1 with the same data element name.";
CM_ SG_ 362 FrntSideRdrLeObj8RdrObjElevnSts "Refer to the data element description in FrntSideRdrLeObj1 with the same data element name.";
CM_ SG_ 362 FrntSideRdrLeObj8RdrObjID "Refer to the data element description in FrntSideRdrLeObj1 with the same data element name.";
CM_ SG_ 362 FrntSideRdrLeObj8RdrObjIsInFreeSpace "Refer to the data element description in FrntSideRdrLeObj1 with the same data element name.";
CM_ SG_ 362 FrntSideRdrLeObj8RdrObjMirrProblty "Refer to the data element description in FrntSideRdrLeObj1 with the same data element name.";
CM_ SG_ 362 FrntSideRdrLeObj8RdrObjMtnPat "Refer to the data element description in FrntSideRdrLeObj1 with the same data element name.";
CM_ SG_ 362 FrntSideRdrLeObj8RdrObjNotRealProblty "Refer to the data element description in FrntSideRdrLeObj1 with the same data element name.";
CM_ SG_ 362 FrntSideRdrLeObj8RdrObjStatyCnt "Refer to the data element description in FrntSideRdrLeObj1 with the same data element name.";
CM_ SG_ 362 FrntSideRdrLeObj8RdrObjTiAlv "Refer to the data element description in FrntSideRdrLeObj1 with the same data element name.";
CM_ SG_ 362 FrntSideRdrLeObj8RdrObjTrackSts "Refer to the data element description in FrntSideRdrLeObj1 with the same data element name.";
CM_ SG_ 362 FrntSideRdrLeObj8RdrObjTyp "Refer to the data element description in FrntSideRdrLeObj1 with the same data element name.";
CM_ SG_ 362 FrntSideRdrLeObj8RdrObjTypConfBike "Refer to the data element description in FrntSideRdrLeObj1 with the same data element name.";
CM_ SG_ 362 FrntSideRdrLeObj8RdrObjTypConfPed "Refer to the data element description in FrntSideRdrLeObj1 with the same data element name.";
CM_ SG_ 362 FrntSideRdrLeObj8RdrObjTypConfVeh "Refer to the data element description in FrntSideRdrLeObj1 with the same data element name.";
CM_ SG_ 362 FrntSideRdrLeObj8RdrObjUsedTracker "Refer to the data element description in FrntSideRdrLeObj1 with the same data element name.";
CM_ SG_ 362 FrntSideRdrLeObj8RdrObjVx "Refer to the data element description in FrntSideRdrLeObj1 with the same data element name.";
CM_ SG_ 362 FrntSideRdrLeObj8RdrObjVxStdDe "Refer to the data element description in FrntSideRdrLeObj1 with the same data element name.";
CM_ SG_ 362 FrntSideRdrLeObj8RdrObjVy "Refer to the data element description in FrntSideRdrLeObj1 with the same data element name.";
CM_ SG_ 362 FrntSideRdrLeObj8RdrObjVyStdDe "Refer to the data element description in FrntSideRdrLeObj1 with the same data element name.";
CM_ SG_ 362 FrntSideRdrLeObj8RelVx "Refer to the data element description in ReSideRdrRiObj1 with the same data element name";
CM_ SG_ 362 FrntSideRdrLeObj8RelVy "Refer to the data element description in ReSideRdrRiObj1 with the same data element name";
CM_ SG_ 364 FrntSideRdrLeObj9Heading "Refer to the data element description in ReSideRdrRiObj1 with the same data element name";
CM_ SG_ 364 FrntSideRdrLeObj9ObjBoxCenterLat "Box center y coordinate (relative closest point)";
CM_ SG_ 364 FrntSideRdrLeObj9ObjBoxCenterLgt "Box center x coordinate (relative closest point)";
CM_ SG_ 364 FrntSideRdrLeObj9ObservationHist "Refer to the data element description in ReSideRdrRiObj1 with the same data element name";
CM_ SG_ 364 FrntSideRdrLeObj9QualityBits "Refer to the data element description in FrntSideRdrLeObj1 with the same data element name.";
CM_ SG_ 364 FrntSideRdrLeObj9RdrObjAx "Refer to the data element description in FrntSideRdrLeObj1 with the same data element name.";
CM_ SG_ 364 FrntSideRdrLeObj9RdrObjAy "Refer to the data element description in FrntSideRdrLeObj1 with the same data element name.";
CM_ SG_ 364 FrntSideRdrLeObj9RdrObjBoxLength "Box length (box extent that is parallel to objects heading angle)";
CM_ SG_ 364 FrntSideRdrLeObj9RdrObjBoxWidth "Box width (box extent that is perpendicular to objects heading angle)";
CM_ SG_ 364 FrntSideRdrLeObj9RdrObjChks "Refer to the data element description in FrntSideRdrLeObj1 with the same data element name.";
CM_ SG_ 364 FrntSideRdrLeObj9RdrObjCntr "Refer to the data element description in FrntSideRdrLeObj1 with the same data element name.";
CM_ SG_ 364 FrntSideRdrLeObj9RdrObjCoastCnt "Refer to the data element description in FrntSideRdrLeObj1 with the same data element name.";
CM_ SG_ 364 FrntSideRdrLeObj9RdrObjConf "Refer to the data element description in FrntSideRdrLeObj1 with the same data element name.";
CM_ SG_ 364 FrntSideRdrLeObj9RdrObjDx "Refer to the data element description in FrntSideRdrLeObj1 with the same data element name.";
CM_ SG_ 364 FrntSideRdrLeObj9RdrObjDxStdDe "Refer to the data element description in FrntSideRdrLeObj1 with the same data element name.";
CM_ SG_ 364 FrntSideRdrLeObj9RdrObjDy "Refer to the data element description in FrntSideRdrLeObj1 with the same data element name.";
CM_ SG_ 364 FrntSideRdrLeObj9RdrObjDyStdDe "Refer to the data element description in FrntSideRdrLeObj1 with the same data element name.";
CM_ SG_ 364 FrntSideRdrLeObj9RdrObjElevnConf "Refer to the data element description in FrntSideRdrLeObj1 with the same data element name.";
CM_ SG_ 364 FrntSideRdrLeObj9RdrObjElevnSts "Refer to the data element description in FrntSideRdrLeObj1 with the same data element name.";
CM_ SG_ 364 FrntSideRdrLeObj9RdrObjID "Refer to the data element description in FrntSideRdrLeObj1 with the same data element name.";
CM_ SG_ 364 FrntSideRdrLeObj9RdrObjIsInFreeSpace "Refer to the data element description in FrntSideRdrLeObj1 with the same data element name.";
CM_ SG_ 364 FrntSideRdrLeObj9RdrObjMirrProblty "Refer to the data element description in FrntSideRdrLeObj1 with the same data element name.";
CM_ SG_ 364 FrntSideRdrLeObj9RdrObjMtnPat "Refer to the data element description in FrntSideRdrLeObj1 with the same data element name.";
CM_ SG_ 364 FrntSideRdrLeObj9RdrObjNotRealProblty "Refer to the data element description in FrntSideRdrLeObj1 with the same data element name.";
CM_ SG_ 364 FrntSideRdrLeObj9RdrObjStatyCnt "Refer to the data element description in FrntSideRdrLeObj1 with the same data element name.";
CM_ SG_ 364 FrntSideRdrLeObj9RdrObjTiAlv "Refer to the data element description in FrntSideRdrLeObj1 with the same data element name.";
CM_ SG_ 364 FrntSideRdrLeObj9RdrObjTrackSts "Refer to the data element description in FrntSideRdrLeObj1 with the same data element name.";
CM_ SG_ 364 FrntSideRdrLeObj9RdrObjTyp "Refer to the data element description in FrntSideRdrLeObj1 with the same data element name.";
CM_ SG_ 364 FrntSideRdrLeObj9RdrObjTypConfBike "Refer to the data element description in FrntSideRdrLeObj1 with the same data element name.";
CM_ SG_ 364 FrntSideRdrLeObj9RdrObjTypConfPed "Refer to the data element description in FrntSideRdrLeObj1 with the same data element name.";
CM_ SG_ 364 FrntSideRdrLeObj9RdrObjTypConfVeh "Refer to the data element description in FrntSideRdrLeObj1 with the same data element name.";
CM_ SG_ 364 FrntSideRdrLeObj9RdrObjUsedTracker "Refer to the data element description in FrntSideRdrLeObj1 with the same data element name.";
CM_ SG_ 364 FrntSideRdrLeObj9RdrObjVx "Refer to the data element description in FrntSideRdrLeObj1 with the same data element name.";
CM_ SG_ 364 FrntSideRdrLeObj9RdrObjVxStdDe "Refer to the data element description in FrntSideRdrLeObj1 with the same data element name.";
CM_ SG_ 364 FrntSideRdrLeObj9RdrObjVy "Refer to the data element description in FrntSideRdrLeObj1 with the same data element name.";
CM_ SG_ 364 FrntSideRdrLeObj9RdrObjVyStdDe "Refer to the data element description in FrntSideRdrLeObj1 with the same data element name.";
CM_ SG_ 364 FrntSideRdrLeObj9RelVx "Refer to the data element description in ReSideRdrRiObj1 with the same data element name";
CM_ SG_ 364 FrntSideRdrLeObj9RelVy "Refer to the data element description in ReSideRdrRiObj1 with the same data element name";
CM_ SG_ 366 FrntSideRdrLeObj10Heading "Refer to the data element description in ReSideRdrRiObj1 with the same data element name";
CM_ SG_ 366 FrntSideRdrLeObj10ObjBoxCenterLat "Box center y coordinate (relative closest point)";
CM_ SG_ 366 FrntSideRdrLeObj10ObjBoxCenterLgt "Box center x coordinate (relative closest point)";
CM_ SG_ 366 FrntSideRdrLeObj10ObservationHist "Refer to the data element description in ReSideRdrRiObj1 with the same data element name";
CM_ SG_ 366 FrntSideRdrLeObj10QualityBits "Refer to the data element description in FrntSideRdrLeObj1 with the same data element name.";
CM_ SG_ 366 FrntSideRdrLeObj10RdrObjAx "Refer to the data element description in FrntSideRdrLeObj1 with the same data element name.";
CM_ SG_ 366 FrntSideRdrLeObj10RdrObjAy "Refer to the data element description in FrntSideRdrLeObj1 with the same data element name.";
CM_ SG_ 366 FrntSideRdrLeObj10RdrObjBoxLength "Box length (box extent that is parallel to objects heading angle)";
CM_ SG_ 366 FrntSideRdrLeObj10RdrObjBoxWidth "Box width (box extent that is perpendicular to objects heading angle)";
CM_ SG_ 366 FrntSideRdrLeObj10RdrObjChks "Refer to the data element description in FrntSideRdrLeObj1 with the same data element name.";
CM_ SG_ 366 FrntSideRdrLeObj10RdrObjCntr "Refer to the data element description in FrntSideRdrLeObj1 with the same data element name.";
CM_ SG_ 366 FrntSideRdrLeObj10RdrObjCoastCnt "Refer to the data element description in FrntSideRdrLeObj1 with the same data element name.";
CM_ SG_ 366 FrntSideRdrLeObj10RdrObjConf "Refer to the data element description in FrntSideRdrLeObj1 with the same data element name.";
CM_ SG_ 366 FrntSideRdrLeObj10RdrObjDx "Refer to the data element description in FrntSideRdrLeObj1 with the same data element name.";
CM_ SG_ 366 FrntSideRdrLeObj10RdrObjDxStdDe "Refer to the data element description in FrntSideRdrLeObj1 with the same data element name.";
CM_ SG_ 366 FrntSideRdrLeObj10RdrObjDy "Refer to the data element description in FrntSideRdrLeObj1 with the same data element name.";
CM_ SG_ 366 FrntSideRdrLeObj10RdrObjDyStdDe "Refer to the data element description in FrntSideRdrLeObj1 with the same data element name.";
CM_ SG_ 366 FrntSideRdrLeObj10RdrObjElevnConf "Refer to the data element description in FrntSideRdrLeObj1 with the same data element name.";
CM_ SG_ 366 FrntSideRdrLeObj10RdrObjElevnSts "Refer to the data element description in FrntSideRdrLeObj1 with the same data element name.";
CM_ SG_ 366 FrntSideRdrLeObj10RdrObjID "Refer to the data element description in FrntSideRdrLeObj1 with the same data element name.";
CM_ SG_ 366 FrntSideRdrLeObj10RdrObjIsInFreeSpace "Refer to the data element description in FrntSideRdrLeObj1 with the same data element name.";
CM_ SG_ 366 FrntSideRdrLeObj10RdrObjMirrProblty "Refer to the data element description in FrntSideRdrLeObj1 with the same data element name.";
CM_ SG_ 366 FrntSideRdrLeObj10RdrObjMtnPat "Refer to the data element description in FrntSideRdrLeObj1 with the same data element name.";
CM_ SG_ 366 FrntSideRdrLeObj10RdrObjNotRealProblty "Refer to the data element description in FrntSideRdrLeObj1 with the same data element name.";
CM_ SG_ 366 FrntSideRdrLeObj10RdrObjStatyCnt "Refer to the data element description in FrntSideRdrLeObj1 with the same data element name.";
CM_ SG_ 366 FrntSideRdrLeObj10RdrObjTiAlv "Refer to the data element description in FrntSideRdrLeObj1 with the same data element name.";
CM_ SG_ 366 FrntSideRdrLeObj10RdrObjTrackSts "Refer to the data element description in FrntSideRdrLeObj1 with the same data element name.";
CM_ SG_ 366 FrntSideRdrLeObj10RdrObjTyp "Refer to the data element description in FrntSideRdrLeObj1 with the same data element name.";
CM_ SG_ 366 FrntSideRdrLeObj10RdrObjTypConfBike "Refer to the data element description in FrntSideRdrLeObj1 with the same data element name.";
CM_ SG_ 366 FrntSideRdrLeObj10RdrObjTypConfPed "Refer to the data element description in FrntSideRdrLeObj1 with the same data element name.";
CM_ SG_ 366 FrntSideRdrLeObj10RdrObjTypConfVeh "Refer to the data element description in FrntSideRdrLeObj1 with the same data element name.";
CM_ SG_ 366 FrntSideRdrLeObj10RdrObjUsedTracker "Refer to the data element description in FrntSideRdrLeObj1 with the same data element name.";
CM_ SG_ 366 FrntSideRdrLeObj10RdrObjVx "Refer to the data element description in FrntSideRdrLeObj1 with the same data element name.";
CM_ SG_ 366 FrntSideRdrLeObj10RdrObjVxStdDe "Refer to the data element description in FrntSideRdrLeObj1 with the same data element name.";
CM_ SG_ 366 FrntSideRdrLeObj10RdrObjVy "Refer to the data element description in FrntSideRdrLeObj1 with the same data element name.";
CM_ SG_ 366 FrntSideRdrLeObj10RdrObjVyStdDe "Refer to the data element description in FrntSideRdrLeObj1 with the same data element name.";
CM_ SG_ 366 FrntSideRdrLeObj10RelVx "Refer to the data element description in ReSideRdrRiObj1 with the same data element name";
CM_ SG_ 366 FrntSideRdrLeObj10RelVy "Refer to the data element description in ReSideRdrRiObj1 with the same data element name";
CM_ SG_ 368 FrntSideRdrLeObj11Heading "Refer to the data element description in ReSideRdrRiObj1 with the same data element name";
CM_ SG_ 368 FrntSideRdrLeObj11ObjBoxCenterLat "Box center y coordinate (relative closest point)";
CM_ SG_ 368 FrntSideRdrLeObj11ObjBoxCenterLgt "Box center x coordinate (relative closest point)";
CM_ SG_ 368 FrntSideRdrLeObj11ObservationHist "Refer to the data element description in ReSideRdrRiObj1 with the same data element name";
CM_ SG_ 368 FrntSideRdrLeObj11QualityBits "Refer to the data element description in FrntSideRdrLeObj1 with the same data element name.";
CM_ SG_ 368 FrntSideRdrLeObj11RdrObjAx "Refer to the data element description in FrntSideRdrLeObj1 with the same data element name.";
CM_ SG_ 368 FrntSideRdrLeObj11RdrObjAy "Refer to the data element description in FrntSideRdrLeObj1 with the same data element name.";
CM_ SG_ 368 FrntSideRdrLeObj11RdrObjBoxLength "Box length (box extent that is parallel to objects heading angle)";
CM_ SG_ 368 FrntSideRdrLeObj11RdrObjBoxWidth "Box width (box extent that is perpendicular to objects heading angle)";
CM_ SG_ 368 FrntSideRdrLeObj11RdrObjChks "Refer to the data element description in FrntSideRdrLeObj1 with the same data element name.";
CM_ SG_ 368 FrntSideRdrLeObj11RdrObjCntr "Refer to the data element description in FrntSideRdrLeObj1 with the same data element name.";
CM_ SG_ 368 FrntSideRdrLeObj11RdrObjCoastCnt "Refer to the data element description in FrntSideRdrLeObj1 with the same data element name.";
CM_ SG_ 368 FrntSideRdrLeObj11RdrObjConf "Refer to the data element description in FrntSideRdrLeObj1 with the same data element name.";
CM_ SG_ 368 FrntSideRdrLeObj11RdrObjDx "Refer to the data element description in FrntSideRdrLeObj1 with the same data element name.";
CM_ SG_ 368 FrntSideRdrLeObj11RdrObjDxStdDe "Refer to the data element description in FrntSideRdrLeObj1 with the same data element name.";
CM_ SG_ 368 FrntSideRdrLeObj11RdrObjDy "Refer to the data element description in FrntSideRdrLeObj1 with the same data element name.";
CM_ SG_ 368 FrntSideRdrLeObj11RdrObjDyStdDe "Refer to the data element description in FrntSideRdrLeObj1 with the same data element name.";
CM_ SG_ 368 FrntSideRdrLeObj11RdrObjElevnConf "Refer to the data element description in FrntSideRdrLeObj1 with the same data element name.";
CM_ SG_ 368 FrntSideRdrLeObj11RdrObjElevnSts "Refer to the data element description in FrntSideRdrLeObj1 with the same data element name.";
CM_ SG_ 368 FrntSideRdrLeObj11RdrObjID "Refer to the data element description in FrntSideRdrLeObj1 with the same data element name.";
CM_ SG_ 368 FrntSideRdrLeObj11RdrObjIsInFreeSpace "Refer to the data element description in FrntSideRdrLeObj1 with the same data element name.";
CM_ SG_ 368 FrntSideRdrLeObj11RdrObjMirrProblty "Refer to the data element description in FrntSideRdrLeObj1 with the same data element name.";
CM_ SG_ 368 FrntSideRdrLeObj11RdrObjMtnPat "Refer to the data element description in FrntSideRdrLeObj1 with the same data element name.";
CM_ SG_ 368 FrntSideRdrLeObj11RdrObjNotRealProblty "Refer to the data element description in FrntSideRdrLeObj1 with the same data element name.";
CM_ SG_ 368 FrntSideRdrLeObj11RdrObjStatyCnt "Refer to the data element description in FrntSideRdrLeObj1 with the same data element name.";
CM_ SG_ 368 FrntSideRdrLeObj11RdrObjTiAlv "Refer to the data element description in FrntSideRdrLeObj1 with the same data element name.";
CM_ SG_ 368 FrntSideRdrLeObj11RdrObjTrackSts "Refer to the data element description in FrntSideRdrLeObj1 with the same data element name.";
CM_ SG_ 368 FrntSideRdrLeObj11RdrObjTyp "Refer to the data element description in FrntSideRdrLeObj1 with the same data element name.";
CM_ SG_ 368 FrntSideRdrLeObj11RdrObjTypConfBike "Refer to the data element description in FrntSideRdrLeObj1 with the same data element name.";
CM_ SG_ 368 FrntSideRdrLeObj11RdrObjTypConfPed "Refer to the data element description in FrntSideRdrLeObj1 with the same data element name.";
CM_ SG_ 368 FrntSideRdrLeObj11RdrObjTypConfVeh "Refer to the data element description in FrntSideRdrLeObj1 with the same data element name.";
CM_ SG_ 368 FrntSideRdrLeObj11RdrObjUsedTracker "Refer to the data element description in FrntSideRdrLeObj1 with the same data element name.";
CM_ SG_ 368 FrntSideRdrLeObj11RdrObjVx "Refer to the data element description in FrntSideRdrLeObj1 with the same data element name.";
CM_ SG_ 368 FrntSideRdrLeObj11RdrObjVxStdDe "Refer to the data element description in FrntSideRdrLeObj1 with the same data element name.";
CM_ SG_ 368 FrntSideRdrLeObj11RdrObjVy "Refer to the data element description in FrntSideRdrLeObj1 with the same data element name.";
CM_ SG_ 368 FrntSideRdrLeObj11RdrObjVyStdDe "Refer to the data element description in FrntSideRdrLeObj1 with the same data element name.";
CM_ SG_ 368 FrntSideRdrLeObj11RelVx "Refer to the data element description in ReSideRdrRiObj1 with the same data element name";
CM_ SG_ 368 FrntSideRdrLeObj11RelVy "Refer to the data element description in ReSideRdrRiObj1 with the same data element name";
CM_ SG_ 370 FrntSideRdrLeObj12Heading "Refer to the data element description in ReSideRdrRiObj1 with the same data element name";
CM_ SG_ 370 FrntSideRdrLeObj12ObjBoxCenterLat "Box center y coordinate (relative closest point)";
CM_ SG_ 370 FrntSideRdrLeObj12ObjBoxCenterLgt "Box center x coordinate (relative closest point)";
CM_ SG_ 370 FrntSideRdrLeObj12ObservationHist "Refer to the data element description in ReSideRdrRiObj1 with the same data element name";
CM_ SG_ 370 FrntSideRdrLeObj12QualityBits "Refer to the data element description in FrntSideRdrLeObj1 with the same data element name.";
CM_ SG_ 370 FrntSideRdrLeObj12RdrObjAx "Refer to the data element description in FrntSideRdrLeObj1 with the same data element name.";
CM_ SG_ 370 FrntSideRdrLeObj12RdrObjAy "Refer to the data element description in FrntSideRdrLeObj1 with the same data element name.";
CM_ SG_ 370 FrntSideRdrLeObj12RdrObjBoxLength "Box length (box extent that is parallel to objects heading angle)";
CM_ SG_ 370 FrntSideRdrLeObj12RdrObjBoxWidth "Box width (box extent that is perpendicular to objects heading angle)";
CM_ SG_ 370 FrntSideRdrLeObj12RdrObjChks "Refer to the data element description in FrntSideRdrLeObj1 with the same data element name.";
CM_ SG_ 370 FrntSideRdrLeObj12RdrObjCntr "Refer to the data element description in FrntSideRdrLeObj1 with the same data element name.";
CM_ SG_ 370 FrntSideRdrLeObj12RdrObjCoastCnt "Refer to the data element description in FrntSideRdrLeObj1 with the same data element name.";
CM_ SG_ 370 FrntSideRdrLeObj12RdrObjConf "Refer to the data element description in FrntSideRdrLeObj1 with the same data element name.";
CM_ SG_ 370 FrntSideRdrLeObj12RdrObjDx "Refer to the data element description in FrntSideRdrLeObj1 with the same data element name.";
CM_ SG_ 370 FrntSideRdrLeObj12RdrObjDxStdDe "Refer to the data element description in FrntSideRdrLeObj1 with the same data element name.";
CM_ SG_ 370 FrntSideRdrLeObj12RdrObjDy "Refer to the data element description in FrntSideRdrLeObj1 with the same data element name.";
CM_ SG_ 370 FrntSideRdrLeObj12RdrObjDyStdDe "Refer to the data element description in FrntSideRdrLeObj1 with the same data element name.";
CM_ SG_ 370 FrntSideRdrLeObj12RdrObjElevnConf "Refer to the data element description in FrntSideRdrLeObj1 with the same data element name.";
CM_ SG_ 370 FrntSideRdrLeObj12RdrObjElevnSts "Refer to the data element description in FrntSideRdrLeObj1 with the same data element name.";
CM_ SG_ 370 FrntSideRdrLeObj12RdrObjID "Refer to the data element description in FrntSideRdrLeObj1 with the same data element name.";
CM_ SG_ 370 FrntSideRdrLeObj12RdrObjIsInFreeSpace "Refer to the data element description in FrntSideRdrLeObj1 with the same data element name.";
CM_ SG_ 370 FrntSideRdrLeObj12RdrObjMirrProblty "Refer to the data element description in FrntSideRdrLeObj1 with the same data element name.";
CM_ SG_ 370 FrntSideRdrLeObj12RdrObjMtnPat "Refer to the data element description in FrntSideRdrLeObj1 with the same data element name.";
CM_ SG_ 370 FrntSideRdrLeObj12RdrObjNotRealProblty "Refer to the data element description in FrntSideRdrLeObj1 with the same data element name.";
CM_ SG_ 370 FrntSideRdrLeObj12RdrObjStatyCnt "Refer to the data element description in FrntSideRdrLeObj1 with the same data element name.";
CM_ SG_ 370 FrntSideRdrLeObj12RdrObjTiAlv "Refer to the data element description in FrntSideRdrLeObj1 with the same data element name.";
CM_ SG_ 370 FrntSideRdrLeObj12RdrObjTrackSts "Refer to the data element description in FrntSideRdrLeObj1 with the same data element name.";
CM_ SG_ 370 FrntSideRdrLeObj12RdrObjTyp "Refer to the data element description in FrntSideRdrLeObj1 with the same data element name.";
CM_ SG_ 370 FrntSideRdrLeObj12RdrObjTypConfBike "Refer to the data element description in FrntSideRdrLeObj1 with the same data element name.";
CM_ SG_ 370 FrntSideRdrLeObj12RdrObjTypConfPed "Refer to the data element description in FrntSideRdrLeObj1 with the same data element name.";
CM_ SG_ 370 FrntSideRdrLeObj12RdrObjTypConfVeh "Refer to the data element description in FrntSideRdrLeObj1 with the same data element name.";
CM_ SG_ 370 FrntSideRdrLeObj12RdrObjUsedTracker "Refer to the data element description in FrntSideRdrLeObj1 with the same data element name.";
CM_ SG_ 370 FrntSideRdrLeObj12RdrObjVx "Refer to the data element description in FrntSideRdrLeObj1 with the same data element name.";
CM_ SG_ 370 FrntSideRdrLeObj12RdrObjVxStdDe "Refer to the data element description in FrntSideRdrLeObj1 with the same data element name.";
CM_ SG_ 370 FrntSideRdrLeObj12RdrObjVy "Refer to the data element description in FrntSideRdrLeObj1 with the same data element name.";
CM_ SG_ 370 FrntSideRdrLeObj12RdrObjVyStdDe "Refer to the data element description in FrntSideRdrLeObj1 with the same data element name.";
CM_ SG_ 370 FrntSideRdrLeObj12RelVx "Refer to the data element description in ReSideRdrRiObj1 with the same data element name";
CM_ SG_ 370 FrntSideRdrLeObj12RelVy "Refer to the data element description in ReSideRdrRiObj1 with the same data element name";
CM_ SG_ 372 FrntSideRdrLeObj13Heading "Refer to the data element description in ReSideRdrRiObj1 with the same data element name";
CM_ SG_ 372 FrntSideRdrLeObj13ObjBoxCenterLat "Box center y coordinate (relative closest point)";
CM_ SG_ 372 FrntSideRdrLeObj13ObjBoxCenterLgt "Box center x coordinate (relative closest point)";
CM_ SG_ 372 FrntSideRdrLeObj13ObservationHist "Refer to the data element description in ReSideRdrRiObj1 with the same data element name";
CM_ SG_ 372 FrntSideRdrLeObj13QualityBits "Refer to the data element description in FrntSideRdrLeObj1 with the same data element name.";
CM_ SG_ 372 FrntSideRdrLeObj13RdrObjAx "Refer to the data element description in FrntSideRdrLeObj1 with the same data element name.";
CM_ SG_ 372 FrntSideRdrLeObj13RdrObjAy "Refer to the data element description in FrntSideRdrLeObj1 with the same data element name.";
CM_ SG_ 372 FrntSideRdrLeObj13RdrObjBoxLength "Box length (box extent that is parallel to objects heading angle)";
CM_ SG_ 372 FrntSideRdrLeObj13RdrObjBoxWidth "Box width (box extent that is perpendicular to objects heading angle)";
CM_ SG_ 372 FrntSideRdrLeObj13RdrObjChks "Refer to the data element description in FrntSideRdrLeObj1 with the same data element name.";
CM_ SG_ 372 FrntSideRdrLeObj13RdrObjCntr "Refer to the data element description in FrntSideRdrLeObj1 with the same data element name.";
CM_ SG_ 372 FrntSideRdrLeObj13RdrObjCoastCnt "Refer to the data element description in FrntSideRdrLeObj1 with the same data element name.";
CM_ SG_ 372 FrntSideRdrLeObj13RdrObjConf "Refer to the data element description in FrntSideRdrLeObj1 with the same data element name.";
CM_ SG_ 372 FrntSideRdrLeObj13RdrObjDx "Refer to the data element description in FrntSideRdrLeObj1 with the same data element name.";
CM_ SG_ 372 FrntSideRdrLeObj13RdrObjDxStdDe "Refer to the data element description in FrntSideRdrLeObj1 with the same data element name.";
CM_ SG_ 372 FrntSideRdrLeObj13RdrObjDy "Refer to the data element description in FrntSideRdrLeObj1 with the same data element name.";
CM_ SG_ 372 FrntSideRdrLeObj13RdrObjDyStdDe "Refer to the data element description in FrntSideRdrLeObj1 with the same data element name.";
CM_ SG_ 372 FrntSideRdrLeObj13RdrObjElevnConf "Refer to the data element description in FrntSideRdrLeObj1 with the same data element name.";
CM_ SG_ 372 FrntSideRdrLeObj13RdrObjElevnSts "Refer to the data element description in FrntSideRdrLeObj1 with the same data element name.";
CM_ SG_ 372 FrntSideRdrLeObj13RdrObjID "Refer to the data element description in FrntSideRdrLeObj1 with the same data element name.";
CM_ SG_ 372 FrntSideRdrLeObj13RdrObjIsInFreeSpace "Refer to the data element description in FrntSideRdrLeObj1 with the same data element name.";
CM_ SG_ 372 FrntSideRdrLeObj13RdrObjMirrProblty "Refer to the data element description in FrntSideRdrLeObj1 with the same data element name.";
CM_ SG_ 372 FrntSideRdrLeObj13RdrObjMtnPat "Refer to the data element description in FrntSideRdrLeObj1 with the same data element name.";
CM_ SG_ 372 FrntSideRdrLeObj13RdrObjNotRealProblty "Refer to the data element description in FrntSideRdrLeObj1 with the same data element name.";
CM_ SG_ 372 FrntSideRdrLeObj13RdrObjStatyCnt "Refer to the data element description in FrntSideRdrLeObj1 with the same data element name.";
CM_ SG_ 372 FrntSideRdrLeObj13RdrObjTiAlv "Refer to the data element description in FrntSideRdrLeObj1 with the same data element name.";
CM_ SG_ 372 FrntSideRdrLeObj13RdrObjTrackSts "Refer to the data element description in FrntSideRdrLeObj1 with the same data element name.";
CM_ SG_ 372 FrntSideRdrLeObj13RdrObjTyp "Refer to the data element description in FrntSideRdrLeObj1 with the same data element name.";
CM_ SG_ 372 FrntSideRdrLeObj13RdrObjTypConfBike "Refer to the data element description in FrntSideRdrLeObj1 with the same data element name.";
CM_ SG_ 372 FrntSideRdrLeObj13RdrObjTypConfPed "Refer to the data element description in FrntSideRdrLeObj1 with the same data element name.";
CM_ SG_ 372 FrntSideRdrLeObj13RdrObjTypConfVeh "Refer to the data element description in FrntSideRdrLeObj1 with the same data element name.";
CM_ SG_ 372 FrntSideRdrLeObj13RdrObjUsedTracker "Refer to the data element description in FrntSideRdrLeObj1 with the same data element name.";
CM_ SG_ 372 FrntSideRdrLeObj13RdrObjVx "Refer to the data element description in FrntSideRdrLeObj1 with the same data element name.";
CM_ SG_ 372 FrntSideRdrLeObj13RdrObjVxStdDe "Refer to the data element description in FrntSideRdrLeObj1 with the same data element name.";
CM_ SG_ 372 FrntSideRdrLeObj13RdrObjVy "Refer to the data element description in FrntSideRdrLeObj1 with the same data element name.";
CM_ SG_ 372 FrntSideRdrLeObj13RdrObjVyStdDe "Refer to the data element description in FrntSideRdrLeObj1 with the same data element name.";
CM_ SG_ 372 FrntSideRdrLeObj13RelVx "Refer to the data element description in ReSideRdrRiObj1 with the same data element name";
CM_ SG_ 372 FrntSideRdrLeObj13RelVy "Refer to the data element description in ReSideRdrRiObj1 with the same data element name";
CM_ SG_ 374 FrntSideRdrLeObj14Heading "Refer to the data element description in ReSideRdrRiObj1 with the same data element name";
CM_ SG_ 374 FrntSideRdrLeObj14ObjBoxCenterLat "Box center y coordinate (relative closest point)";
CM_ SG_ 374 FrntSideRdrLeObj14ObjBoxCenterLgt "Box center x coordinate (relative closest point)";
CM_ SG_ 374 FrntSideRdrLeObj14ObservationHist "Refer to the data element description in ReSideRdrRiObj1 with the same data element name";
CM_ SG_ 374 FrntSideRdrLeObj14QualityBits "Refer to the data element description in FrntSideRdrLeObj1 with the same data element name.";
CM_ SG_ 374 FrntSideRdrLeObj14RdrObjAx "Refer to the data element description in FrntSideRdrLeObj1 with the same data element name.";
CM_ SG_ 374 FrntSideRdrLeObj14RdrObjAy "Refer to the data element description in FrntSideRdrLeObj1 with the same data element name.";
CM_ SG_ 374 FrntSideRdrLeObj14RdrObjBoxLength "Box length (box extent that is parallel to objects heading angle)";
CM_ SG_ 374 FrntSideRdrLeObj14RdrObjBoxWidth "Box width (box extent that is perpendicular to objects heading angle)";
CM_ SG_ 374 FrntSideRdrLeObj14RdrObjChks "Refer to the data element description in FrntSideRdrLeObj1 with the same data element name.";
CM_ SG_ 374 FrntSideRdrLeObj14RdrObjCntr "Refer to the data element description in FrntSideRdrLeObj1 with the same data element name.";
CM_ SG_ 374 FrntSideRdrLeObj14RdrObjCoastCnt "Refer to the data element description in FrntSideRdrLeObj1 with the same data element name.";
CM_ SG_ 374 FrntSideRdrLeObj14RdrObjConf "Refer to the data element description in FrntSideRdrLeObj1 with the same data element name.";
CM_ SG_ 374 FrntSideRdrLeObj14RdrObjDx "Refer to the data element description in FrntSideRdrLeObj1 with the same data element name.";
CM_ SG_ 374 FrntSideRdrLeObj14RdrObjDxStdDe "Refer to the data element description in FrntSideRdrLeObj1 with the same data element name.";
CM_ SG_ 374 FrntSideRdrLeObj14RdrObjDy "Refer to the data element description in FrntSideRdrLeObj1 with the same data element name.";
CM_ SG_ 374 FrntSideRdrLeObj14RdrObjDyStdDe "Refer to the data element description in FrntSideRdrLeObj1 with the same data element name.";
CM_ SG_ 374 FrntSideRdrLeObj14RdrObjElevnConf "Refer to the data element description in FrntSideRdrLeObj1 with the same data element name.";
CM_ SG_ 374 FrntSideRdrLeObj14RdrObjElevnSts "Refer to the data element description in FrntSideRdrLeObj1 with the same data element name.";
CM_ SG_ 374 FrntSideRdrLeObj14RdrObjID "Refer to the data element description in FrntSideRdrLeObj1 with the same data element name.";
CM_ SG_ 374 FrntSideRdrLeObj14RdrObjIsInFreeSpace "Refer to the data element description in FrntSideRdrLeObj1 with the same data element name.";
CM_ SG_ 374 FrntSideRdrLeObj14RdrObjMirrProblty "Refer to the data element description in FrntSideRdrLeObj1 with the same data element name.";
CM_ SG_ 374 FrntSideRdrLeObj14RdrObjMtnPat "Refer to the data element description in FrntSideRdrLeObj1 with the same data element name.";
CM_ SG_ 374 FrntSideRdrLeObj14RdrObjNotRealProblty "Refer to the data element description in FrntSideRdrLeObj1 with the same data element name.";
CM_ SG_ 374 FrntSideRdrLeObj14RdrObjStatyCnt "Refer to the data element description in FrntSideRdrLeObj1 with the same data element name.";
CM_ SG_ 374 FrntSideRdrLeObj14RdrObjTiAlv "Refer to the data element description in FrntSideRdrLeObj1 with the same data element name.";
CM_ SG_ 374 FrntSideRdrLeObj14RdrObjTrackSts "Refer to the data element description in FrntSideRdrLeObj1 with the same data element name.";
CM_ SG_ 374 FrntSideRdrLeObj14RdrObjTyp "Refer to the data element description in FrntSideRdrLeObj1 with the same data element name.";
CM_ SG_ 374 FrntSideRdrLeObj14RdrObjTypConfBike "Refer to the data element description in FrntSideRdrLeObj1 with the same data element name.";
CM_ SG_ 374 FrntSideRdrLeObj14RdrObjTypConfPed "Refer to the data element description in FrntSideRdrLeObj1 with the same data element name.";
CM_ SG_ 374 FrntSideRdrLeObj14RdrObjTypConfVeh "Refer to the data element description in FrntSideRdrLeObj1 with the same data element name.";
CM_ SG_ 374 FrntSideRdrLeObj14RdrObjUsedTracker "Refer to the data element description in FrntSideRdrLeObj1 with the same data element name.";
CM_ SG_ 374 FrntSideRdrLeObj14RdrObjVx "Refer to the data element description in FrntSideRdrLeObj1 with the same data element name.";
CM_ SG_ 374 FrntSideRdrLeObj14RdrObjVxStdDe "Refer to the data element description in FrntSideRdrLeObj1 with the same data element name.";
CM_ SG_ 374 FrntSideRdrLeObj14RdrObjVy "Refer to the data element description in FrntSideRdrLeObj1 with the same data element name.";
CM_ SG_ 374 FrntSideRdrLeObj14RdrObjVyStdDe "Refer to the data element description in FrntSideRdrLeObj1 with the same data element name.";
CM_ SG_ 374 FrntSideRdrLeObj14RelVx "Refer to the data element description in ReSideRdrRiObj1 with the same data element name";
CM_ SG_ 374 FrntSideRdrLeObj14RelVy "Refer to the data element description in ReSideRdrRiObj1 with the same data element name";
CM_ SG_ 376 FrntSideRdrLeObj15Heading "Refer to the data element description in ReSideRdrRiObj1 with the same data element name";
CM_ SG_ 376 FrntSideRdrLeObj15ObjBoxCenterLat "Box center y coordinate (relative closest point)";
CM_ SG_ 376 FrntSideRdrLeObj15ObjBoxCenterLgt "Box center x coordinate (relative closest point)";
CM_ SG_ 376 FrntSideRdrLeObj15ObservationHist "Refer to the data element description in ReSideRdrRiObj1 with the same data element name";
CM_ SG_ 376 FrntSideRdrLeObj15QualityBits "Refer to the data element description in FrntSideRdrLeObj1 with the same data element name.";
CM_ SG_ 376 FrntSideRdrLeObj15RdrObjAx "Refer to the data element description in FrntSideRdrLeObj1 with the same data element name.";
CM_ SG_ 376 FrntSideRdrLeObj15RdrObjAy "Refer to the data element description in FrntSideRdrLeObj1 with the same data element name.";
CM_ SG_ 376 FrntSideRdrLeObj15RdrObjBoxLength "Box length (box extent that is parallel to objects heading angle)";
CM_ SG_ 376 FrntSideRdrLeObj15RdrObjBoxWidth "Box width (box extent that is perpendicular to objects heading angle)";
CM_ SG_ 376 FrntSideRdrLeObj15RdrObjChks "Refer to the data element description in FrntSideRdrLeObj1 with the same data element name.";
CM_ SG_ 376 FrntSideRdrLeObj15RdrObjCntr "Refer to the data element description in FrntSideRdrLeObj1 with the same data element name.";
CM_ SG_ 376 FrntSideRdrLeObj15RdrObjCoastCnt "Refer to the data element description in FrntSideRdrLeObj1 with the same data element name.";
CM_ SG_ 376 FrntSideRdrLeObj15RdrObjConf "Refer to the data element description in FrntSideRdrLeObj1 with the same data element name.";
CM_ SG_ 376 FrntSideRdrLeObj15RdrObjDx "Refer to the data element description in FrntSideRdrLeObj1 with the same data element name.";
CM_ SG_ 376 FrntSideRdrLeObj15RdrObjDxStdDe "Refer to the data element description in FrntSideRdrLeObj1 with the same data element name.";
CM_ SG_ 376 FrntSideRdrLeObj15RdrObjDy "Refer to the data element description in FrntSideRdrLeObj1 with the same data element name.";
CM_ SG_ 376 FrntSideRdrLeObj15RdrObjDyStdDe "Refer to the data element description in FrntSideRdrLeObj1 with the same data element name.";
CM_ SG_ 376 FrntSideRdrLeObj15RdrObjElevnConf "Refer to the data element description in FrntSideRdrLeObj1 with the same data element name.";
CM_ SG_ 376 FrntSideRdrLeObj15RdrObjElevnSts "Refer to the data element description in FrntSideRdrLeObj1 with the same data element name.";
CM_ SG_ 376 FrntSideRdrLeObj15RdrObjID "Refer to the data element description in FrntSideRdrLeObj1 with the same data element name.";
CM_ SG_ 376 FrntSideRdrLeObj15RdrObjIsInFreeSpace "Refer to the data element description in FrntSideRdrLeObj1 with the same data element name.";
CM_ SG_ 376 FrntSideRdrLeObj15RdrObjMirrProblty "Refer to the data element description in FrntSideRdrLeObj1 with the same data element name.";
CM_ SG_ 376 FrntSideRdrLeObj15RdrObjMtnPat "Refer to the data element description in FrntSideRdrLeObj1 with the same data element name.";
CM_ SG_ 376 FrntSideRdrLeObj15RdrObjNotRealProblty "Refer to the data element description in FrntSideRdrLeObj1 with the same data element name.";
CM_ SG_ 376 FrntSideRdrLeObj15RdrObjStatyCnt "Refer to the data element description in FrntSideRdrLeObj1 with the same data element name.";
CM_ SG_ 376 FrntSideRdrLeObj15RdrObjTiAlv "Refer to the data element description in FrntSideRdrLeObj1 with the same data element name.";
CM_ SG_ 376 FrntSideRdrLeObj15RdrObjTrackSts "Refer to the data element description in FrntSideRdrLeObj1 with the same data element name.";
CM_ SG_ 376 FrntSideRdrLeObj15RdrObjTyp "Refer to the data element description in FrntSideRdrLeObj1 with the same data element name.";
CM_ SG_ 376 FrntSideRdrLeObj15RdrObjTypConfBike "Refer to the data element description in FrntSideRdrLeObj1 with the same data element name.";
CM_ SG_ 376 FrntSideRdrLeObj15RdrObjTypConfPed "Refer to the data element description in FrntSideRdrLeObj1 with the same data element name.";
CM_ SG_ 376 FrntSideRdrLeObj15RdrObjTypConfVeh "Refer to the data element description in FrntSideRdrLeObj1 with the same data element name.";
CM_ SG_ 376 FrntSideRdrLeObj15RdrObjUsedTracker "Refer to the data element description in FrntSideRdrLeObj1 with the same data element name.";
CM_ SG_ 376 FrntSideRdrLeObj15RdrObjVx "Refer to the data element description in FrntSideRdrLeObj1 with the same data element name.";
CM_ SG_ 376 FrntSideRdrLeObj15RdrObjVxStdDe "Refer to the data element description in FrntSideRdrLeObj1 with the same data element name.";
CM_ SG_ 376 FrntSideRdrLeObj15RdrObjVy "Refer to the data element description in FrntSideRdrLeObj1 with the same data element name.";
CM_ SG_ 376 FrntSideRdrLeObj15RdrObjVyStdDe "Refer to the data element description in FrntSideRdrLeObj1 with the same data element name.";
CM_ SG_ 376 FrntSideRdrLeObj15RelVx "Refer to the data element description in ReSideRdrRiObj1 with the same data element name";
CM_ SG_ 376 FrntSideRdrLeObj15RelVy "Refer to the data element description in ReSideRdrRiObj1 with the same data element name";
BA_DEF_ BO_ "CANFD_BRS" ENUM "0","1";
BA_DEF_ BO_ "GenMsgCycleTime" INT 0 65536; // [ms]
BA_DEF_ BO_ "GenMsgDelayTime" INT 0 65536; // [ms]
BA_DEF_ BO_ "GenMsgSendType" ENUM "cyclic", "spontaneous", "not-used", "not-used", "not-used", "cyclicAndSpontaneous", "not-used", "cyclicIfActive", "NoMsgSendType"; // [us]
BA_DEF_ BO_ "GenMsgStartDelayTime" INT 0 65536; // [ms]
BA_DEF_ BO_ "VFrameFormat" ENUM "StandardCAN","ExtendedCAN","reserved","J1939PG","reserved","reserved","reserved","reserved","reserved","reserved","reserved","reserved","reserved","reserved","StandardCAN_FD","ExtendedCAN_FD";
BA_DEF_ SG_ "GenSigSendType" ENUM "Cyclic","OnWrite","OnWriteWithRepetition","OnChange","OnChangeWithRepetition","IfActive","IfActiveWithRepetition","NoSigSendType";
BA_DEF_ SG_ "GenSigStartValue" HEX 0 80000000;
BA_DEF_ BO_ "GenMsgILSupport" ENUM "No","Yes";
BA_DEF_ BO_ "NmAsrMessage" ENUM "No","Yes";
BA_DEF_ SG_ "GenSigFuncType" ENUM "NoFunction","n/a","n/a","n/a","n/a","n/a","n/a","n/a","n/a","n/a","n/a","n/a","n/a","n/a","n/a","CHK","CNTR","n/a","n/a","n/a","CNTR_AR_01","CRC_AR_01_BOTH","CRC_AR_01_ALT","CRC_AR_01_LOW","CRC_AR_01_NIBBLE","CNTR_AR_04","CRC_AR_04A","CNTR_AR_05","CRC_AR_05";
BA_DEF_ SG_ "GenSigDataID" STRING;
BA_DEF_DEF_ "CANFD_BRS" "1";
BA_DEF_DEF_ "GenSigStartValue" 0;
BA_DEF_DEF_ "VFrameFormat" "J1939PG";
BA_DEF_DEF_ "GenSigSendType" "NoSigSendType";
BA_DEF_DEF_ "GenMsgCycleTime" 0;
BA_DEF_DEF_ "GenMsgDelayTime" 0;
BA_DEF_DEF_ "GenMsgStartDelayTime" 0;
BA_DEF_DEF_ "GenMsgSendType" "NoMsgSendType";
BA_DEF_DEF_ "GenMsgILSupport" "Yes";
BA_DEF_DEF_ "NmAsrMessage" "No";
BA_DEF_DEF_ "GenSigFuncType" "NoFunction";
BA_DEF_DEF_ "GenSigDataID" "";
// Frame: FSRLSafetyCANFD1Frame25
BA_ "GenMsgCycleTime" BO_ 352 50.000;
BA_ "GenMsgSendType" BO_ 352 0;
BA_ "VFrameFormat" BO_ 352 14;
// Frame: FSRLSafetyCANFD1Frame26
BA_ "GenMsgCycleTime" BO_ 354 50.000;
BA_ "GenMsgSendType" BO_ 354 0;
BA_ "VFrameFormat" BO_ 354 14;
// Frame: FSRLSafetyCANFD1Frame27
BA_ "GenMsgCycleTime" BO_ 356 50.000;
BA_ "GenMsgSendType" BO_ 356 0;
BA_ "VFrameFormat" BO_ 356 14;
// Frame: FSRLSafetyCANFD1Frame28
BA_ "GenMsgCycleTime" BO_ 358 50.000;
BA_ "GenMsgSendType" BO_ 358 0;
BA_ "VFrameFormat" BO_ 358 14;
// Frame: FSRLSafetyCANFD1Frame29
BA_ "GenMsgCycleTime" BO_ 360 50.000;
BA_ "GenMsgSendType" BO_ 360 0;
BA_ "VFrameFormat" BO_ 360 14;
// Frame: FSRLSafetyCANFD1Frame30
BA_ "GenMsgCycleTime" BO_ 362 50.000;
BA_ "GenMsgSendType" BO_ 362 0;
BA_ "VFrameFormat" BO_ 362 14;
// Frame: FSRLSafetyCANFD1Frame31
BA_ "GenMsgCycleTime" BO_ 364 50.000;
BA_ "GenMsgSendType" BO_ 364 0;
BA_ "VFrameFormat" BO_ 364 14;
// Frame: FSRLSafetyCANFD1Frame32
BA_ "GenMsgCycleTime" BO_ 366 50.000;
BA_ "GenMsgSendType" BO_ 366 0;
BA_ "VFrameFormat" BO_ 366 14;
// Frame: FSRLSafetyCANFD1Frame33
BA_ "GenMsgCycleTime" BO_ 368 50.000;
BA_ "GenMsgSendType" BO_ 368 0;
BA_ "VFrameFormat" BO_ 368 14;
// Frame: FSRLSafetyCANFD1Frame34
BA_ "GenMsgCycleTime" BO_ 370 50.000;
BA_ "GenMsgSendType" BO_ 370 0;
BA_ "VFrameFormat" BO_ 370 14;
// Frame: FSRLSafetyCANFD1Frame35
BA_ "GenMsgCycleTime" BO_ 372 50.000;
BA_ "GenMsgSendType" BO_ 372 0;
BA_ "VFrameFormat" BO_ 372 14;
// Frame: FSRLSafetyCANFD1Frame36
BA_ "GenMsgCycleTime" BO_ 374 50.000;
BA_ "GenMsgSendType" BO_ 374 0;
BA_ "VFrameFormat" BO_ 374 14;
// Frame: FSRLSafetyCANFD1Frame37
BA_ "GenMsgCycleTime" BO_ 376 50.000;
BA_ "GenMsgSendType" BO_ 376 0;
BA_ "VFrameFormat" BO_ 376 14;
// Frame: FsrlSafetyCanFD1NMFr
BA_ "GenMsgDelayTime" BO_ 1283 20.000;
BA_ "GenMsgSendType" BO_ 1283 1;
BA_ "VFrameFormat" BO_ 1283 0;
BA_ "GenMsgILSupport" BO_ 1283 0;
BA_ "NmAsrMessage" BO_ 1283 1;
BA_ "GenSigSendType" SG_ 366 FrntSideRdrLeObj10Heading 0;
BA_ "GenSigStartValue" SG_ 366 FrntSideRdrLeObj10Heading 1800;
BA_ "GenSigSendType" SG_ 366 FrntSideRdrLeObj10ObjBoxCenterLat 0;
BA_ "GenSigStartValue" SG_ 366 FrntSideRdrLeObj10ObjBoxCenterLat 250;
BA_ "GenSigSendType" SG_ 366 FrntSideRdrLeObj10ObjBoxCenterLgt 0;
BA_ "GenSigStartValue" SG_ 366 FrntSideRdrLeObj10ObjBoxCenterLgt 250;
BA_ "GenSigSendType" SG_ 366 FrntSideRdrLeObj10ObservationHist 0;
BA_ "GenSigSendType" SG_ 366 FrntSideRdrLeObj10QualityBits 0;
BA_ "GenSigSendType" SG_ 366 FrntSideRdrLeObj10RdrObjAx 0;
BA_ "GenSigSendType" SG_ 366 FrntSideRdrLeObj10RdrObjAy 0;
BA_ "GenSigSendType" SG_ 366 FrntSideRdrLeObj10RdrObjBoxLength 0;
BA_ "GenSigSendType" SG_ 366 FrntSideRdrLeObj10RdrObjBoxWidth 0;
BA_ "GenSigDataID" SG_ 366 FrntSideRdrLeObj10RdrObjChks "0x8BD";
BA_ "GenSigFuncType" SG_ 366 FrntSideRdrLeObj10RdrObjChks 15;
BA_ "GenSigSendType" SG_ 366 FrntSideRdrLeObj10RdrObjChks 0;
BA_ "GenSigFuncType" SG_ 366 FrntSideRdrLeObj10RdrObjCntr 16;
BA_ "GenSigSendType" SG_ 366 FrntSideRdrLeObj10RdrObjCntr 0;
BA_ "GenSigSendType" SG_ 366 FrntSideRdrLeObj10RdrObjCoastCnt 0;
BA_ "GenSigStartValue" SG_ 366 FrntSideRdrLeObj10RdrObjCoastCnt 31;
BA_ "GenSigSendType" SG_ 366 FrntSideRdrLeObj10RdrObjConf 0;
BA_ "GenSigSendType" SG_ 366 FrntSideRdrLeObj10RdrObjDx 0;
BA_ "GenSigSendType" SG_ 366 FrntSideRdrLeObj10RdrObjDxStdDe 0;
BA_ "GenSigSendType" SG_ 366 FrntSideRdrLeObj10RdrObjDy 0;
BA_ "GenSigStartValue" SG_ 366 FrntSideRdrLeObj10RdrObjDy 4000;
BA_ "GenSigSendType" SG_ 366 FrntSideRdrLeObj10RdrObjDyStdDe 0;
BA_ "GenSigSendType" SG_ 366 FrntSideRdrLeObj10RdrObjElevnConf 0;
BA_ "GenSigSendType" SG_ 366 FrntSideRdrLeObj10RdrObjElevnSts 0;
BA_ "GenSigSendType" SG_ 366 FrntSideRdrLeObj10RdrObjID 0;
BA_ "GenSigSendType" SG_ 366 FrntSideRdrLeObj10RdrObjIsInFreeSpace 0;
BA_ "GenSigStartValue" SG_ 366 FrntSideRdrLeObj10RdrObjIsInFreeSpace 1;
BA_ "GenSigSendType" SG_ 366 FrntSideRdrLeObj10RdrObjMirrProblty 0;
BA_ "GenSigSendType" SG_ 366 FrntSideRdrLeObj10RdrObjMtnPat 0;
BA_ "GenSigStartValue" SG_ 366 FrntSideRdrLeObj10RdrObjMtnPat 3;
BA_ "GenSigSendType" SG_ 366 FrntSideRdrLeObj10RdrObjNotRealProblty 0;
BA_ "GenSigSendType" SG_ 366 FrntSideRdrLeObj10RdrObjStatyCnt 0;
BA_ "GenSigSendType" SG_ 366 FrntSideRdrLeObj10RdrObjTiAlv 0;
BA_ "GenSigSendType" SG_ 366 FrntSideRdrLeObj10RdrObjTrackSts 0;
BA_ "GenSigSendType" SG_ 366 FrntSideRdrLeObj10RdrObjTyp 0;
BA_ "GenSigSendType" SG_ 366 FrntSideRdrLeObj10RdrObjTypConfBike 0;
BA_ "GenSigSendType" SG_ 366 FrntSideRdrLeObj10RdrObjTypConfPed 0;
BA_ "GenSigSendType" SG_ 366 FrntSideRdrLeObj10RdrObjTypConfVeh 0;
BA_ "GenSigSendType" SG_ 366 FrntSideRdrLeObj10RdrObjUsedTracker 0;
BA_ "GenSigStartValue" SG_ 366 FrntSideRdrLeObj10RdrObjUsedTracker 3;
BA_ "GenSigSendType" SG_ 366 FrntSideRdrLeObj10RdrObjVx 0;
BA_ "GenSigStartValue" SG_ 366 FrntSideRdrLeObj10RdrObjVx 6400;
BA_ "GenSigSendType" SG_ 366 FrntSideRdrLeObj10RdrObjVxStdDe 0;
BA_ "GenSigSendType" SG_ 366 FrntSideRdrLeObj10RdrObjVy 0;
BA_ "GenSigStartValue" SG_ 366 FrntSideRdrLeObj10RdrObjVy 6400;
BA_ "GenSigSendType" SG_ 366 FrntSideRdrLeObj10RdrObjVyStdDe 0;
BA_ "GenSigSendType" SG_ 366 FrntSideRdrLeObj10RelVx 0;
BA_ "GenSigStartValue" SG_ 366 FrntSideRdrLeObj10RelVx 1780;
BA_ "GenSigSendType" SG_ 366 FrntSideRdrLeObj10RelVy 0;
BA_ "GenSigStartValue" SG_ 366 FrntSideRdrLeObj10RelVy 1780;
BA_ "GenSigSendType" SG_ 368 FrntSideRdrLeObj11Heading 0;
BA_ "GenSigStartValue" SG_ 368 FrntSideRdrLeObj11Heading 1800;
BA_ "GenSigSendType" SG_ 368 FrntSideRdrLeObj11ObjBoxCenterLat 0;
BA_ "GenSigStartValue" SG_ 368 FrntSideRdrLeObj11ObjBoxCenterLat 250;
BA_ "GenSigSendType" SG_ 368 FrntSideRdrLeObj11ObjBoxCenterLgt 0;
BA_ "GenSigStartValue" SG_ 368 FrntSideRdrLeObj11ObjBoxCenterLgt 250;
BA_ "GenSigSendType" SG_ 368 FrntSideRdrLeObj11ObservationHist 0;
BA_ "GenSigSendType" SG_ 368 FrntSideRdrLeObj11QualityBits 0;
BA_ "GenSigSendType" SG_ 368 FrntSideRdrLeObj11RdrObjAx 0;
BA_ "GenSigSendType" SG_ 368 FrntSideRdrLeObj11RdrObjAy 0;
BA_ "GenSigSendType" SG_ 368 FrntSideRdrLeObj11RdrObjBoxLength 0;
BA_ "GenSigSendType" SG_ 368 FrntSideRdrLeObj11RdrObjBoxWidth 0;
BA_ "GenSigDataID" SG_ 368 FrntSideRdrLeObj11RdrObjChks "0x8BE";
BA_ "GenSigFuncType" SG_ 368 FrntSideRdrLeObj11RdrObjChks 15;
BA_ "GenSigSendType" SG_ 368 FrntSideRdrLeObj11RdrObjChks 0;
BA_ "GenSigFuncType" SG_ 368 FrntSideRdrLeObj11RdrObjCntr 16;
BA_ "GenSigSendType" SG_ 368 FrntSideRdrLeObj11RdrObjCntr 0;
BA_ "GenSigSendType" SG_ 368 FrntSideRdrLeObj11RdrObjCoastCnt 0;
BA_ "GenSigStartValue" SG_ 368 FrntSideRdrLeObj11RdrObjCoastCnt 31;
BA_ "GenSigSendType" SG_ 368 FrntSideRdrLeObj11RdrObjConf 0;
BA_ "GenSigSendType" SG_ 368 FrntSideRdrLeObj11RdrObjDx 0;
BA_ "GenSigSendType" SG_ 368 FrntSideRdrLeObj11RdrObjDxStdDe 0;
BA_ "GenSigSendType" SG_ 368 FrntSideRdrLeObj11RdrObjDy 0;
BA_ "GenSigStartValue" SG_ 368 FrntSideRdrLeObj11RdrObjDy 4000;
BA_ "GenSigSendType" SG_ 368 FrntSideRdrLeObj11RdrObjDyStdDe 0;
BA_ "GenSigSendType" SG_ 368 FrntSideRdrLeObj11RdrObjElevnConf 0;
BA_ "GenSigSendType" SG_ 368 FrntSideRdrLeObj11RdrObjElevnSts 0;
BA_ "GenSigSendType" SG_ 368 FrntSideRdrLeObj11RdrObjID 0;
BA_ "GenSigSendType" SG_ 368 FrntSideRdrLeObj11RdrObjIsInFreeSpace 0;
BA_ "GenSigStartValue" SG_ 368 FrntSideRdrLeObj11RdrObjIsInFreeSpace 1;
BA_ "GenSigSendType" SG_ 368 FrntSideRdrLeObj11RdrObjMirrProblty 0;
BA_ "GenSigSendType" SG_ 368 FrntSideRdrLeObj11RdrObjMtnPat 0;
BA_ "GenSigStartValue" SG_ 368 FrntSideRdrLeObj11RdrObjMtnPat 3;
BA_ "GenSigSendType" SG_ 368 FrntSideRdrLeObj11RdrObjNotRealProblty 0;
BA_ "GenSigSendType" SG_ 368 FrntSideRdrLeObj11RdrObjStatyCnt 0;
BA_ "GenSigSendType" SG_ 368 FrntSideRdrLeObj11RdrObjTiAlv 0;
BA_ "GenSigSendType" SG_ 368 FrntSideRdrLeObj11RdrObjTrackSts 0;
BA_ "GenSigSendType" SG_ 368 FrntSideRdrLeObj11RdrObjTyp 0;
BA_ "GenSigSendType" SG_ 368 FrntSideRdrLeObj11RdrObjTypConfBike 0;
BA_ "GenSigSendType" SG_ 368 FrntSideRdrLeObj11RdrObjTypConfPed 0;
BA_ "GenSigSendType" SG_ 368 FrntSideRdrLeObj11RdrObjTypConfVeh 0;
BA_ "GenSigSendType" SG_ 368 FrntSideRdrLeObj11RdrObjUsedTracker 0;
BA_ "GenSigStartValue" SG_ 368 FrntSideRdrLeObj11RdrObjUsedTracker 3;
BA_ "GenSigSendType" SG_ 368 FrntSideRdrLeObj11RdrObjVx 0;
BA_ "GenSigStartValue" SG_ 368 FrntSideRdrLeObj11RdrObjVx 6400;
BA_ "GenSigSendType" SG_ 368 FrntSideRdrLeObj11RdrObjVxStdDe 0;
BA_ "GenSigSendType" SG_ 368 FrntSideRdrLeObj11RdrObjVy 0;
BA_ "GenSigStartValue" SG_ 368 FrntSideRdrLeObj11RdrObjVy 6400;
BA_ "GenSigSendType" SG_ 368 FrntSideRdrLeObj11RdrObjVyStdDe 0;
BA_ "GenSigSendType" SG_ 368 FrntSideRdrLeObj11RelVx 0;
BA_ "GenSigStartValue" SG_ 368 FrntSideRdrLeObj11RelVx 1780;
BA_ "GenSigSendType" SG_ 368 FrntSideRdrLeObj11RelVy 0;
BA_ "GenSigStartValue" SG_ 368 FrntSideRdrLeObj11RelVy 1780;
BA_ "GenSigSendType" SG_ 370 FrntSideRdrLeObj12Heading 0;
BA_ "GenSigStartValue" SG_ 370 FrntSideRdrLeObj12Heading 1800;
BA_ "GenSigSendType" SG_ 370 FrntSideRdrLeObj12ObjBoxCenterLat 0;
BA_ "GenSigStartValue" SG_ 370 FrntSideRdrLeObj12ObjBoxCenterLat 250;
BA_ "GenSigSendType" SG_ 370 FrntSideRdrLeObj12ObjBoxCenterLgt 0;
BA_ "GenSigStartValue" SG_ 370 FrntSideRdrLeObj12ObjBoxCenterLgt 250;
BA_ "GenSigSendType" SG_ 370 FrntSideRdrLeObj12ObservationHist 0;
BA_ "GenSigSendType" SG_ 370 FrntSideRdrLeObj12QualityBits 0;
BA_ "GenSigSendType" SG_ 370 FrntSideRdrLeObj12RdrObjAx 0;
BA_ "GenSigSendType" SG_ 370 FrntSideRdrLeObj12RdrObjAy 0;
BA_ "GenSigSendType" SG_ 370 FrntSideRdrLeObj12RdrObjBoxLength 0;
BA_ "GenSigSendType" SG_ 370 FrntSideRdrLeObj12RdrObjBoxWidth 0;
BA_ "GenSigDataID" SG_ 370 FrntSideRdrLeObj12RdrObjChks "0x8BF";
BA_ "GenSigFuncType" SG_ 370 FrntSideRdrLeObj12RdrObjChks 15;
BA_ "GenSigSendType" SG_ 370 FrntSideRdrLeObj12RdrObjChks 0;
BA_ "GenSigFuncType" SG_ 370 FrntSideRdrLeObj12RdrObjCntr 16;
BA_ "GenSigSendType" SG_ 370 FrntSideRdrLeObj12RdrObjCntr 0;
BA_ "GenSigSendType" SG_ 370 FrntSideRdrLeObj12RdrObjCoastCnt 0;
BA_ "GenSigStartValue" SG_ 370 FrntSideRdrLeObj12RdrObjCoastCnt 31;
BA_ "GenSigSendType" SG_ 370 FrntSideRdrLeObj12RdrObjConf 0;
BA_ "GenSigSendType" SG_ 370 FrntSideRdrLeObj12RdrObjDx 0;
BA_ "GenSigSendType" SG_ 370 FrntSideRdrLeObj12RdrObjDxStdDe 0;
BA_ "GenSigSendType" SG_ 370 FrntSideRdrLeObj12RdrObjDy 0;
BA_ "GenSigStartValue" SG_ 370 FrntSideRdrLeObj12RdrObjDy 4000;
BA_ "GenSigSendType" SG_ 370 FrntSideRdrLeObj12RdrObjDyStdDe 0;
BA_ "GenSigSendType" SG_ 370 FrntSideRdrLeObj12RdrObjElevnConf 0;
BA_ "GenSigSendType" SG_ 370 FrntSideRdrLeObj12RdrObjElevnSts 0;
BA_ "GenSigSendType" SG_ 370 FrntSideRdrLeObj12RdrObjID 0;
BA_ "GenSigSendType" SG_ 370 FrntSideRdrLeObj12RdrObjIsInFreeSpace 0;
BA_ "GenSigStartValue" SG_ 370 FrntSideRdrLeObj12RdrObjIsInFreeSpace 1;
BA_ "GenSigSendType" SG_ 370 FrntSideRdrLeObj12RdrObjMirrProblty 0;
BA_ "GenSigSendType" SG_ 370 FrntSideRdrLeObj12RdrObjMtnPat 0;
BA_ "GenSigStartValue" SG_ 370 FrntSideRdrLeObj12RdrObjMtnPat 3;
BA_ "GenSigSendType" SG_ 370 FrntSideRdrLeObj12RdrObjNotRealProblty 0;
BA_ "GenSigSendType" SG_ 370 FrntSideRdrLeObj12RdrObjStatyCnt 0;
BA_ "GenSigSendType" SG_ 370 FrntSideRdrLeObj12RdrObjTiAlv 0;
BA_ "GenSigSendType" SG_ 370 FrntSideRdrLeObj12RdrObjTrackSts 0;
BA_ "GenSigSendType" SG_ 370 FrntSideRdrLeObj12RdrObjTyp 0;
BA_ "GenSigSendType" SG_ 370 FrntSideRdrLeObj12RdrObjTypConfBike 0;
BA_ "GenSigSendType" SG_ 370 FrntSideRdrLeObj12RdrObjTypConfPed 0;
BA_ "GenSigSendType" SG_ 370 FrntSideRdrLeObj12RdrObjTypConfVeh 0;
BA_ "GenSigSendType" SG_ 370 FrntSideRdrLeObj12RdrObjUsedTracker 0;
BA_ "GenSigStartValue" SG_ 370 FrntSideRdrLeObj12RdrObjUsedTracker 3;
BA_ "GenSigSendType" SG_ 370 FrntSideRdrLeObj12RdrObjVx 0;
BA_ "GenSigStartValue" SG_ 370 FrntSideRdrLeObj12RdrObjVx 6400;
BA_ "GenSigSendType" SG_ 370 FrntSideRdrLeObj12RdrObjVxStdDe 0;
BA_ "GenSigSendType" SG_ 370 FrntSideRdrLeObj12RdrObjVy 0;
BA_ "GenSigStartValue" SG_ 370 FrntSideRdrLeObj12RdrObjVy 6400;
BA_ "GenSigSendType" SG_ 370 FrntSideRdrLeObj12RdrObjVyStdDe 0;
BA_ "GenSigSendType" SG_ 370 FrntSideRdrLeObj12RelVx 0;
BA_ "GenSigStartValue" SG_ 370 FrntSideRdrLeObj12RelVx 1780;
BA_ "GenSigSendType" SG_ 370 FrntSideRdrLeObj12RelVy 0;
BA_ "GenSigStartValue" SG_ 370 FrntSideRdrLeObj12RelVy 1780;
BA_ "GenSigSendType" SG_ 372 FrntSideRdrLeObj13Heading 0;
BA_ "GenSigStartValue" SG_ 372 FrntSideRdrLeObj13Heading 1800;
BA_ "GenSigSendType" SG_ 372 FrntSideRdrLeObj13ObjBoxCenterLat 0;
BA_ "GenSigStartValue" SG_ 372 FrntSideRdrLeObj13ObjBoxCenterLat 250;
BA_ "GenSigSendType" SG_ 372 FrntSideRdrLeObj13ObjBoxCenterLgt 0;
BA_ "GenSigStartValue" SG_ 372 FrntSideRdrLeObj13ObjBoxCenterLgt 250;
BA_ "GenSigSendType" SG_ 372 FrntSideRdrLeObj13ObservationHist 0;
BA_ "GenSigSendType" SG_ 372 FrntSideRdrLeObj13QualityBits 0;
BA_ "GenSigSendType" SG_ 372 FrntSideRdrLeObj13RdrObjAx 0;
BA_ "GenSigSendType" SG_ 372 FrntSideRdrLeObj13RdrObjAy 0;
BA_ "GenSigSendType" SG_ 372 FrntSideRdrLeObj13RdrObjBoxLength 0;
BA_ "GenSigSendType" SG_ 372 FrntSideRdrLeObj13RdrObjBoxWidth 0;
BA_ "GenSigDataID" SG_ 372 FrntSideRdrLeObj13RdrObjChks "0x8C0";
BA_ "GenSigFuncType" SG_ 372 FrntSideRdrLeObj13RdrObjChks 15;
BA_ "GenSigSendType" SG_ 372 FrntSideRdrLeObj13RdrObjChks 0;
BA_ "GenSigFuncType" SG_ 372 FrntSideRdrLeObj13RdrObjCntr 16;
BA_ "GenSigSendType" SG_ 372 FrntSideRdrLeObj13RdrObjCntr 0;
BA_ "GenSigSendType" SG_ 372 FrntSideRdrLeObj13RdrObjCoastCnt 0;
BA_ "GenSigStartValue" SG_ 372 FrntSideRdrLeObj13RdrObjCoastCnt 31;
BA_ "GenSigSendType" SG_ 372 FrntSideRdrLeObj13RdrObjConf 0;
BA_ "GenSigSendType" SG_ 372 FrntSideRdrLeObj13RdrObjDx 0;
BA_ "GenSigSendType" SG_ 372 FrntSideRdrLeObj13RdrObjDxStdDe 0;
BA_ "GenSigSendType" SG_ 372 FrntSideRdrLeObj13RdrObjDy 0;
BA_ "GenSigStartValue" SG_ 372 FrntSideRdrLeObj13RdrObjDy 4000;
BA_ "GenSigSendType" SG_ 372 FrntSideRdrLeObj13RdrObjDyStdDe 0;
BA_ "GenSigSendType" SG_ 372 FrntSideRdrLeObj13RdrObjElevnConf 0;
BA_ "GenSigSendType" SG_ 372 FrntSideRdrLeObj13RdrObjElevnSts 0;
BA_ "GenSigSendType" SG_ 372 FrntSideRdrLeObj13RdrObjID 0;
BA_ "GenSigSendType" SG_ 372 FrntSideRdrLeObj13RdrObjIsInFreeSpace 0;
BA_ "GenSigStartValue" SG_ 372 FrntSideRdrLeObj13RdrObjIsInFreeSpace 1;
BA_ "GenSigSendType" SG_ 372 FrntSideRdrLeObj13RdrObjMirrProblty 0;
BA_ "GenSigSendType" SG_ 372 FrntSideRdrLeObj13RdrObjMtnPat 0;
BA_ "GenSigStartValue" SG_ 372 FrntSideRdrLeObj13RdrObjMtnPat 3;
BA_ "GenSigSendType" SG_ 372 FrntSideRdrLeObj13RdrObjNotRealProblty 0;
BA_ "GenSigSendType" SG_ 372 FrntSideRdrLeObj13RdrObjStatyCnt 0;
BA_ "GenSigSendType" SG_ 372 FrntSideRdrLeObj13RdrObjTiAlv 0;
BA_ "GenSigSendType" SG_ 372 FrntSideRdrLeObj13RdrObjTrackSts 0;
BA_ "GenSigSendType" SG_ 372 FrntSideRdrLeObj13RdrObjTyp 0;
BA_ "GenSigSendType" SG_ 372 FrntSideRdrLeObj13RdrObjTypConfBike 0;
BA_ "GenSigSendType" SG_ 372 FrntSideRdrLeObj13RdrObjTypConfPed 0;
BA_ "GenSigSendType" SG_ 372 FrntSideRdrLeObj13RdrObjTypConfVeh 0;
BA_ "GenSigSendType" SG_ 372 FrntSideRdrLeObj13RdrObjUsedTracker 0;
BA_ "GenSigStartValue" SG_ 372 FrntSideRdrLeObj13RdrObjUsedTracker 3;
BA_ "GenSigSendType" SG_ 372 FrntSideRdrLeObj13RdrObjVx 0;
BA_ "GenSigStartValue" SG_ 372 FrntSideRdrLeObj13RdrObjVx 6400;
BA_ "GenSigSendType" SG_ 372 FrntSideRdrLeObj13RdrObjVxStdDe 0;
BA_ "GenSigSendType" SG_ 372 FrntSideRdrLeObj13RdrObjVy 0;
BA_ "GenSigStartValue" SG_ 372 FrntSideRdrLeObj13RdrObjVy 6400;
BA_ "GenSigSendType" SG_ 372 FrntSideRdrLeObj13RdrObjVyStdDe 0;
BA_ "GenSigSendType" SG_ 372 FrntSideRdrLeObj13RelVx 0;
BA_ "GenSigStartValue" SG_ 372 FrntSideRdrLeObj13RelVx 1780;
BA_ "GenSigSendType" SG_ 372 FrntSideRdrLeObj13RelVy 0;
BA_ "GenSigStartValue" SG_ 372 FrntSideRdrLeObj13RelVy 1780;
BA_ "GenSigSendType" SG_ 374 FrntSideRdrLeObj14Heading 0;
BA_ "GenSigStartValue" SG_ 374 FrntSideRdrLeObj14Heading 1800;
BA_ "GenSigSendType" SG_ 374 FrntSideRdrLeObj14ObjBoxCenterLat 0;
BA_ "GenSigStartValue" SG_ 374 FrntSideRdrLeObj14ObjBoxCenterLat 250;
BA_ "GenSigSendType" SG_ 374 FrntSideRdrLeObj14ObjBoxCenterLgt 0;
BA_ "GenSigStartValue" SG_ 374 FrntSideRdrLeObj14ObjBoxCenterLgt 250;
BA_ "GenSigSendType" SG_ 374 FrntSideRdrLeObj14ObservationHist 0;
BA_ "GenSigSendType" SG_ 374 FrntSideRdrLeObj14QualityBits 0;
BA_ "GenSigSendType" SG_ 374 FrntSideRdrLeObj14RdrObjAx 0;
BA_ "GenSigSendType" SG_ 374 FrntSideRdrLeObj14RdrObjAy 0;
BA_ "GenSigSendType" SG_ 374 FrntSideRdrLeObj14RdrObjBoxLength 0;
BA_ "GenSigSendType" SG_ 374 FrntSideRdrLeObj14RdrObjBoxWidth 0;
BA_ "GenSigDataID" SG_ 374 FrntSideRdrLeObj14RdrObjChks "0x8C1";
BA_ "GenSigFuncType" SG_ 374 FrntSideRdrLeObj14RdrObjChks 15;
BA_ "GenSigSendType" SG_ 374 FrntSideRdrLeObj14RdrObjChks 0;
BA_ "GenSigFuncType" SG_ 374 FrntSideRdrLeObj14RdrObjCntr 16;
BA_ "GenSigSendType" SG_ 374 FrntSideRdrLeObj14RdrObjCntr 0;
BA_ "GenSigSendType" SG_ 374 FrntSideRdrLeObj14RdrObjCoastCnt 0;
BA_ "GenSigStartValue" SG_ 374 FrntSideRdrLeObj14RdrObjCoastCnt 31;
BA_ "GenSigSendType" SG_ 374 FrntSideRdrLeObj14RdrObjConf 0;
BA_ "GenSigSendType" SG_ 374 FrntSideRdrLeObj14RdrObjDx 0;
BA_ "GenSigSendType" SG_ 374 FrntSideRdrLeObj14RdrObjDxStdDe 0;
BA_ "GenSigSendType" SG_ 374 FrntSideRdrLeObj14RdrObjDy 0;
BA_ "GenSigStartValue" SG_ 374 FrntSideRdrLeObj14RdrObjDy 4000;
BA_ "GenSigSendType" SG_ 374 FrntSideRdrLeObj14RdrObjDyStdDe 0;
BA_ "GenSigSendType" SG_ 374 FrntSideRdrLeObj14RdrObjElevnConf 0;
BA_ "GenSigSendType" SG_ 374 FrntSideRdrLeObj14RdrObjElevnSts 0;
BA_ "GenSigSendType" SG_ 374 FrntSideRdrLeObj14RdrObjID 0;
BA_ "GenSigSendType" SG_ 374 FrntSideRdrLeObj14RdrObjIsInFreeSpace 0;
BA_ "GenSigStartValue" SG_ 374 FrntSideRdrLeObj14RdrObjIsInFreeSpace 1;
BA_ "GenSigSendType" SG_ 374 FrntSideRdrLeObj14RdrObjMirrProblty 0;
BA_ "GenSigSendType" SG_ 374 FrntSideRdrLeObj14RdrObjMtnPat 0;
BA_ "GenSigStartValue" SG_ 374 FrntSideRdrLeObj14RdrObjMtnPat 3;
BA_ "GenSigSendType" SG_ 374 FrntSideRdrLeObj14RdrObjNotRealProblty 0;
BA_ "GenSigSendType" SG_ 374 FrntSideRdrLeObj14RdrObjStatyCnt 0;
BA_ "GenSigSendType" SG_ 374 FrntSideRdrLeObj14RdrObjTiAlv 0;
BA_ "GenSigSendType" SG_ 374 FrntSideRdrLeObj14RdrObjTrackSts 0;
BA_ "GenSigSendType" SG_ 374 FrntSideRdrLeObj14RdrObjTyp 0;
BA_ "GenSigSendType" SG_ 374 FrntSideRdrLeObj14RdrObjTypConfBike 0;
BA_ "GenSigSendType" SG_ 374 FrntSideRdrLeObj14RdrObjTypConfPed 0;
BA_ "GenSigSendType" SG_ 374 FrntSideRdrLeObj14RdrObjTypConfVeh 0;
BA_ "GenSigSendType" SG_ 374 FrntSideRdrLeObj14RdrObjUsedTracker 0;
BA_ "GenSigStartValue" SG_ 374 FrntSideRdrLeObj14RdrObjUsedTracker 3;
BA_ "GenSigSendType" SG_ 374 FrntSideRdrLeObj14RdrObjVx 0;
BA_ "GenSigStartValue" SG_ 374 FrntSideRdrLeObj14RdrObjVx 6400;
BA_ "GenSigSendType" SG_ 374 FrntSideRdrLeObj14RdrObjVxStdDe 0;
BA_ "GenSigSendType" SG_ 374 FrntSideRdrLeObj14RdrObjVy 0;
BA_ "GenSigStartValue" SG_ 374 FrntSideRdrLeObj14RdrObjVy 6400;
BA_ "GenSigSendType" SG_ 374 FrntSideRdrLeObj14RdrObjVyStdDe 0;
BA_ "GenSigSendType" SG_ 374 FrntSideRdrLeObj14RelVx 0;
BA_ "GenSigStartValue" SG_ 374 FrntSideRdrLeObj14RelVx 1780;
BA_ "GenSigSendType" SG_ 374 FrntSideRdrLeObj14RelVy 0;
BA_ "GenSigStartValue" SG_ 374 FrntSideRdrLeObj14RelVy 1780;
BA_ "GenSigSendType" SG_ 376 FrntSideRdrLeObj15Heading 0;
BA_ "GenSigStartValue" SG_ 376 FrntSideRdrLeObj15Heading 1800;
BA_ "GenSigSendType" SG_ 376 FrntSideRdrLeObj15ObjBoxCenterLat 0;
BA_ "GenSigStartValue" SG_ 376 FrntSideRdrLeObj15ObjBoxCenterLat 250;
BA_ "GenSigSendType" SG_ 376 FrntSideRdrLeObj15ObjBoxCenterLgt 0;
BA_ "GenSigStartValue" SG_ 376 FrntSideRdrLeObj15ObjBoxCenterLgt 250;
BA_ "GenSigSendType" SG_ 376 FrntSideRdrLeObj15ObservationHist 0;
BA_ "GenSigSendType" SG_ 376 FrntSideRdrLeObj15QualityBits 0;
BA_ "GenSigSendType" SG_ 376 FrntSideRdrLeObj15RdrObjAx 0;
BA_ "GenSigSendType" SG_ 376 FrntSideRdrLeObj15RdrObjAy 0;
BA_ "GenSigSendType" SG_ 376 FrntSideRdrLeObj15RdrObjBoxLength 0;
BA_ "GenSigSendType" SG_ 376 FrntSideRdrLeObj15RdrObjBoxWidth 0;
BA_ "GenSigDataID" SG_ 376 FrntSideRdrLeObj15RdrObjChks "0x8C2";
BA_ "GenSigFuncType" SG_ 376 FrntSideRdrLeObj15RdrObjChks 15;
BA_ "GenSigSendType" SG_ 376 FrntSideRdrLeObj15RdrObjChks 0;
BA_ "GenSigFuncType" SG_ 376 FrntSideRdrLeObj15RdrObjCntr 16;
BA_ "GenSigSendType" SG_ 376 FrntSideRdrLeObj15RdrObjCntr 0;
BA_ "GenSigSendType" SG_ 376 FrntSideRdrLeObj15RdrObjCoastCnt 0;
BA_ "GenSigStartValue" SG_ 376 FrntSideRdrLeObj15RdrObjCoastCnt 31;
BA_ "GenSigSendType" SG_ 376 FrntSideRdrLeObj15RdrObjConf 0;
BA_ "GenSigSendType" SG_ 376 FrntSideRdrLeObj15RdrObjDx 0;
BA_ "GenSigSendType" SG_ 376 FrntSideRdrLeObj15RdrObjDxStdDe 0;
BA_ "GenSigSendType" SG_ 376 FrntSideRdrLeObj15RdrObjDy 0;
BA_ "GenSigStartValue" SG_ 376 FrntSideRdrLeObj15RdrObjDy 4000;
BA_ "GenSigSendType" SG_ 376 FrntSideRdrLeObj15RdrObjDyStdDe 0;
BA_ "GenSigSendType" SG_ 376 FrntSideRdrLeObj15RdrObjElevnConf 0;
BA_ "GenSigSendType" SG_ 376 FrntSideRdrLeObj15RdrObjElevnSts 0;
BA_ "GenSigSendType" SG_ 376 FrntSideRdrLeObj15RdrObjID 0;
BA_ "GenSigSendType" SG_ 376 FrntSideRdrLeObj15RdrObjIsInFreeSpace 0;
BA_ "GenSigStartValue" SG_ 376 FrntSideRdrLeObj15RdrObjIsInFreeSpace 1;
BA_ "GenSigSendType" SG_ 376 FrntSideRdrLeObj15RdrObjMirrProblty 0;
BA_ "GenSigSendType" SG_ 376 FrntSideRdrLeObj15RdrObjMtnPat 0;
BA_ "GenSigStartValue" SG_ 376 FrntSideRdrLeObj15RdrObjMtnPat 3;
BA_ "GenSigSendType" SG_ 376 FrntSideRdrLeObj15RdrObjNotRealProblty 0;
BA_ "GenSigSendType" SG_ 376 FrntSideRdrLeObj15RdrObjStatyCnt 0;
BA_ "GenSigSendType" SG_ 376 FrntSideRdrLeObj15RdrObjTiAlv 0;
BA_ "GenSigSendType" SG_ 376 FrntSideRdrLeObj15RdrObjTrackSts 0;
BA_ "GenSigSendType" SG_ 376 FrntSideRdrLeObj15RdrObjTyp 0;
BA_ "GenSigSendType" SG_ 376 FrntSideRdrLeObj15RdrObjTypConfBike 0;
BA_ "GenSigSendType" SG_ 376 FrntSideRdrLeObj15RdrObjTypConfPed 0;
BA_ "GenSigSendType" SG_ 376 FrntSideRdrLeObj15RdrObjTypConfVeh 0;
BA_ "GenSigSendType" SG_ 376 FrntSideRdrLeObj15RdrObjUsedTracker 0;
BA_ "GenSigStartValue" SG_ 376 FrntSideRdrLeObj15RdrObjUsedTracker 3;
BA_ "GenSigSendType" SG_ 376 FrntSideRdrLeObj15RdrObjVx 0;
BA_ "GenSigStartValue" SG_ 376 FrntSideRdrLeObj15RdrObjVx 6400;
BA_ "GenSigSendType" SG_ 376 FrntSideRdrLeObj15RdrObjVxStdDe 0;
BA_ "GenSigSendType" SG_ 376 FrntSideRdrLeObj15RdrObjVy 0;
BA_ "GenSigStartValue" SG_ 376 FrntSideRdrLeObj15RdrObjVy 6400;
BA_ "GenSigSendType" SG_ 376 FrntSideRdrLeObj15RdrObjVyStdDe 0;
BA_ "GenSigSendType" SG_ 376 FrntSideRdrLeObj15RelVx 0;
BA_ "GenSigStartValue" SG_ 376 FrntSideRdrLeObj15RelVx 1780;
BA_ "GenSigSendType" SG_ 376 FrntSideRdrLeObj15RelVy 0;
BA_ "GenSigStartValue" SG_ 376 FrntSideRdrLeObj15RelVy 1780;
BA_ "GenSigSendType" SG_ 352 FrntSideRdrLeObj3Heading 0;
BA_ "GenSigStartValue" SG_ 352 FrntSideRdrLeObj3Heading 1800;
BA_ "GenSigSendType" SG_ 352 FrntSideRdrLeObj3ObjBoxCenterLat 0;
BA_ "GenSigStartValue" SG_ 352 FrntSideRdrLeObj3ObjBoxCenterLat 250;
BA_ "GenSigSendType" SG_ 352 FrntSideRdrLeObj3ObjBoxCenterLgt 0;
BA_ "GenSigStartValue" SG_ 352 FrntSideRdrLeObj3ObjBoxCenterLgt 250;
BA_ "GenSigSendType" SG_ 352 FrntSideRdrLeObj3ObservationHist 0;
BA_ "GenSigSendType" SG_ 352 FrntSideRdrLeObj3QualityBits 0;
BA_ "GenSigSendType" SG_ 352 FrntSideRdrLeObj3RdrObjAx 0;
BA_ "GenSigSendType" SG_ 352 FrntSideRdrLeObj3RdrObjAy 0;
BA_ "GenSigSendType" SG_ 352 FrntSideRdrLeObj3RdrObjBoxLength 0;
BA_ "GenSigSendType" SG_ 352 FrntSideRdrLeObj3RdrObjBoxWidth 0;
BA_ "GenSigDataID" SG_ 352 FrntSideRdrLeObj3RdrObjChks "0x8B6";
BA_ "GenSigFuncType" SG_ 352 FrntSideRdrLeObj3RdrObjChks 15;
BA_ "GenSigSendType" SG_ 352 FrntSideRdrLeObj3RdrObjChks 0;
BA_ "GenSigFuncType" SG_ 352 FrntSideRdrLeObj3RdrObjCntr 16;
BA_ "GenSigSendType" SG_ 352 FrntSideRdrLeObj3RdrObjCntr 0;
BA_ "GenSigSendType" SG_ 352 FrntSideRdrLeObj3RdrObjCoastCnt 0;
BA_ "GenSigStartValue" SG_ 352 FrntSideRdrLeObj3RdrObjCoastCnt 31;
BA_ "GenSigSendType" SG_ 352 FrntSideRdrLeObj3RdrObjConf 0;
BA_ "GenSigSendType" SG_ 352 FrntSideRdrLeObj3RdrObjDx 0;
BA_ "GenSigSendType" SG_ 352 FrntSideRdrLeObj3RdrObjDxStdDe 0;
BA_ "GenSigSendType" SG_ 352 FrntSideRdrLeObj3RdrObjDy 0;
BA_ "GenSigStartValue" SG_ 352 FrntSideRdrLeObj3RdrObjDy 4000;
BA_ "GenSigSendType" SG_ 352 FrntSideRdrLeObj3RdrObjDyStdDe 0;
BA_ "GenSigSendType" SG_ 352 FrntSideRdrLeObj3RdrObjElevnConf 0;
BA_ "GenSigSendType" SG_ 352 FrntSideRdrLeObj3RdrObjElevnSts 0;
BA_ "GenSigSendType" SG_ 352 FrntSideRdrLeObj3RdrObjID 0;
BA_ "GenSigSendType" SG_ 352 FrntSideRdrLeObj3RdrObjIsInFreeSpace 0;
BA_ "GenSigStartValue" SG_ 352 FrntSideRdrLeObj3RdrObjIsInFreeSpace 1;
BA_ "GenSigSendType" SG_ 352 FrntSideRdrLeObj3RdrObjMirrProblty 0;
BA_ "GenSigSendType" SG_ 352 FrntSideRdrLeObj3RdrObjMtnPat 0;
BA_ "GenSigStartValue" SG_ 352 FrntSideRdrLeObj3RdrObjMtnPat 3;
BA_ "GenSigSendType" SG_ 352 FrntSideRdrLeObj3RdrObjNotRealProblty 0;
BA_ "GenSigSendType" SG_ 352 FrntSideRdrLeObj3RdrObjStatyCnt 0;
BA_ "GenSigSendType" SG_ 352 FrntSideRdrLeObj3RdrObjTiAlv 0;
BA_ "GenSigSendType" SG_ 352 FrntSideRdrLeObj3RdrObjTrackSts 0;
BA_ "GenSigSendType" SG_ 352 FrntSideRdrLeObj3RdrObjTyp 0;
BA_ "GenSigSendType" SG_ 352 FrntSideRdrLeObj3RdrObjTypConfBike 0;
BA_ "GenSigSendType" SG_ 352 FrntSideRdrLeObj3RdrObjTypConfPed 0;
BA_ "GenSigSendType" SG_ 352 FrntSideRdrLeObj3RdrObjTypConfVeh 0;
BA_ "GenSigSendType" SG_ 352 FrntSideRdrLeObj3RdrObjUsedTracker 0;
BA_ "GenSigStartValue" SG_ 352 FrntSideRdrLeObj3RdrObjUsedTracker 3;
BA_ "GenSigSendType" SG_ 352 FrntSideRdrLeObj3RdrObjVx 0;
BA_ "GenSigStartValue" SG_ 352 FrntSideRdrLeObj3RdrObjVx 6400;
BA_ "GenSigSendType" SG_ 352 FrntSideRdrLeObj3RdrObjVxStdDe 0;
BA_ "GenSigSendType" SG_ 352 FrntSideRdrLeObj3RdrObjVy 0;
BA_ "GenSigStartValue" SG_ 352 FrntSideRdrLeObj3RdrObjVy 6400;
BA_ "GenSigSendType" SG_ 352 FrntSideRdrLeObj3RdrObjVyStdDe 0;
BA_ "GenSigSendType" SG_ 352 FrntSideRdrLeObj3RelVx 0;
BA_ "GenSigStartValue" SG_ 352 FrntSideRdrLeObj3RelVx 1780;
BA_ "GenSigSendType" SG_ 352 FrntSideRdrLeObj3RelVy 0;
BA_ "GenSigStartValue" SG_ 352 FrntSideRdrLeObj3RelVy 1780;
BA_ "GenSigSendType" SG_ 354 FrntSideRdrLeObj4Heading 0;
BA_ "GenSigStartValue" SG_ 354 FrntSideRdrLeObj4Heading 1800;
BA_ "GenSigSendType" SG_ 354 FrntSideRdrLeObj4ObjBoxCenterLat 0;
BA_ "GenSigStartValue" SG_ 354 FrntSideRdrLeObj4ObjBoxCenterLat 250;
BA_ "GenSigSendType" SG_ 354 FrntSideRdrLeObj4ObjBoxCenterLgt 0;
BA_ "GenSigStartValue" SG_ 354 FrntSideRdrLeObj4ObjBoxCenterLgt 250;
BA_ "GenSigSendType" SG_ 354 FrntSideRdrLeObj4ObservationHist 0;
BA_ "GenSigSendType" SG_ 354 FrntSideRdrLeObj4QualityBits 0;
BA_ "GenSigSendType" SG_ 354 FrntSideRdrLeObj4RdrObjAx 0;
BA_ "GenSigSendType" SG_ 354 FrntSideRdrLeObj4RdrObjAy 0;
BA_ "GenSigSendType" SG_ 354 FrntSideRdrLeObj4RdrObjBoxLength 0;
BA_ "GenSigSendType" SG_ 354 FrntSideRdrLeObj4RdrObjBoxWidth 0;
BA_ "GenSigDataID" SG_ 354 FrntSideRdrLeObj4RdrObjChks "0x8B7";
BA_ "GenSigFuncType" SG_ 354 FrntSideRdrLeObj4RdrObjChks 15;
BA_ "GenSigSendType" SG_ 354 FrntSideRdrLeObj4RdrObjChks 0;
BA_ "GenSigFuncType" SG_ 354 FrntSideRdrLeObj4RdrObjCntr 16;
BA_ "GenSigSendType" SG_ 354 FrntSideRdrLeObj4RdrObjCntr 0;
BA_ "GenSigSendType" SG_ 354 FrntSideRdrLeObj4RdrObjCoastCnt 0;
BA_ "GenSigStartValue" SG_ 354 FrntSideRdrLeObj4RdrObjCoastCnt 31;
BA_ "GenSigSendType" SG_ 354 FrntSideRdrLeObj4RdrObjConf 0;
BA_ "GenSigSendType" SG_ 354 FrntSideRdrLeObj4RdrObjDx 0;
BA_ "GenSigSendType" SG_ 354 FrntSideRdrLeObj4RdrObjDxStdDe 0;
BA_ "GenSigSendType" SG_ 354 FrntSideRdrLeObj4RdrObjDy 0;
BA_ "GenSigStartValue" SG_ 354 FrntSideRdrLeObj4RdrObjDy 4000;
BA_ "GenSigSendType" SG_ 354 FrntSideRdrLeObj4RdrObjDyStdDe 0;
BA_ "GenSigSendType" SG_ 354 FrntSideRdrLeObj4RdrObjElevnConf 0;
BA_ "GenSigSendType" SG_ 354 FrntSideRdrLeObj4RdrObjElevnSts 0;
BA_ "GenSigSendType" SG_ 354 FrntSideRdrLeObj4RdrObjID 0;
BA_ "GenSigSendType" SG_ 354 FrntSideRdrLeObj4RdrObjIsInFreeSpace 0;
BA_ "GenSigStartValue" SG_ 354 FrntSideRdrLeObj4RdrObjIsInFreeSpace 1;
BA_ "GenSigSendType" SG_ 354 FrntSideRdrLeObj4RdrObjMirrProblty 0;
BA_ "GenSigSendType" SG_ 354 FrntSideRdrLeObj4RdrObjMtnPat 0;
BA_ "GenSigStartValue" SG_ 354 FrntSideRdrLeObj4RdrObjMtnPat 3;
BA_ "GenSigSendType" SG_ 354 FrntSideRdrLeObj4RdrObjNotRealProblty 0;
BA_ "GenSigSendType" SG_ 354 FrntSideRdrLeObj4RdrObjStatyCnt 0;
BA_ "GenSigSendType" SG_ 354 FrntSideRdrLeObj4RdrObjTiAlv 0;
BA_ "GenSigSendType" SG_ 354 FrntSideRdrLeObj4RdrObjTrackSts 0;
BA_ "GenSigSendType" SG_ 354 FrntSideRdrLeObj4RdrObjTyp 0;
BA_ "GenSigSendType" SG_ 354 FrntSideRdrLeObj4RdrObjTypConfBike 0;
BA_ "GenSigSendType" SG_ 354 FrntSideRdrLeObj4RdrObjTypConfPed 0;
BA_ "GenSigSendType" SG_ 354 FrntSideRdrLeObj4RdrObjTypConfVeh 0;
BA_ "GenSigSendType" SG_ 354 FrntSideRdrLeObj4RdrObjUsedTracker 0;
BA_ "GenSigStartValue" SG_ 354 FrntSideRdrLeObj4RdrObjUsedTracker 3;
BA_ "GenSigSendType" SG_ 354 FrntSideRdrLeObj4RdrObjVx 0;
BA_ "GenSigStartValue" SG_ 354 FrntSideRdrLeObj4RdrObjVx 6400;
BA_ "GenSigSendType" SG_ 354 FrntSideRdrLeObj4RdrObjVxStdDe 0;
BA_ "GenSigSendType" SG_ 354 FrntSideRdrLeObj4RdrObjVy 0;
BA_ "GenSigStartValue" SG_ 354 FrntSideRdrLeObj4RdrObjVy 6400;
BA_ "GenSigSendType" SG_ 354 FrntSideRdrLeObj4RdrObjVyStdDe 0;
BA_ "GenSigSendType" SG_ 354 FrntSideRdrLeObj4RelVx 0;
BA_ "GenSigStartValue" SG_ 354 FrntSideRdrLeObj4RelVx 1780;
BA_ "GenSigSendType" SG_ 354 FrntSideRdrLeObj4RelVy 0;
BA_ "GenSigStartValue" SG_ 354 FrntSideRdrLeObj4RelVy 1780;
BA_ "GenSigSendType" SG_ 356 FrntSideRdrLeObj5Heading 0;
BA_ "GenSigStartValue" SG_ 356 FrntSideRdrLeObj5Heading 1800;
BA_ "GenSigSendType" SG_ 356 FrntSideRdrLeObj5ObjBoxCenterLat 0;
BA_ "GenSigStartValue" SG_ 356 FrntSideRdrLeObj5ObjBoxCenterLat 250;
BA_ "GenSigSendType" SG_ 356 FrntSideRdrLeObj5ObjBoxCenterLgt 0;
BA_ "GenSigStartValue" SG_ 356 FrntSideRdrLeObj5ObjBoxCenterLgt 250;
BA_ "GenSigSendType" SG_ 356 FrntSideRdrLeObj5ObservationHist 0;
BA_ "GenSigSendType" SG_ 356 FrntSideRdrLeObj5QualityBits 0;
BA_ "GenSigSendType" SG_ 356 FrntSideRdrLeObj5RdrObjAx 0;
BA_ "GenSigSendType" SG_ 356 FrntSideRdrLeObj5RdrObjAy 0;
BA_ "GenSigSendType" SG_ 356 FrntSideRdrLeObj5RdrObjBoxLength 0;
BA_ "GenSigSendType" SG_ 356 FrntSideRdrLeObj5RdrObjBoxWidth 0;
BA_ "GenSigDataID" SG_ 356 FrntSideRdrLeObj5RdrObjChks "0x8B8";
BA_ "GenSigFuncType" SG_ 356 FrntSideRdrLeObj5RdrObjChks 15;
BA_ "GenSigSendType" SG_ 356 FrntSideRdrLeObj5RdrObjChks 0;
BA_ "GenSigFuncType" SG_ 356 FrntSideRdrLeObj5RdrObjCntr 16;
BA_ "GenSigSendType" SG_ 356 FrntSideRdrLeObj5RdrObjCntr 0;
BA_ "GenSigSendType" SG_ 356 FrntSideRdrLeObj5RdrObjCoastCnt 0;
BA_ "GenSigStartValue" SG_ 356 FrntSideRdrLeObj5RdrObjCoastCnt 31;
BA_ "GenSigSendType" SG_ 356 FrntSideRdrLeObj5RdrObjConf 0;
BA_ "GenSigSendType" SG_ 356 FrntSideRdrLeObj5RdrObjDx 0;
BA_ "GenSigSendType" SG_ 356 FrntSideRdrLeObj5RdrObjDxStdDe 0;
BA_ "GenSigSendType" SG_ 356 FrntSideRdrLeObj5RdrObjDy 0;
BA_ "GenSigStartValue" SG_ 356 FrntSideRdrLeObj5RdrObjDy 4000;
BA_ "GenSigSendType" SG_ 356 FrntSideRdrLeObj5RdrObjDyStdDe 0;
BA_ "GenSigSendType" SG_ 356 FrntSideRdrLeObj5RdrObjElevnConf 0;
BA_ "GenSigSendType" SG_ 356 FrntSideRdrLeObj5RdrObjElevnSts 0;
BA_ "GenSigSendType" SG_ 356 FrntSideRdrLeObj5RdrObjID 0;
BA_ "GenSigSendType" SG_ 356 FrntSideRdrLeObj5RdrObjIsInFreeSpace 0;
BA_ "GenSigStartValue" SG_ 356 FrntSideRdrLeObj5RdrObjIsInFreeSpace 1;
BA_ "GenSigSendType" SG_ 356 FrntSideRdrLeObj5RdrObjMirrProblty 0;
BA_ "GenSigSendType" SG_ 356 FrntSideRdrLeObj5RdrObjMtnPat 0;
BA_ "GenSigStartValue" SG_ 356 FrntSideRdrLeObj5RdrObjMtnPat 3;
BA_ "GenSigSendType" SG_ 356 FrntSideRdrLeObj5RdrObjNotRealProblty 0;
BA_ "GenSigSendType" SG_ 356 FrntSideRdrLeObj5RdrObjStatyCnt 0;
BA_ "GenSigSendType" SG_ 356 FrntSideRdrLeObj5RdrObjTiAlv 0;
BA_ "GenSigSendType" SG_ 356 FrntSideRdrLeObj5RdrObjTrackSts 0;
BA_ "GenSigSendType" SG_ 356 FrntSideRdrLeObj5RdrObjTyp 0;
BA_ "GenSigSendType" SG_ 356 FrntSideRdrLeObj5RdrObjTypConfBike 0;
BA_ "GenSigSendType" SG_ 356 FrntSideRdrLeObj5RdrObjTypConfPed 0;
BA_ "GenSigSendType" SG_ 356 FrntSideRdrLeObj5RdrObjTypConfVeh 0;
BA_ "GenSigSendType" SG_ 356 FrntSideRdrLeObj5RdrObjUsedTracker 0;
BA_ "GenSigStartValue" SG_ 356 FrntSideRdrLeObj5RdrObjUsedTracker 3;
BA_ "GenSigSendType" SG_ 356 FrntSideRdrLeObj5RdrObjVx 0;
BA_ "GenSigStartValue" SG_ 356 FrntSideRdrLeObj5RdrObjVx 6400;
BA_ "GenSigSendType" SG_ 356 FrntSideRdrLeObj5RdrObjVxStdDe 0;
BA_ "GenSigSendType" SG_ 356 FrntSideRdrLeObj5RdrObjVy 0;
BA_ "GenSigStartValue" SG_ 356 FrntSideRdrLeObj5RdrObjVy 6400;
BA_ "GenSigSendType" SG_ 356 FrntSideRdrLeObj5RdrObjVyStdDe 0;
BA_ "GenSigSendType" SG_ 356 FrntSideRdrLeObj5RelVx 0;
BA_ "GenSigStartValue" SG_ 356 FrntSideRdrLeObj5RelVx 1780;
BA_ "GenSigSendType" SG_ 356 FrntSideRdrLeObj5RelVy 0;
BA_ "GenSigStartValue" SG_ 356 FrntSideRdrLeObj5RelVy 1780;
BA_ "GenSigSendType" SG_ 358 FrntSideRdrLeObj6Heading 0;
BA_ "GenSigStartValue" SG_ 358 FrntSideRdrLeObj6Heading 1800;
BA_ "GenSigSendType" SG_ 358 FrntSideRdrLeObj6ObjBoxCenterLat 0;
BA_ "GenSigStartValue" SG_ 358 FrntSideRdrLeObj6ObjBoxCenterLat 250;
BA_ "GenSigSendType" SG_ 358 FrntSideRdrLeObj6ObjBoxCenterLgt 0;
BA_ "GenSigStartValue" SG_ 358 FrntSideRdrLeObj6ObjBoxCenterLgt 250;
BA_ "GenSigSendType" SG_ 358 FrntSideRdrLeObj6ObservationHist 0;
BA_ "GenSigSendType" SG_ 358 FrntSideRdrLeObj6QualityBits 0;
BA_ "GenSigSendType" SG_ 358 FrntSideRdrLeObj6RdrObjAx 0;
BA_ "GenSigSendType" SG_ 358 FrntSideRdrLeObj6RdrObjAy 0;
BA_ "GenSigSendType" SG_ 358 FrntSideRdrLeObj6RdrObjBoxLength 0;
BA_ "GenSigSendType" SG_ 358 FrntSideRdrLeObj6RdrObjBoxWidth 0;
BA_ "GenSigDataID" SG_ 358 FrntSideRdrLeObj6RdrObjChks "0x8B9";
BA_ "GenSigFuncType" SG_ 358 FrntSideRdrLeObj6RdrObjChks 15;
BA_ "GenSigSendType" SG_ 358 FrntSideRdrLeObj6RdrObjChks 0;
BA_ "GenSigFuncType" SG_ 358 FrntSideRdrLeObj6RdrObjCntr 16;
BA_ "GenSigSendType" SG_ 358 FrntSideRdrLeObj6RdrObjCntr 0;
BA_ "GenSigSendType" SG_ 358 FrntSideRdrLeObj6RdrObjCoastCnt 0;
BA_ "GenSigStartValue" SG_ 358 FrntSideRdrLeObj6RdrObjCoastCnt 31;
BA_ "GenSigSendType" SG_ 358 FrntSideRdrLeObj6RdrObjConf 0;
BA_ "GenSigSendType" SG_ 358 FrntSideRdrLeObj6RdrObjDx 0;
BA_ "GenSigSendType" SG_ 358 FrntSideRdrLeObj6RdrObjDxStdDe 0;
BA_ "GenSigSendType" SG_ 358 FrntSideRdrLeObj6RdrObjDy 0;
BA_ "GenSigStartValue" SG_ 358 FrntSideRdrLeObj6RdrObjDy 4000;
BA_ "GenSigSendType" SG_ 358 FrntSideRdrLeObj6RdrObjDyStdDe 0;
BA_ "GenSigSendType" SG_ 358 FrntSideRdrLeObj6RdrObjElevnConf 0;
BA_ "GenSigSendType" SG_ 358 FrntSideRdrLeObj6RdrObjElevnSts 0;
BA_ "GenSigSendType" SG_ 358 FrntSideRdrLeObj6RdrObjID 0;
BA_ "GenSigSendType" SG_ 358 FrntSideRdrLeObj6RdrObjIsInFreeSpace 0;
BA_ "GenSigStartValue" SG_ 358 FrntSideRdrLeObj6RdrObjIsInFreeSpace 1;
BA_ "GenSigSendType" SG_ 358 FrntSideRdrLeObj6RdrObjMirrProblty 0;
BA_ "GenSigSendType" SG_ 358 FrntSideRdrLeObj6RdrObjMtnPat 0;
BA_ "GenSigStartValue" SG_ 358 FrntSideRdrLeObj6RdrObjMtnPat 3;
BA_ "GenSigSendType" SG_ 358 FrntSideRdrLeObj6RdrObjNotRealProblty 0;
BA_ "GenSigSendType" SG_ 358 FrntSideRdrLeObj6RdrObjStatyCnt 0;
BA_ "GenSigSendType" SG_ 358 FrntSideRdrLeObj6RdrObjTiAlv 0;
BA_ "GenSigSendType" SG_ 358 FrntSideRdrLeObj6RdrObjTrackSts 0;
BA_ "GenSigSendType" SG_ 358 FrntSideRdrLeObj6RdrObjTyp 0;
BA_ "GenSigSendType" SG_ 358 FrntSideRdrLeObj6RdrObjTypConfBike 0;
BA_ "GenSigSendType" SG_ 358 FrntSideRdrLeObj6RdrObjTypConfPed 0;
BA_ "GenSigSendType" SG_ 358 FrntSideRdrLeObj6RdrObjTypConfVeh 0;
BA_ "GenSigSendType" SG_ 358 FrntSideRdrLeObj6RdrObjUsedTracker 0;
BA_ "GenSigStartValue" SG_ 358 FrntSideRdrLeObj6RdrObjUsedTracker 3;
BA_ "GenSigSendType" SG_ 358 FrntSideRdrLeObj6RdrObjVx 0;
BA_ "GenSigStartValue" SG_ 358 FrntSideRdrLeObj6RdrObjVx 6400;
BA_ "GenSigSendType" SG_ 358 FrntSideRdrLeObj6RdrObjVxStdDe 0;
BA_ "GenSigSendType" SG_ 358 FrntSideRdrLeObj6RdrObjVy 0;
BA_ "GenSigStartValue" SG_ 358 FrntSideRdrLeObj6RdrObjVy 6400;
BA_ "GenSigSendType" SG_ 358 FrntSideRdrLeObj6RdrObjVyStdDe 0;
BA_ "GenSigSendType" SG_ 358 FrntSideRdrLeObj6RelVx 0;
BA_ "GenSigStartValue" SG_ 358 FrntSideRdrLeObj6RelVx 1780;
BA_ "GenSigSendType" SG_ 358 FrntSideRdrLeObj6RelVy 0;
BA_ "GenSigStartValue" SG_ 358 FrntSideRdrLeObj6RelVy 1780;
BA_ "GenSigSendType" SG_ 360 FrntSideRdrLeObj7Heading 0;
BA_ "GenSigStartValue" SG_ 360 FrntSideRdrLeObj7Heading 1800;
BA_ "GenSigSendType" SG_ 360 FrntSideRdrLeObj7ObjBoxCenterLat 0;
BA_ "GenSigStartValue" SG_ 360 FrntSideRdrLeObj7ObjBoxCenterLat 250;
BA_ "GenSigSendType" SG_ 360 FrntSideRdrLeObj7ObjBoxCenterLgt 0;
BA_ "GenSigStartValue" SG_ 360 FrntSideRdrLeObj7ObjBoxCenterLgt 250;
BA_ "GenSigSendType" SG_ 360 FrntSideRdrLeObj7ObservationHist 0;
BA_ "GenSigSendType" SG_ 360 FrntSideRdrLeObj7QualityBits 0;
BA_ "GenSigSendType" SG_ 360 FrntSideRdrLeObj7RdrObjAx 0;
BA_ "GenSigSendType" SG_ 360 FrntSideRdrLeObj7RdrObjAy 0;
BA_ "GenSigSendType" SG_ 360 FrntSideRdrLeObj7RdrObjBoxLength 0;
BA_ "GenSigSendType" SG_ 360 FrntSideRdrLeObj7RdrObjBoxWidth 0;
BA_ "GenSigDataID" SG_ 360 FrntSideRdrLeObj7RdrObjChks "0x8BA";
BA_ "GenSigFuncType" SG_ 360 FrntSideRdrLeObj7RdrObjChks 15;
BA_ "GenSigSendType" SG_ 360 FrntSideRdrLeObj7RdrObjChks 0;
BA_ "GenSigFuncType" SG_ 360 FrntSideRdrLeObj7RdrObjCntr 16;
BA_ "GenSigSendType" SG_ 360 FrntSideRdrLeObj7RdrObjCntr 0;
BA_ "GenSigSendType" SG_ 360 FrntSideRdrLeObj7RdrObjCoastCnt 0;
BA_ "GenSigStartValue" SG_ 360 FrntSideRdrLeObj7RdrObjCoastCnt 31;
BA_ "GenSigSendType" SG_ 360 FrntSideRdrLeObj7RdrObjConf 0;
BA_ "GenSigSendType" SG_ 360 FrntSideRdrLeObj7RdrObjDx 0;
BA_ "GenSigSendType" SG_ 360 FrntSideRdrLeObj7RdrObjDxStdDe 0;
BA_ "GenSigSendType" SG_ 360 FrntSideRdrLeObj7RdrObjDy 0;
BA_ "GenSigStartValue" SG_ 360 FrntSideRdrLeObj7RdrObjDy 4000;
BA_ "GenSigSendType" SG_ 360 FrntSideRdrLeObj7RdrObjDyStdDe 0;
BA_ "GenSigSendType" SG_ 360 FrntSideRdrLeObj7RdrObjElevnConf 0;
BA_ "GenSigSendType" SG_ 360 FrntSideRdrLeObj7RdrObjElevnSts 0;
BA_ "GenSigSendType" SG_ 360 FrntSideRdrLeObj7RdrObjID 0;
BA_ "GenSigSendType" SG_ 360 FrntSideRdrLeObj7RdrObjIsInFreeSpace 0;
BA_ "GenSigStartValue" SG_ 360 FrntSideRdrLeObj7RdrObjIsInFreeSpace 1;
BA_ "GenSigSendType" SG_ 360 FrntSideRdrLeObj7RdrObjMirrProblty 0;
BA_ "GenSigSendType" SG_ 360 FrntSideRdrLeObj7RdrObjMtnPat 0;
BA_ "GenSigStartValue" SG_ 360 FrntSideRdrLeObj7RdrObjMtnPat 3;
BA_ "GenSigSendType" SG_ 360 FrntSideRdrLeObj7RdrObjNotRealProblty 0;
BA_ "GenSigSendType" SG_ 360 FrntSideRdrLeObj7RdrObjStatyCnt 0;
BA_ "GenSigSendType" SG_ 360 FrntSideRdrLeObj7RdrObjTiAlv 0;
BA_ "GenSigSendType" SG_ 360 FrntSideRdrLeObj7RdrObjTrackSts 0;
BA_ "GenSigSendType" SG_ 360 FrntSideRdrLeObj7RdrObjTyp 0;
BA_ "GenSigSendType" SG_ 360 FrntSideRdrLeObj7RdrObjTypConfBike 0;
BA_ "GenSigSendType" SG_ 360 FrntSideRdrLeObj7RdrObjTypConfPed 0;
BA_ "GenSigSendType" SG_ 360 FrntSideRdrLeObj7RdrObjTypConfVeh 0;
BA_ "GenSigSendType" SG_ 360 FrntSideRdrLeObj7RdrObjUsedTracker 0;
BA_ "GenSigStartValue" SG_ 360 FrntSideRdrLeObj7RdrObjUsedTracker 3;
BA_ "GenSigSendType" SG_ 360 FrntSideRdrLeObj7RdrObjVx 0;
BA_ "GenSigStartValue" SG_ 360 FrntSideRdrLeObj7RdrObjVx 6400;
BA_ "GenSigSendType" SG_ 360 FrntSideRdrLeObj7RdrObjVxStdDe 0;
BA_ "GenSigSendType" SG_ 360 FrntSideRdrLeObj7RdrObjVy 0;
BA_ "GenSigStartValue" SG_ 360 FrntSideRdrLeObj7RdrObjVy 6400;
BA_ "GenSigSendType" SG_ 360 FrntSideRdrLeObj7RdrObjVyStdDe 0;
BA_ "GenSigSendType" SG_ 360 FrntSideRdrLeObj7RelVx 0;
BA_ "GenSigStartValue" SG_ 360 FrntSideRdrLeObj7RelVx 1780;
BA_ "GenSigSendType" SG_ 360 FrntSideRdrLeObj7RelVy 0;
BA_ "GenSigStartValue" SG_ 360 FrntSideRdrLeObj7RelVy 1780;
BA_ "GenSigSendType" SG_ 362 FrntSideRdrLeObj8Heading 0;
BA_ "GenSigStartValue" SG_ 362 FrntSideRdrLeObj8Heading 1800;
BA_ "GenSigSendType" SG_ 362 FrntSideRdrLeObj8ObjBoxCenterLat 0;
BA_ "GenSigStartValue" SG_ 362 FrntSideRdrLeObj8ObjBoxCenterLat 250;
BA_ "GenSigSendType" SG_ 362 FrntSideRdrLeObj8ObjBoxCenterLgt 0;
BA_ "GenSigStartValue" SG_ 362 FrntSideRdrLeObj8ObjBoxCenterLgt 250;
BA_ "GenSigSendType" SG_ 362 FrntSideRdrLeObj8ObservationHist 0;
BA_ "GenSigSendType" SG_ 362 FrntSideRdrLeObj8QualityBits 0;
BA_ "GenSigSendType" SG_ 362 FrntSideRdrLeObj8RdrObjAx 0;
BA_ "GenSigSendType" SG_ 362 FrntSideRdrLeObj8RdrObjAy 0;
BA_ "GenSigSendType" SG_ 362 FrntSideRdrLeObj8RdrObjBoxLength 0;
BA_ "GenSigSendType" SG_ 362 FrntSideRdrLeObj8RdrObjBoxWidth 0;
BA_ "GenSigDataID" SG_ 362 FrntSideRdrLeObj8RdrObjChks "0x8BB";
BA_ "GenSigFuncType" SG_ 362 FrntSideRdrLeObj8RdrObjChks 15;
BA_ "GenSigSendType" SG_ 362 FrntSideRdrLeObj8RdrObjChks 0;
BA_ "GenSigFuncType" SG_ 362 FrntSideRdrLeObj8RdrObjCntr 16;
BA_ "GenSigSendType" SG_ 362 FrntSideRdrLeObj8RdrObjCntr 0;
BA_ "GenSigSendType" SG_ 362 FrntSideRdrLeObj8RdrObjCoastCnt 0;
BA_ "GenSigStartValue" SG_ 362 FrntSideRdrLeObj8RdrObjCoastCnt 31;
BA_ "GenSigSendType" SG_ 362 FrntSideRdrLeObj8RdrObjConf 0;
BA_ "GenSigSendType" SG_ 362 FrntSideRdrLeObj8RdrObjDx 0;
BA_ "GenSigSendType" SG_ 362 FrntSideRdrLeObj8RdrObjDxStdDe 0;
BA_ "GenSigSendType" SG_ 362 FrntSideRdrLeObj8RdrObjDy 0;
BA_ "GenSigStartValue" SG_ 362 FrntSideRdrLeObj8RdrObjDy 4000;
BA_ "GenSigSendType" SG_ 362 FrntSideRdrLeObj8RdrObjDyStdDe 0;
BA_ "GenSigSendType" SG_ 362 FrntSideRdrLeObj8RdrObjElevnConf 0;
BA_ "GenSigSendType" SG_ 362 FrntSideRdrLeObj8RdrObjElevnSts 0;
BA_ "GenSigSendType" SG_ 362 FrntSideRdrLeObj8RdrObjID 0;
BA_ "GenSigSendType" SG_ 362 FrntSideRdrLeObj8RdrObjIsInFreeSpace 0;
BA_ "GenSigStartValue" SG_ 362 FrntSideRdrLeObj8RdrObjIsInFreeSpace 1;
BA_ "GenSigSendType" SG_ 362 FrntSideRdrLeObj8RdrObjMirrProblty 0;
BA_ "GenSigSendType" SG_ 362 FrntSideRdrLeObj8RdrObjMtnPat 0;
BA_ "GenSigStartValue" SG_ 362 FrntSideRdrLeObj8RdrObjMtnPat 3;
BA_ "GenSigSendType" SG_ 362 FrntSideRdrLeObj8RdrObjNotRealProblty 0;
BA_ "GenSigSendType" SG_ 362 FrntSideRdrLeObj8RdrObjStatyCnt 0;
BA_ "GenSigSendType" SG_ 362 FrntSideRdrLeObj8RdrObjTiAlv 0;
BA_ "GenSigSendType" SG_ 362 FrntSideRdrLeObj8RdrObjTrackSts 0;
BA_ "GenSigSendType" SG_ 362 FrntSideRdrLeObj8RdrObjTyp 0;
BA_ "GenSigSendType" SG_ 362 FrntSideRdrLeObj8RdrObjTypConfBike 0;
BA_ "GenSigSendType" SG_ 362 FrntSideRdrLeObj8RdrObjTypConfPed 0;
BA_ "GenSigSendType" SG_ 362 FrntSideRdrLeObj8RdrObjTypConfVeh 0;
BA_ "GenSigSendType" SG_ 362 FrntSideRdrLeObj8RdrObjUsedTracker 0;
BA_ "GenSigStartValue" SG_ 362 FrntSideRdrLeObj8RdrObjUsedTracker 3;
BA_ "GenSigSendType" SG_ 362 FrntSideRdrLeObj8RdrObjVx 0;
BA_ "GenSigStartValue" SG_ 362 FrntSideRdrLeObj8RdrObjVx 6400;
BA_ "GenSigSendType" SG_ 362 FrntSideRdrLeObj8RdrObjVxStdDe 0;
BA_ "GenSigSendType" SG_ 362 FrntSideRdrLeObj8RdrObjVy 0;
BA_ "GenSigStartValue" SG_ 362 FrntSideRdrLeObj8RdrObjVy 6400;
BA_ "GenSigSendType" SG_ 362 FrntSideRdrLeObj8RdrObjVyStdDe 0;
BA_ "GenSigSendType" SG_ 362 FrntSideRdrLeObj8RelVx 0;
BA_ "GenSigStartValue" SG_ 362 FrntSideRdrLeObj8RelVx 1780;
BA_ "GenSigSendType" SG_ 362 FrntSideRdrLeObj8RelVy 0;
BA_ "GenSigStartValue" SG_ 362 FrntSideRdrLeObj8RelVy 1780;
BA_ "GenSigSendType" SG_ 364 FrntSideRdrLeObj9Heading 0;
BA_ "GenSigStartValue" SG_ 364 FrntSideRdrLeObj9Heading 1800;
BA_ "GenSigSendType" SG_ 364 FrntSideRdrLeObj9ObjBoxCenterLat 0;
BA_ "GenSigStartValue" SG_ 364 FrntSideRdrLeObj9ObjBoxCenterLat 250;
BA_ "GenSigSendType" SG_ 364 FrntSideRdrLeObj9ObjBoxCenterLgt 0;
BA_ "GenSigStartValue" SG_ 364 FrntSideRdrLeObj9ObjBoxCenterLgt 250;
BA_ "GenSigSendType" SG_ 364 FrntSideRdrLeObj9ObservationHist 0;
BA_ "GenSigSendType" SG_ 364 FrntSideRdrLeObj9QualityBits 0;
BA_ "GenSigSendType" SG_ 364 FrntSideRdrLeObj9RdrObjAx 0;
BA_ "GenSigSendType" SG_ 364 FrntSideRdrLeObj9RdrObjAy 0;
BA_ "GenSigSendType" SG_ 364 FrntSideRdrLeObj9RdrObjBoxLength 0;
BA_ "GenSigSendType" SG_ 364 FrntSideRdrLeObj9RdrObjBoxWidth 0;
BA_ "GenSigDataID" SG_ 364 FrntSideRdrLeObj9RdrObjChks "0x8BC";
BA_ "GenSigFuncType" SG_ 364 FrntSideRdrLeObj9RdrObjChks 15;
BA_ "GenSigSendType" SG_ 364 FrntSideRdrLeObj9RdrObjChks 0;
BA_ "GenSigFuncType" SG_ 364 FrntSideRdrLeObj9RdrObjCntr 16;
BA_ "GenSigSendType" SG_ 364 FrntSideRdrLeObj9RdrObjCntr 0;
BA_ "GenSigSendType" SG_ 364 FrntSideRdrLeObj9RdrObjCoastCnt 0;
BA_ "GenSigStartValue" SG_ 364 FrntSideRdrLeObj9RdrObjCoastCnt 31;
BA_ "GenSigSendType" SG_ 364 FrntSideRdrLeObj9RdrObjConf 0;
BA_ "GenSigSendType" SG_ 364 FrntSideRdrLeObj9RdrObjDx 0;
BA_ "GenSigSendType" SG_ 364 FrntSideRdrLeObj9RdrObjDxStdDe 0;
BA_ "GenSigSendType" SG_ 364 FrntSideRdrLeObj9RdrObjDy 0;
BA_ "GenSigStartValue" SG_ 364 FrntSideRdrLeObj9RdrObjDy 4000;
BA_ "GenSigSendType" SG_ 364 FrntSideRdrLeObj9RdrObjDyStdDe 0;
BA_ "GenSigSendType" SG_ 364 FrntSideRdrLeObj9RdrObjElevnConf 0;
BA_ "GenSigSendType" SG_ 364 FrntSideRdrLeObj9RdrObjElevnSts 0;
BA_ "GenSigSendType" SG_ 364 FrntSideRdrLeObj9RdrObjID 0;
BA_ "GenSigSendType" SG_ 364 FrntSideRdrLeObj9RdrObjIsInFreeSpace 0;
BA_ "GenSigStartValue" SG_ 364 FrntSideRdrLeObj9RdrObjIsInFreeSpace 1;
BA_ "GenSigSendType" SG_ 364 FrntSideRdrLeObj9RdrObjMirrProblty 0;
BA_ "GenSigSendType" SG_ 364 FrntSideRdrLeObj9RdrObjMtnPat 0;
BA_ "GenSigStartValue" SG_ 364 FrntSideRdrLeObj9RdrObjMtnPat 3;
BA_ "GenSigSendType" SG_ 364 FrntSideRdrLeObj9RdrObjNotRealProblty 0;
BA_ "GenSigSendType" SG_ 364 FrntSideRdrLeObj9RdrObjStatyCnt 0;
BA_ "GenSigSendType" SG_ 364 FrntSideRdrLeObj9RdrObjTiAlv 0;
BA_ "GenSigSendType" SG_ 364 FrntSideRdrLeObj9RdrObjTrackSts 0;
BA_ "GenSigSendType" SG_ 364 FrntSideRdrLeObj9RdrObjTyp 0;
BA_ "GenSigSendType" SG_ 364 FrntSideRdrLeObj9RdrObjTypConfBike 0;
BA_ "GenSigSendType" SG_ 364 FrntSideRdrLeObj9RdrObjTypConfPed 0;
BA_ "GenSigSendType" SG_ 364 FrntSideRdrLeObj9RdrObjTypConfVeh 0;
BA_ "GenSigSendType" SG_ 364 FrntSideRdrLeObj9RdrObjUsedTracker 0;
BA_ "GenSigStartValue" SG_ 364 FrntSideRdrLeObj9RdrObjUsedTracker 3;
BA_ "GenSigSendType" SG_ 364 FrntSideRdrLeObj9RdrObjVx 0;
BA_ "GenSigStartValue" SG_ 364 FrntSideRdrLeObj9RdrObjVx 6400;
BA_ "GenSigSendType" SG_ 364 FrntSideRdrLeObj9RdrObjVxStdDe 0;
BA_ "GenSigSendType" SG_ 364 FrntSideRdrLeObj9RdrObjVy 0;
BA_ "GenSigStartValue" SG_ 364 FrntSideRdrLeObj9RdrObjVy 6400;
BA_ "GenSigSendType" SG_ 364 FrntSideRdrLeObj9RdrObjVyStdDe 0;
BA_ "GenSigSendType" SG_ 364 FrntSideRdrLeObj9RelVx 0;
BA_ "GenSigStartValue" SG_ 364 FrntSideRdrLeObj9RelVx 1780;
BA_ "GenSigSendType" SG_ 364 FrntSideRdrLeObj9RelVy 0;
BA_ "GenSigStartValue" SG_ 364 FrntSideRdrLeObj9RelVy 1780;
VAL_ 352 FrntSideRdrLeObj3RdrObjElevnSts 0 "RdrObjElevnSts_Unknown" 1 "RdrObjElevnSts_OverRidable" 2 "RdrObjElevnSts_Rlv" 3 "RdrObjElevnSts_UnderRidable";
VAL_ 352 FrntSideRdrLeObj3RdrObjIsInFreeSpace 0 "YesNo2_No" 1 "YesNo2_Yes";
VAL_ 352 FrntSideRdrLeObj3RdrObjMtnPat 0 "RdrObjMtnPat_Ukwn" 1 "RdrObjMtnPat_Staty" 2 "RdrObjMtnPat_StatyFromMovg" 3 "RdrObjMtnPat_Movg" 4 "RdrObjMtnPat_Receding" 5 "RdrObjMtnPat_Oncoming" 6 "RdrObjMtnPat_CrossingFromLe" 7 "RdrObjMtnPat_CrossingFromRi";
VAL_ 352 FrntSideRdrLeObj3RdrObjTrackSts 0 "RdrObjTrackSts_Invld" 1 "RdrObjTrackSts_Updated" 2 "RdrObjTrackSts_New" 3 "RdrObjTrackSts_Coasted";
VAL_ 352 FrntSideRdrLeObj3RdrObjTyp 0 "RdrObjTyp_Ukwn" 1 "RdrObjTyp_Car" 2 "RdrObjTyp_MotorCycle" 3 "RdrObjTyp_Truck" 4 "RdrObjTyp_Ped" 5 "RdrObjTyp_ObstdVert1" 6 "RdrObjTyp_ObstdVert2" 7 "RdrObjTyp_Anim" 8 "RdrObjTyp_ObjGen" 9 "RdrObjTyp_Bicycle" 10 "RdrObjTyp_VehofUkwnClass" 11 "RdrObjTyp_Reserved";
VAL_ 352 FrntSideRdrLeObj3RdrObjUsedTracker 0 "RdrObjUsedTracker_Stationary" 1 "RdrObjUsedTracker_MovingCVModel" 2 "RdrObjUsedTracker_MovingCTModel" 3 "RdrObjUsedTracker_Undefined";
VAL_ 354 FrntSideRdrLeObj4RdrObjElevnSts 0 "RdrObjElevnSts_Unknown" 1 "RdrObjElevnSts_OverRidable" 2 "RdrObjElevnSts_Rlv" 3 "RdrObjElevnSts_UnderRidable";
VAL_ 354 FrntSideRdrLeObj4RdrObjIsInFreeSpace 0 "YesNo2_No" 1 "YesNo2_Yes";
VAL_ 354 FrntSideRdrLeObj4RdrObjMtnPat 0 "RdrObjMtnPat_Ukwn" 1 "RdrObjMtnPat_Staty" 2 "RdrObjMtnPat_StatyFromMovg" 3 "RdrObjMtnPat_Movg" 4 "RdrObjMtnPat_Receding" 5 "RdrObjMtnPat_Oncoming" 6 "RdrObjMtnPat_CrossingFromLe" 7 "RdrObjMtnPat_CrossingFromRi";
VAL_ 354 FrntSideRdrLeObj4RdrObjTrackSts 0 "RdrObjTrackSts_Invld" 1 "RdrObjTrackSts_Updated" 2 "RdrObjTrackSts_New" 3 "RdrObjTrackSts_Coasted";
VAL_ 354 FrntSideRdrLeObj4RdrObjTyp 0 "RdrObjTyp_Ukwn" 1 "RdrObjTyp_Car" 2 "RdrObjTyp_MotorCycle" 3 "RdrObjTyp_Truck" 4 "RdrObjTyp_Ped" 5 "RdrObjTyp_ObstdVert1" 6 "RdrObjTyp_ObstdVert2" 7 "RdrObjTyp_Anim" 8 "RdrObjTyp_ObjGen" 9 "RdrObjTyp_Bicycle" 10 "RdrObjTyp_VehofUkwnClass" 11 "RdrObjTyp_Reserved";
VAL_ 354 FrntSideRdrLeObj4RdrObjUsedTracker 0 "RdrObjUsedTracker_Stationary" 1 "RdrObjUsedTracker_MovingCVModel" 2 "RdrObjUsedTracker_MovingCTModel" 3 "RdrObjUsedTracker_Undefined";
VAL_ 356 FrntSideRdrLeObj5RdrObjElevnSts 0 "RdrObjElevnSts_Unknown" 1 "RdrObjElevnSts_OverRidable" 2 "RdrObjElevnSts_Rlv" 3 "RdrObjElevnSts_UnderRidable";
VAL_ 356 FrntSideRdrLeObj5RdrObjIsInFreeSpace 0 "YesNo2_No" 1 "YesNo2_Yes";
VAL_ 356 FrntSideRdrLeObj5RdrObjMtnPat 0 "RdrObjMtnPat_Ukwn" 1 "RdrObjMtnPat_Staty" 2 "RdrObjMtnPat_StatyFromMovg" 3 "RdrObjMtnPat_Movg" 4 "RdrObjMtnPat_Receding" 5 "RdrObjMtnPat_Oncoming" 6 "RdrObjMtnPat_CrossingFromLe" 7 "RdrObjMtnPat_CrossingFromRi";
VAL_ 356 FrntSideRdrLeObj5RdrObjTrackSts 0 "RdrObjTrackSts_Invld" 1 "RdrObjTrackSts_Updated" 2 "RdrObjTrackSts_New" 3 "RdrObjTrackSts_Coasted";
VAL_ 356 FrntSideRdrLeObj5RdrObjTyp 0 "RdrObjTyp_Ukwn" 1 "RdrObjTyp_Car" 2 "RdrObjTyp_MotorCycle" 3 "RdrObjTyp_Truck" 4 "RdrObjTyp_Ped" 5 "RdrObjTyp_ObstdVert1" 6 "RdrObjTyp_ObstdVert2" 7 "RdrObjTyp_Anim" 8 "RdrObjTyp_ObjGen" 9 "RdrObjTyp_Bicycle" 10 "RdrObjTyp_VehofUkwnClass" 11 "RdrObjTyp_Reserved";
VAL_ 356 FrntSideRdrLeObj5RdrObjUsedTracker 0 "RdrObjUsedTracker_Stationary" 1 "RdrObjUsedTracker_MovingCVModel" 2 "RdrObjUsedTracker_MovingCTModel" 3 "RdrObjUsedTracker_Undefined";
VAL_ 358 FrntSideRdrLeObj6RdrObjElevnSts 0 "RdrObjElevnSts_Unknown" 1 "RdrObjElevnSts_OverRidable" 2 "RdrObjElevnSts_Rlv" 3 "RdrObjElevnSts_UnderRidable";
VAL_ 358 FrntSideRdrLeObj6RdrObjIsInFreeSpace 0 "YesNo2_No" 1 "YesNo2_Yes";
VAL_ 358 FrntSideRdrLeObj6RdrObjMtnPat 0 "RdrObjMtnPat_Ukwn" 1 "RdrObjMtnPat_Staty" 2 "RdrObjMtnPat_StatyFromMovg" 3 "RdrObjMtnPat_Movg" 4 "RdrObjMtnPat_Receding" 5 "RdrObjMtnPat_Oncoming" 6 "RdrObjMtnPat_CrossingFromLe" 7 "RdrObjMtnPat_CrossingFromRi";
VAL_ 358 FrntSideRdrLeObj6RdrObjTrackSts 0 "RdrObjTrackSts_Invld" 1 "RdrObjTrackSts_Updated" 2 "RdrObjTrackSts_New" 3 "RdrObjTrackSts_Coasted";
VAL_ 358 FrntSideRdrLeObj6RdrObjTyp 0 "RdrObjTyp_Ukwn" 1 "RdrObjTyp_Car" 2 "RdrObjTyp_MotorCycle" 3 "RdrObjTyp_Truck" 4 "RdrObjTyp_Ped" 5 "RdrObjTyp_ObstdVert1" 6 "RdrObjTyp_ObstdVert2" 7 "RdrObjTyp_Anim" 8 "RdrObjTyp_ObjGen" 9 "RdrObjTyp_Bicycle" 10 "RdrObjTyp_VehofUkwnClass" 11 "RdrObjTyp_Reserved";
VAL_ 358 FrntSideRdrLeObj6RdrObjUsedTracker 0 "RdrObjUsedTracker_Stationary" 1 "RdrObjUsedTracker_MovingCVModel" 2 "RdrObjUsedTracker_MovingCTModel" 3 "RdrObjUsedTracker_Undefined";
VAL_ 360 FrntSideRdrLeObj7RdrObjElevnSts 0 "RdrObjElevnSts_Unknown" 1 "RdrObjElevnSts_OverRidable" 2 "RdrObjElevnSts_Rlv" 3 "RdrObjElevnSts_UnderRidable";
VAL_ 360 FrntSideRdrLeObj7RdrObjIsInFreeSpace 0 "YesNo2_No" 1 "YesNo2_Yes";
VAL_ 360 FrntSideRdrLeObj7RdrObjMtnPat 0 "RdrObjMtnPat_Ukwn" 1 "RdrObjMtnPat_Staty" 2 "RdrObjMtnPat_StatyFromMovg" 3 "RdrObjMtnPat_Movg" 4 "RdrObjMtnPat_Receding" 5 "RdrObjMtnPat_Oncoming" 6 "RdrObjMtnPat_CrossingFromLe" 7 "RdrObjMtnPat_CrossingFromRi";
VAL_ 360 FrntSideRdrLeObj7RdrObjTrackSts 0 "RdrObjTrackSts_Invld" 1 "RdrObjTrackSts_Updated" 2 "RdrObjTrackSts_New" 3 "RdrObjTrackSts_Coasted";
VAL_ 360 FrntSideRdrLeObj7RdrObjTyp 0 "RdrObjTyp_Ukwn" 1 "RdrObjTyp_Car" 2 "RdrObjTyp_MotorCycle" 3 "RdrObjTyp_Truck" 4 "RdrObjTyp_Ped" 5 "RdrObjTyp_ObstdVert1" 6 "RdrObjTyp_ObstdVert2" 7 "RdrObjTyp_Anim" 8 "RdrObjTyp_ObjGen" 9 "RdrObjTyp_Bicycle" 10 "RdrObjTyp_VehofUkwnClass" 11 "RdrObjTyp_Reserved";
VAL_ 360 FrntSideRdrLeObj7RdrObjUsedTracker 0 "RdrObjUsedTracker_Stationary" 1 "RdrObjUsedTracker_MovingCVModel" 2 "RdrObjUsedTracker_MovingCTModel" 3 "RdrObjUsedTracker_Undefined";
VAL_ 362 FrntSideRdrLeObj8RdrObjElevnSts 0 "RdrObjElevnSts_Unknown" 1 "RdrObjElevnSts_OverRidable" 2 "RdrObjElevnSts_Rlv" 3 "RdrObjElevnSts_UnderRidable";
VAL_ 362 FrntSideRdrLeObj8RdrObjIsInFreeSpace 0 "YesNo2_No" 1 "YesNo2_Yes";
VAL_ 362 FrntSideRdrLeObj8RdrObjMtnPat 0 "RdrObjMtnPat_Ukwn" 1 "RdrObjMtnPat_Staty" 2 "RdrObjMtnPat_StatyFromMovg" 3 "RdrObjMtnPat_Movg" 4 "RdrObjMtnPat_Receding" 5 "RdrObjMtnPat_Oncoming" 6 "RdrObjMtnPat_CrossingFromLe" 7 "RdrObjMtnPat_CrossingFromRi";
VAL_ 362 FrntSideRdrLeObj8RdrObjTrackSts 0 "RdrObjTrackSts_Invld" 1 "RdrObjTrackSts_Updated" 2 "RdrObjTrackSts_New" 3 "RdrObjTrackSts_Coasted";
VAL_ 362 FrntSideRdrLeObj8RdrObjTyp 0 "RdrObjTyp_Ukwn" 1 "RdrObjTyp_Car" 2 "RdrObjTyp_MotorCycle" 3 "RdrObjTyp_Truck" 4 "RdrObjTyp_Ped" 5 "RdrObjTyp_ObstdVert1" 6 "RdrObjTyp_ObstdVert2" 7 "RdrObjTyp_Anim" 8 "RdrObjTyp_ObjGen" 9 "RdrObjTyp_Bicycle" 10 "RdrObjTyp_VehofUkwnClass" 11 "RdrObjTyp_Reserved";
VAL_ 362 FrntSideRdrLeObj8RdrObjUsedTracker 0 "RdrObjUsedTracker_Stationary" 1 "RdrObjUsedTracker_MovingCVModel" 2 "RdrObjUsedTracker_MovingCTModel" 3 "RdrObjUsedTracker_Undefined";
VAL_ 364 FrntSideRdrLeObj9RdrObjElevnSts 0 "RdrObjElevnSts_Unknown" 1 "RdrObjElevnSts_OverRidable" 2 "RdrObjElevnSts_Rlv" 3 "RdrObjElevnSts_UnderRidable";
VAL_ 364 FrntSideRdrLeObj9RdrObjIsInFreeSpace 0 "YesNo2_No" 1 "YesNo2_Yes";
VAL_ 364 FrntSideRdrLeObj9RdrObjMtnPat 0 "RdrObjMtnPat_Ukwn" 1 "RdrObjMtnPat_Staty" 2 "RdrObjMtnPat_StatyFromMovg" 3 "RdrObjMtnPat_Movg" 4 "RdrObjMtnPat_Receding" 5 "RdrObjMtnPat_Oncoming" 6 "RdrObjMtnPat_CrossingFromLe" 7 "RdrObjMtnPat_CrossingFromRi";
VAL_ 364 FrntSideRdrLeObj9RdrObjTrackSts 0 "RdrObjTrackSts_Invld" 1 "RdrObjTrackSts_Updated" 2 "RdrObjTrackSts_New" 3 "RdrObjTrackSts_Coasted";
VAL_ 364 FrntSideRdrLeObj9RdrObjTyp 0 "RdrObjTyp_Ukwn" 1 "RdrObjTyp_Car" 2 "RdrObjTyp_MotorCycle" 3 "RdrObjTyp_Truck" 4 "RdrObjTyp_Ped" 5 "RdrObjTyp_ObstdVert1" 6 "RdrObjTyp_ObstdVert2" 7 "RdrObjTyp_Anim" 8 "RdrObjTyp_ObjGen" 9 "RdrObjTyp_Bicycle" 10 "RdrObjTyp_VehofUkwnClass" 11 "RdrObjTyp_Reserved";
VAL_ 364 FrntSideRdrLeObj9RdrObjUsedTracker 0 "RdrObjUsedTracker_Stationary" 1 "RdrObjUsedTracker_MovingCVModel" 2 "RdrObjUsedTracker_MovingCTModel" 3 "RdrObjUsedTracker_Undefined";
VAL_ 366 FrntSideRdrLeObj10RdrObjElevnSts 0 "RdrObjElevnSts_Unknown" 1 "RdrObjElevnSts_OverRidable" 2 "RdrObjElevnSts_Rlv" 3 "RdrObjElevnSts_UnderRidable";
VAL_ 366 FrntSideRdrLeObj10RdrObjIsInFreeSpace 0 "YesNo2_No" 1 "YesNo2_Yes";
VAL_ 366 FrntSideRdrLeObj10RdrObjMtnPat 0 "RdrObjMtnPat_Ukwn" 1 "RdrObjMtnPat_Staty" 2 "RdrObjMtnPat_StatyFromMovg" 3 "RdrObjMtnPat_Movg" 4 "RdrObjMtnPat_Receding" 5 "RdrObjMtnPat_Oncoming" 6 "RdrObjMtnPat_CrossingFromLe" 7 "RdrObjMtnPat_CrossingFromRi";
VAL_ 366 FrntSideRdrLeObj10RdrObjTrackSts 0 "RdrObjTrackSts_Invld" 1 "RdrObjTrackSts_Updated" 2 "RdrObjTrackSts_New" 3 "RdrObjTrackSts_Coasted";
VAL_ 366 FrntSideRdrLeObj10RdrObjTyp 0 "RdrObjTyp_Ukwn" 1 "RdrObjTyp_Car" 2 "RdrObjTyp_MotorCycle" 3 "RdrObjTyp_Truck" 4 "RdrObjTyp_Ped" 5 "RdrObjTyp_ObstdVert1" 6 "RdrObjTyp_ObstdVert2" 7 "RdrObjTyp_Anim" 8 "RdrObjTyp_ObjGen" 9 "RdrObjTyp_Bicycle" 10 "RdrObjTyp_VehofUkwnClass" 11 "RdrObjTyp_Reserved";
VAL_ 366 FrntSideRdrLeObj10RdrObjUsedTracker 0 "RdrObjUsedTracker_Stationary" 1 "RdrObjUsedTracker_MovingCVModel" 2 "RdrObjUsedTracker_MovingCTModel" 3 "RdrObjUsedTracker_Undefined";
VAL_ 368 FrntSideRdrLeObj11RdrObjElevnSts 0 "RdrObjElevnSts_Unknown" 1 "RdrObjElevnSts_OverRidable" 2 "RdrObjElevnSts_Rlv" 3 "RdrObjElevnSts_UnderRidable";
VAL_ 368 FrntSideRdrLeObj11RdrObjIsInFreeSpace 0 "YesNo2_No" 1 "YesNo2_Yes";
VAL_ 368 FrntSideRdrLeObj11RdrObjMtnPat 0 "RdrObjMtnPat_Ukwn" 1 "RdrObjMtnPat_Staty" 2 "RdrObjMtnPat_StatyFromMovg" 3 "RdrObjMtnPat_Movg" 4 "RdrObjMtnPat_Receding" 5 "RdrObjMtnPat_Oncoming" 6 "RdrObjMtnPat_CrossingFromLe" 7 "RdrObjMtnPat_CrossingFromRi";
VAL_ 368 FrntSideRdrLeObj11RdrObjTrackSts 0 "RdrObjTrackSts_Invld" 1 "RdrObjTrackSts_Updated" 2 "RdrObjTrackSts_New" 3 "RdrObjTrackSts_Coasted";
VAL_ 368 FrntSideRdrLeObj11RdrObjTyp 0 "RdrObjTyp_Ukwn" 1 "RdrObjTyp_Car" 2 "RdrObjTyp_MotorCycle" 3 "RdrObjTyp_Truck" 4 "RdrObjTyp_Ped" 5 "RdrObjTyp_ObstdVert1" 6 "RdrObjTyp_ObstdVert2" 7 "RdrObjTyp_Anim" 8 "RdrObjTyp_ObjGen" 9 "RdrObjTyp_Bicycle" 10 "RdrObjTyp_VehofUkwnClass" 11 "RdrObjTyp_Reserved";
VAL_ 368 FrntSideRdrLeObj11RdrObjUsedTracker 0 "RdrObjUsedTracker_Stationary" 1 "RdrObjUsedTracker_MovingCVModel" 2 "RdrObjUsedTracker_MovingCTModel" 3 "RdrObjUsedTracker_Undefined";
VAL_ 370 FrntSideRdrLeObj12RdrObjElevnSts 0 "RdrObjElevnSts_Unknown" 1 "RdrObjElevnSts_OverRidable" 2 "RdrObjElevnSts_Rlv" 3 "RdrObjElevnSts_UnderRidable";
VAL_ 370 FrntSideRdrLeObj12RdrObjIsInFreeSpace 0 "YesNo2_No" 1 "YesNo2_Yes";
VAL_ 370 FrntSideRdrLeObj12RdrObjMtnPat 0 "RdrObjMtnPat_Ukwn" 1 "RdrObjMtnPat_Staty" 2 "RdrObjMtnPat_StatyFromMovg" 3 "RdrObjMtnPat_Movg" 4 "RdrObjMtnPat_Receding" 5 "RdrObjMtnPat_Oncoming" 6 "RdrObjMtnPat_CrossingFromLe" 7 "RdrObjMtnPat_CrossingFromRi";
VAL_ 370 FrntSideRdrLeObj12RdrObjTrackSts 0 "RdrObjTrackSts_Invld" 1 "RdrObjTrackSts_Updated" 2 "RdrObjTrackSts_New" 3 "RdrObjTrackSts_Coasted";
VAL_ 370 FrntSideRdrLeObj12RdrObjTyp 0 "RdrObjTyp_Ukwn" 1 "RdrObjTyp_Car" 2 "RdrObjTyp_MotorCycle" 3 "RdrObjTyp_Truck" 4 "RdrObjTyp_Ped" 5 "RdrObjTyp_ObstdVert1" 6 "RdrObjTyp_ObstdVert2" 7 "RdrObjTyp_Anim" 8 "RdrObjTyp_ObjGen" 9 "RdrObjTyp_Bicycle" 10 "RdrObjTyp_VehofUkwnClass" 11 "RdrObjTyp_Reserved";
VAL_ 370 FrntSideRdrLeObj12RdrObjUsedTracker 0 "RdrObjUsedTracker_Stationary" 1 "RdrObjUsedTracker_MovingCVModel" 2 "RdrObjUsedTracker_MovingCTModel" 3 "RdrObjUsedTracker_Undefined";
VAL_ 372 FrntSideRdrLeObj13RdrObjElevnSts 0 "RdrObjElevnSts_Unknown" 1 "RdrObjElevnSts_OverRidable" 2 "RdrObjElevnSts_Rlv" 3 "RdrObjElevnSts_UnderRidable";
VAL_ 372 FrntSideRdrLeObj13RdrObjIsInFreeSpace 0 "YesNo2_No" 1 "YesNo2_Yes";
VAL_ 372 FrntSideRdrLeObj13RdrObjMtnPat 0 "RdrObjMtnPat_Ukwn" 1 "RdrObjMtnPat_Staty" 2 "RdrObjMtnPat_StatyFromMovg" 3 "RdrObjMtnPat_Movg" 4 "RdrObjMtnPat_Receding" 5 "RdrObjMtnPat_Oncoming" 6 "RdrObjMtnPat_CrossingFromLe" 7 "RdrObjMtnPat_CrossingFromRi";
VAL_ 372 FrntSideRdrLeObj13RdrObjTrackSts 0 "RdrObjTrackSts_Invld" 1 "RdrObjTrackSts_Updated" 2 "RdrObjTrackSts_New" 3 "RdrObjTrackSts_Coasted";
VAL_ 372 FrntSideRdrLeObj13RdrObjTyp 0 "RdrObjTyp_Ukwn" 1 "RdrObjTyp_Car" 2 "RdrObjTyp_MotorCycle" 3 "RdrObjTyp_Truck" 4 "RdrObjTyp_Ped" 5 "RdrObjTyp_ObstdVert1" 6 "RdrObjTyp_ObstdVert2" 7 "RdrObjTyp_Anim" 8 "RdrObjTyp_ObjGen" 9 "RdrObjTyp_Bicycle" 10 "RdrObjTyp_VehofUkwnClass" 11 "RdrObjTyp_Reserved";
VAL_ 372 FrntSideRdrLeObj13RdrObjUsedTracker 0 "RdrObjUsedTracker_Stationary" 1 "RdrObjUsedTracker_MovingCVModel" 2 "RdrObjUsedTracker_MovingCTModel" 3 "RdrObjUsedTracker_Undefined";
VAL_ 374 FrntSideRdrLeObj14RdrObjElevnSts 0 "RdrObjElevnSts_Unknown" 1 "RdrObjElevnSts_OverRidable" 2 "RdrObjElevnSts_Rlv" 3 "RdrObjElevnSts_UnderRidable";
VAL_ 374 FrntSideRdrLeObj14RdrObjIsInFreeSpace 0 "YesNo2_No" 1 "YesNo2_Yes";
VAL_ 374 FrntSideRdrLeObj14RdrObjMtnPat 0 "RdrObjMtnPat_Ukwn" 1 "RdrObjMtnPat_Staty" 2 "RdrObjMtnPat_StatyFromMovg" 3 "RdrObjMtnPat_Movg" 4 "RdrObjMtnPat_Receding" 5 "RdrObjMtnPat_Oncoming" 6 "RdrObjMtnPat_CrossingFromLe" 7 "RdrObjMtnPat_CrossingFromRi";
VAL_ 374 FrntSideRdrLeObj14RdrObjTrackSts 0 "RdrObjTrackSts_Invld" 1 "RdrObjTrackSts_Updated" 2 "RdrObjTrackSts_New" 3 "RdrObjTrackSts_Coasted";
VAL_ 374 FrntSideRdrLeObj14RdrObjTyp 0 "RdrObjTyp_Ukwn" 1 "RdrObjTyp_Car" 2 "RdrObjTyp_MotorCycle" 3 "RdrObjTyp_Truck" 4 "RdrObjTyp_Ped" 5 "RdrObjTyp_ObstdVert1" 6 "RdrObjTyp_ObstdVert2" 7 "RdrObjTyp_Anim" 8 "RdrObjTyp_ObjGen" 9 "RdrObjTyp_Bicycle" 10 "RdrObjTyp_VehofUkwnClass" 11 "RdrObjTyp_Reserved";
VAL_ 374 FrntSideRdrLeObj14RdrObjUsedTracker 0 "RdrObjUsedTracker_Stationary" 1 "RdrObjUsedTracker_MovingCVModel" 2 "RdrObjUsedTracker_MovingCTModel" 3 "RdrObjUsedTracker_Undefined";
VAL_ 376 FrntSideRdrLeObj15RdrObjElevnSts 0 "RdrObjElevnSts_Unknown" 1 "RdrObjElevnSts_OverRidable" 2 "RdrObjElevnSts_Rlv" 3 "RdrObjElevnSts_UnderRidable";
VAL_ 376 FrntSideRdrLeObj15RdrObjIsInFreeSpace 0 "YesNo2_No" 1 "YesNo2_Yes";
VAL_ 376 FrntSideRdrLeObj15RdrObjMtnPat 0 "RdrObjMtnPat_Ukwn" 1 "RdrObjMtnPat_Staty" 2 "RdrObjMtnPat_StatyFromMovg" 3 "RdrObjMtnPat_Movg" 4 "RdrObjMtnPat_Receding" 5 "RdrObjMtnPat_Oncoming" 6 "RdrObjMtnPat_CrossingFromLe" 7 "RdrObjMtnPat_CrossingFromRi";
VAL_ 376 FrntSideRdrLeObj15RdrObjTrackSts 0 "RdrObjTrackSts_Invld" 1 "RdrObjTrackSts_Updated" 2 "RdrObjTrackSts_New" 3 "RdrObjTrackSts_Coasted";
VAL_ 376 FrntSideRdrLeObj15RdrObjTyp 0 "RdrObjTyp_Ukwn" 1 "RdrObjTyp_Car" 2 "RdrObjTyp_MotorCycle" 3 "RdrObjTyp_Truck" 4 "RdrObjTyp_Ped" 5 "RdrObjTyp_ObstdVert1" 6 "RdrObjTyp_ObstdVert2" 7 "RdrObjTyp_Anim" 8 "RdrObjTyp_ObjGen" 9 "RdrObjTyp_Bicycle" 10 "RdrObjTyp_VehofUkwnClass" 11 "RdrObjTyp_Reserved";
VAL_ 376 FrntSideRdrLeObj15RdrObjUsedTracker 0 "RdrObjUsedTracker_Stationary" 1 "RdrObjUsedTracker_MovingCVModel" 2 "RdrObjUsedTracker_MovingCTModel" 3 "RdrObjUsedTracker_Undefined";
SIG_GROUP_ 366 FrntSideRdrLeObj10 1 : FrntSideRdrLeObj10Heading FrntSideRdrLeObj10ObjBoxCenterLat FrntSideRdrLeObj10ObjBoxCenterLgt FrntSideRdrLeObj10ObservationHist FrntSideRdrLeObj10QualityBits FrntSideRdrLeObj10RdrObjAx FrntSideRdrLeObj10RdrObjAy FrntSideRdrLeObj10RdrObjBoxLength FrntSideRdrLeObj10RdrObjBoxWidth FrntSideRdrLeObj10RdrObjChks FrntSideRdrLeObj10RdrObjCntr FrntSideRdrLeObj10RdrObjCoastCnt FrntSideRdrLeObj10RdrObjConf FrntSideRdrLeObj10RdrObjDx FrntSideRdrLeObj10RdrObjDxStdDe FrntSideRdrLeObj10RdrObjDy FrntSideRdrLeObj10RdrObjDyStdDe FrntSideRdrLeObj10RdrObjElevnConf FrntSideRdrLeObj10RdrObjElevnSts FrntSideRdrLeObj10RdrObjID FrntSideRdrLeObj10RdrObjIsInFreeSpace FrntSideRdrLeObj10RdrObjMirrProblty FrntSideRdrLeObj10RdrObjMtnPat FrntSideRdrLeObj10RdrObjNotRealProblty FrntSideRdrLeObj10RdrObjStatyCnt FrntSideRdrLeObj10RdrObjTiAlv FrntSideRdrLeObj10RdrObjTrackSts FrntSideRdrLeObj10RdrObjTyp FrntSideRdrLeObj10RdrObjTypConfBike FrntSideRdrLeObj10RdrObjTypConfPed FrntSideRdrLeObj10RdrObjTypConfVeh FrntSideRdrLeObj10RdrObjUsedTracker FrntSideRdrLeObj10RdrObjVx FrntSideRdrLeObj10RdrObjVxStdDe FrntSideRdrLeObj10RdrObjVy FrntSideRdrLeObj10RdrObjVyStdDe FrntSideRdrLeObj10RelVx FrntSideRdrLeObj10RelVy;
SIG_GROUP_ 368 FrntSideRdrLeObj11 1 : FrntSideRdrLeObj11Heading FrntSideRdrLeObj11ObjBoxCenterLat FrntSideRdrLeObj11ObjBoxCenterLgt FrntSideRdrLeObj11ObservationHist FrntSideRdrLeObj11QualityBits FrntSideRdrLeObj11RdrObjAx FrntSideRdrLeObj11RdrObjAy FrntSideRdrLeObj11RdrObjBoxLength FrntSideRdrLeObj11RdrObjBoxWidth FrntSideRdrLeObj11RdrObjChks FrntSideRdrLeObj11RdrObjCntr FrntSideRdrLeObj11RdrObjCoastCnt FrntSideRdrLeObj11RdrObjConf FrntSideRdrLeObj11RdrObjDx FrntSideRdrLeObj11RdrObjDxStdDe FrntSideRdrLeObj11RdrObjDy FrntSideRdrLeObj11RdrObjDyStdDe FrntSideRdrLeObj11RdrObjElevnConf FrntSideRdrLeObj11RdrObjElevnSts FrntSideRdrLeObj11RdrObjID FrntSideRdrLeObj11RdrObjIsInFreeSpace FrntSideRdrLeObj11RdrObjMirrProblty FrntSideRdrLeObj11RdrObjMtnPat FrntSideRdrLeObj11RdrObjNotRealProblty FrntSideRdrLeObj11RdrObjStatyCnt FrntSideRdrLeObj11RdrObjTiAlv FrntSideRdrLeObj11RdrObjTrackSts FrntSideRdrLeObj11RdrObjTyp FrntSideRdrLeObj11RdrObjTypConfBike FrntSideRdrLeObj11RdrObjTypConfPed FrntSideRdrLeObj11RdrObjTypConfVeh FrntSideRdrLeObj11RdrObjUsedTracker FrntSideRdrLeObj11RdrObjVx FrntSideRdrLeObj11RdrObjVxStdDe FrntSideRdrLeObj11RdrObjVy FrntSideRdrLeObj11RdrObjVyStdDe FrntSideRdrLeObj11RelVx FrntSideRdrLeObj11RelVy;
SIG_GROUP_ 370 FrntSideRdrLeObj12 1 : FrntSideRdrLeObj12Heading FrntSideRdrLeObj12ObjBoxCenterLat FrntSideRdrLeObj12ObjBoxCenterLgt FrntSideRdrLeObj12ObservationHist FrntSideRdrLeObj12QualityBits FrntSideRdrLeObj12RdrObjAx FrntSideRdrLeObj12RdrObjAy FrntSideRdrLeObj12RdrObjBoxLength FrntSideRdrLeObj12RdrObjBoxWidth FrntSideRdrLeObj12RdrObjChks FrntSideRdrLeObj12RdrObjCntr FrntSideRdrLeObj12RdrObjCoastCnt FrntSideRdrLeObj12RdrObjConf FrntSideRdrLeObj12RdrObjDx FrntSideRdrLeObj12RdrObjDxStdDe FrntSideRdrLeObj12RdrObjDy FrntSideRdrLeObj12RdrObjDyStdDe FrntSideRdrLeObj12RdrObjElevnConf FrntSideRdrLeObj12RdrObjElevnSts FrntSideRdrLeObj12RdrObjID FrntSideRdrLeObj12RdrObjIsInFreeSpace FrntSideRdrLeObj12RdrObjMirrProblty FrntSideRdrLeObj12RdrObjMtnPat FrntSideRdrLeObj12RdrObjNotRealProblty FrntSideRdrLeObj12RdrObjStatyCnt FrntSideRdrLeObj12RdrObjTiAlv FrntSideRdrLeObj12RdrObjTrackSts FrntSideRdrLeObj12RdrObjTyp FrntSideRdrLeObj12RdrObjTypConfBike FrntSideRdrLeObj12RdrObjTypConfPed FrntSideRdrLeObj12RdrObjTypConfVeh FrntSideRdrLeObj12RdrObjUsedTracker FrntSideRdrLeObj12RdrObjVx FrntSideRdrLeObj12RdrObjVxStdDe FrntSideRdrLeObj12RdrObjVy FrntSideRdrLeObj12RdrObjVyStdDe FrntSideRdrLeObj12RelVx FrntSideRdrLeObj12RelVy;
SIG_GROUP_ 372 FrntSideRdrLeObj13 1 : FrntSideRdrLeObj13Heading FrntSideRdrLeObj13ObjBoxCenterLat FrntSideRdrLeObj13ObjBoxCenterLgt FrntSideRdrLeObj13ObservationHist FrntSideRdrLeObj13QualityBits FrntSideRdrLeObj13RdrObjAx FrntSideRdrLeObj13RdrObjAy FrntSideRdrLeObj13RdrObjBoxLength FrntSideRdrLeObj13RdrObjBoxWidth FrntSideRdrLeObj13RdrObjChks FrntSideRdrLeObj13RdrObjCntr FrntSideRdrLeObj13RdrObjCoastCnt FrntSideRdrLeObj13RdrObjConf FrntSideRdrLeObj13RdrObjDx FrntSideRdrLeObj13RdrObjDxStdDe FrntSideRdrLeObj13RdrObjDy FrntSideRdrLeObj13RdrObjDyStdDe FrntSideRdrLeObj13RdrObjElevnConf FrntSideRdrLeObj13RdrObjElevnSts FrntSideRdrLeObj13RdrObjID FrntSideRdrLeObj13RdrObjIsInFreeSpace FrntSideRdrLeObj13RdrObjMirrProblty FrntSideRdrLeObj13RdrObjMtnPat FrntSideRdrLeObj13RdrObjNotRealProblty FrntSideRdrLeObj13RdrObjStatyCnt FrntSideRdrLeObj13RdrObjTiAlv FrntSideRdrLeObj13RdrObjTrackSts FrntSideRdrLeObj13RdrObjTyp FrntSideRdrLeObj13RdrObjTypConfBike FrntSideRdrLeObj13RdrObjTypConfPed FrntSideRdrLeObj13RdrObjTypConfVeh FrntSideRdrLeObj13RdrObjUsedTracker FrntSideRdrLeObj13RdrObjVx FrntSideRdrLeObj13RdrObjVxStdDe FrntSideRdrLeObj13RdrObjVy FrntSideRdrLeObj13RdrObjVyStdDe FrntSideRdrLeObj13RelVx FrntSideRdrLeObj13RelVy;
SIG_GROUP_ 374 FrntSideRdrLeObj14 1 : FrntSideRdrLeObj14Heading FrntSideRdrLeObj14ObjBoxCenterLat FrntSideRdrLeObj14ObjBoxCenterLgt FrntSideRdrLeObj14ObservationHist FrntSideRdrLeObj14QualityBits FrntSideRdrLeObj14RdrObjAx FrntSideRdrLeObj14RdrObjAy FrntSideRdrLeObj14RdrObjBoxLength FrntSideRdrLeObj14RdrObjBoxWidth FrntSideRdrLeObj14RdrObjChks FrntSideRdrLeObj14RdrObjCntr FrntSideRdrLeObj14RdrObjCoastCnt FrntSideRdrLeObj14RdrObjConf FrntSideRdrLeObj14RdrObjDx FrntSideRdrLeObj14RdrObjDxStdDe FrntSideRdrLeObj14RdrObjDy FrntSideRdrLeObj14RdrObjDyStdDe FrntSideRdrLeObj14RdrObjElevnConf FrntSideRdrLeObj14RdrObjElevnSts FrntSideRdrLeObj14RdrObjID FrntSideRdrLeObj14RdrObjIsInFreeSpace FrntSideRdrLeObj14RdrObjMirrProblty FrntSideRdrLeObj14RdrObjMtnPat FrntSideRdrLeObj14RdrObjNotRealProblty FrntSideRdrLeObj14RdrObjStatyCnt FrntSideRdrLeObj14RdrObjTiAlv FrntSideRdrLeObj14RdrObjTrackSts FrntSideRdrLeObj14RdrObjTyp FrntSideRdrLeObj14RdrObjTypConfBike FrntSideRdrLeObj14RdrObjTypConfPed FrntSideRdrLeObj14RdrObjTypConfVeh FrntSideRdrLeObj14RdrObjUsedTracker FrntSideRdrLeObj14RdrObjVx FrntSideRdrLeObj14RdrObjVxStdDe FrntSideRdrLeObj14RdrObjVy FrntSideRdrLeObj14RdrObjVyStdDe FrntSideRdrLeObj14RelVx FrntSideRdrLeObj14RelVy;
SIG_GROUP_ 376 FrntSideRdrLeObj15 1 : FrntSideRdrLeObj15Heading FrntSideRdrLeObj15ObjBoxCenterLat FrntSideRdrLeObj15ObjBoxCenterLgt FrntSideRdrLeObj15ObservationHist FrntSideRdrLeObj15QualityBits FrntSideRdrLeObj15RdrObjAx FrntSideRdrLeObj15RdrObjAy FrntSideRdrLeObj15RdrObjBoxLength FrntSideRdrLeObj15RdrObjBoxWidth FrntSideRdrLeObj15RdrObjChks FrntSideRdrLeObj15RdrObjCntr FrntSideRdrLeObj15RdrObjCoastCnt FrntSideRdrLeObj15RdrObjConf FrntSideRdrLeObj15RdrObjDx FrntSideRdrLeObj15RdrObjDxStdDe FrntSideRdrLeObj15RdrObjDy FrntSideRdrLeObj15RdrObjDyStdDe FrntSideRdrLeObj15RdrObjElevnConf FrntSideRdrLeObj15RdrObjElevnSts FrntSideRdrLeObj15RdrObjID FrntSideRdrLeObj15RdrObjIsInFreeSpace FrntSideRdrLeObj15RdrObjMirrProblty FrntSideRdrLeObj15RdrObjMtnPat FrntSideRdrLeObj15RdrObjNotRealProblty FrntSideRdrLeObj15RdrObjStatyCnt FrntSideRdrLeObj15RdrObjTiAlv FrntSideRdrLeObj15RdrObjTrackSts FrntSideRdrLeObj15RdrObjTyp FrntSideRdrLeObj15RdrObjTypConfBike FrntSideRdrLeObj15RdrObjTypConfPed FrntSideRdrLeObj15RdrObjTypConfVeh FrntSideRdrLeObj15RdrObjUsedTracker FrntSideRdrLeObj15RdrObjVx FrntSideRdrLeObj15RdrObjVxStdDe FrntSideRdrLeObj15RdrObjVy FrntSideRdrLeObj15RdrObjVyStdDe FrntSideRdrLeObj15RelVx FrntSideRdrLeObj15RelVy;
SIG_GROUP_ 352 FrntSideRdrLeObj3 1 : FrntSideRdrLeObj3Heading FrntSideRdrLeObj3ObjBoxCenterLat FrntSideRdrLeObj3ObjBoxCenterLgt FrntSideRdrLeObj3ObservationHist FrntSideRdrLeObj3QualityBits FrntSideRdrLeObj3RdrObjAx FrntSideRdrLeObj3RdrObjAy FrntSideRdrLeObj3RdrObjBoxLength FrntSideRdrLeObj3RdrObjBoxWidth FrntSideRdrLeObj3RdrObjChks FrntSideRdrLeObj3RdrObjCntr FrntSideRdrLeObj3RdrObjCoastCnt FrntSideRdrLeObj3RdrObjConf FrntSideRdrLeObj3RdrObjDx FrntSideRdrLeObj3RdrObjDxStdDe FrntSideRdrLeObj3RdrObjDy FrntSideRdrLeObj3RdrObjDyStdDe FrntSideRdrLeObj3RdrObjElevnConf FrntSideRdrLeObj3RdrObjElevnSts FrntSideRdrLeObj3RdrObjID FrntSideRdrLeObj3RdrObjIsInFreeSpace FrntSideRdrLeObj3RdrObjMirrProblty FrntSideRdrLeObj3RdrObjMtnPat FrntSideRdrLeObj3RdrObjNotRealProblty FrntSideRdrLeObj3RdrObjStatyCnt FrntSideRdrLeObj3RdrObjTiAlv FrntSideRdrLeObj3RdrObjTrackSts FrntSideRdrLeObj3RdrObjTyp FrntSideRdrLeObj3RdrObjTypConfBike FrntSideRdrLeObj3RdrObjTypConfPed FrntSideRdrLeObj3RdrObjTypConfVeh FrntSideRdrLeObj3RdrObjUsedTracker FrntSideRdrLeObj3RdrObjVx FrntSideRdrLeObj3RdrObjVxStdDe FrntSideRdrLeObj3RdrObjVy FrntSideRdrLeObj3RdrObjVyStdDe FrntSideRdrLeObj3RelVx FrntSideRdrLeObj3RelVy;
SIG_GROUP_ 354 FrntSideRdrLeObj4 1 : FrntSideRdrLeObj4Heading FrntSideRdrLeObj4ObjBoxCenterLat FrntSideRdrLeObj4ObjBoxCenterLgt FrntSideRdrLeObj4ObservationHist FrntSideRdrLeObj4QualityBits FrntSideRdrLeObj4RdrObjAx FrntSideRdrLeObj4RdrObjAy FrntSideRdrLeObj4RdrObjBoxLength FrntSideRdrLeObj4RdrObjBoxWidth FrntSideRdrLeObj4RdrObjChks FrntSideRdrLeObj4RdrObjCntr FrntSideRdrLeObj4RdrObjCoastCnt FrntSideRdrLeObj4RdrObjConf FrntSideRdrLeObj4RdrObjDx FrntSideRdrLeObj4RdrObjDxStdDe FrntSideRdrLeObj4RdrObjDy FrntSideRdrLeObj4RdrObjDyStdDe FrntSideRdrLeObj4RdrObjElevnConf FrntSideRdrLeObj4RdrObjElevnSts FrntSideRdrLeObj4RdrObjID FrntSideRdrLeObj4RdrObjIsInFreeSpace FrntSideRdrLeObj4RdrObjMirrProblty FrntSideRdrLeObj4RdrObjMtnPat FrntSideRdrLeObj4RdrObjNotRealProblty FrntSideRdrLeObj4RdrObjStatyCnt FrntSideRdrLeObj4RdrObjTiAlv FrntSideRdrLeObj4RdrObjTrackSts FrntSideRdrLeObj4RdrObjTyp FrntSideRdrLeObj4RdrObjTypConfBike FrntSideRdrLeObj4RdrObjTypConfPed FrntSideRdrLeObj4RdrObjTypConfVeh FrntSideRdrLeObj4RdrObjUsedTracker FrntSideRdrLeObj4RdrObjVx FrntSideRdrLeObj4RdrObjVxStdDe FrntSideRdrLeObj4RdrObjVy FrntSideRdrLeObj4RdrObjVyStdDe FrntSideRdrLeObj4RelVx FrntSideRdrLeObj4RelVy;
SIG_GROUP_ 356 FrntSideRdrLeObj5 1 : FrntSideRdrLeObj5Heading FrntSideRdrLeObj5ObjBoxCenterLat FrntSideRdrLeObj5ObjBoxCenterLgt FrntSideRdrLeObj5ObservationHist FrntSideRdrLeObj5QualityBits FrntSideRdrLeObj5RdrObjAx FrntSideRdrLeObj5RdrObjAy FrntSideRdrLeObj5RdrObjBoxLength FrntSideRdrLeObj5RdrObjBoxWidth FrntSideRdrLeObj5RdrObjChks FrntSideRdrLeObj5RdrObjCntr FrntSideRdrLeObj5RdrObjCoastCnt FrntSideRdrLeObj5RdrObjConf FrntSideRdrLeObj5RdrObjDx FrntSideRdrLeObj5RdrObjDxStdDe FrntSideRdrLeObj5RdrObjDy FrntSideRdrLeObj5RdrObjDyStdDe FrntSideRdrLeObj5RdrObjElevnConf FrntSideRdrLeObj5RdrObjElevnSts FrntSideRdrLeObj5RdrObjID FrntSideRdrLeObj5RdrObjIsInFreeSpace FrntSideRdrLeObj5RdrObjMirrProblty FrntSideRdrLeObj5RdrObjMtnPat FrntSideRdrLeObj5RdrObjNotRealProblty FrntSideRdrLeObj5RdrObjStatyCnt FrntSideRdrLeObj5RdrObjTiAlv FrntSideRdrLeObj5RdrObjTrackSts FrntSideRdrLeObj5RdrObjTyp FrntSideRdrLeObj5RdrObjTypConfBike FrntSideRdrLeObj5RdrObjTypConfPed FrntSideRdrLeObj5RdrObjTypConfVeh FrntSideRdrLeObj5RdrObjUsedTracker FrntSideRdrLeObj5RdrObjVx FrntSideRdrLeObj5RdrObjVxStdDe FrntSideRdrLeObj5RdrObjVy FrntSideRdrLeObj5RdrObjVyStdDe FrntSideRdrLeObj5RelVx FrntSideRdrLeObj5RelVy;
SIG_GROUP_ 358 FrntSideRdrLeObj6 1 : FrntSideRdrLeObj6Heading FrntSideRdrLeObj6ObjBoxCenterLat FrntSideRdrLeObj6ObjBoxCenterLgt FrntSideRdrLeObj6ObservationHist FrntSideRdrLeObj6QualityBits FrntSideRdrLeObj6RdrObjAx FrntSideRdrLeObj6RdrObjAy FrntSideRdrLeObj6RdrObjBoxLength FrntSideRdrLeObj6RdrObjBoxWidth FrntSideRdrLeObj6RdrObjChks FrntSideRdrLeObj6RdrObjCntr FrntSideRdrLeObj6RdrObjCoastCnt FrntSideRdrLeObj6RdrObjConf FrntSideRdrLeObj6RdrObjDx FrntSideRdrLeObj6RdrObjDxStdDe FrntSideRdrLeObj6RdrObjDy FrntSideRdrLeObj6RdrObjDyStdDe FrntSideRdrLeObj6RdrObjElevnConf FrntSideRdrLeObj6RdrObjElevnSts FrntSideRdrLeObj6RdrObjID FrntSideRdrLeObj6RdrObjIsInFreeSpace FrntSideRdrLeObj6RdrObjMirrProblty FrntSideRdrLeObj6RdrObjMtnPat FrntSideRdrLeObj6RdrObjNotRealProblty FrntSideRdrLeObj6RdrObjStatyCnt FrntSideRdrLeObj6RdrObjTiAlv FrntSideRdrLeObj6RdrObjTrackSts FrntSideRdrLeObj6RdrObjTyp FrntSideRdrLeObj6RdrObjTypConfBike FrntSideRdrLeObj6RdrObjTypConfPed FrntSideRdrLeObj6RdrObjTypConfVeh FrntSideRdrLeObj6RdrObjUsedTracker FrntSideRdrLeObj6RdrObjVx FrntSideRdrLeObj6RdrObjVxStdDe FrntSideRdrLeObj6RdrObjVy FrntSideRdrLeObj6RdrObjVyStdDe FrntSideRdrLeObj6RelVx FrntSideRdrLeObj6RelVy;
SIG_GROUP_ 360 FrntSideRdrLeObj7 1 : FrntSideRdrLeObj7Heading FrntSideRdrLeObj7ObjBoxCenterLat FrntSideRdrLeObj7ObjBoxCenterLgt FrntSideRdrLeObj7ObservationHist FrntSideRdrLeObj7QualityBits FrntSideRdrLeObj7RdrObjAx FrntSideRdrLeObj7RdrObjAy FrntSideRdrLeObj7RdrObjBoxLength FrntSideRdrLeObj7RdrObjBoxWidth FrntSideRdrLeObj7RdrObjChks FrntSideRdrLeObj7RdrObjCntr FrntSideRdrLeObj7RdrObjCoastCnt FrntSideRdrLeObj7RdrObjConf FrntSideRdrLeObj7RdrObjDx FrntSideRdrLeObj7RdrObjDxStdDe FrntSideRdrLeObj7RdrObjDy FrntSideRdrLeObj7RdrObjDyStdDe FrntSideRdrLeObj7RdrObjElevnConf FrntSideRdrLeObj7RdrObjElevnSts FrntSideRdrLeObj7RdrObjID FrntSideRdrLeObj7RdrObjIsInFreeSpace FrntSideRdrLeObj7RdrObjMirrProblty FrntSideRdrLeObj7RdrObjMtnPat FrntSideRdrLeObj7RdrObjNotRealProblty FrntSideRdrLeObj7RdrObjStatyCnt FrntSideRdrLeObj7RdrObjTiAlv FrntSideRdrLeObj7RdrObjTrackSts FrntSideRdrLeObj7RdrObjTyp FrntSideRdrLeObj7RdrObjTypConfBike FrntSideRdrLeObj7RdrObjTypConfPed FrntSideRdrLeObj7RdrObjTypConfVeh FrntSideRdrLeObj7RdrObjUsedTracker FrntSideRdrLeObj7RdrObjVx FrntSideRdrLeObj7RdrObjVxStdDe FrntSideRdrLeObj7RdrObjVy FrntSideRdrLeObj7RdrObjVyStdDe FrntSideRdrLeObj7RelVx FrntSideRdrLeObj7RelVy;
SIG_GROUP_ 362 FrntSideRdrLeObj8 1 : FrntSideRdrLeObj8Heading FrntSideRdrLeObj8ObjBoxCenterLat FrntSideRdrLeObj8ObjBoxCenterLgt FrntSideRdrLeObj8ObservationHist FrntSideRdrLeObj8QualityBits FrntSideRdrLeObj8RdrObjAx FrntSideRdrLeObj8RdrObjAy FrntSideRdrLeObj8RdrObjBoxLength FrntSideRdrLeObj8RdrObjBoxWidth FrntSideRdrLeObj8RdrObjChks FrntSideRdrLeObj8RdrObjCntr FrntSideRdrLeObj8RdrObjCoastCnt FrntSideRdrLeObj8RdrObjConf FrntSideRdrLeObj8RdrObjDx FrntSideRdrLeObj8RdrObjDxStdDe FrntSideRdrLeObj8RdrObjDy FrntSideRdrLeObj8RdrObjDyStdDe FrntSideRdrLeObj8RdrObjElevnConf FrntSideRdrLeObj8RdrObjElevnSts FrntSideRdrLeObj8RdrObjID FrntSideRdrLeObj8RdrObjIsInFreeSpace FrntSideRdrLeObj8RdrObjMirrProblty FrntSideRdrLeObj8RdrObjMtnPat FrntSideRdrLeObj8RdrObjNotRealProblty FrntSideRdrLeObj8RdrObjStatyCnt FrntSideRdrLeObj8RdrObjTiAlv FrntSideRdrLeObj8RdrObjTrackSts FrntSideRdrLeObj8RdrObjTyp FrntSideRdrLeObj8RdrObjTypConfBike FrntSideRdrLeObj8RdrObjTypConfPed FrntSideRdrLeObj8RdrObjTypConfVeh FrntSideRdrLeObj8RdrObjUsedTracker FrntSideRdrLeObj8RdrObjVx FrntSideRdrLeObj8RdrObjVxStdDe FrntSideRdrLeObj8RdrObjVy FrntSideRdrLeObj8RdrObjVyStdDe FrntSideRdrLeObj8RelVx FrntSideRdrLeObj8RelVy;
SIG_GROUP_ 364 FrntSideRdrLeObj9 1 : FrntSideRdrLeObj9Heading FrntSideRdrLeObj9ObjBoxCenterLat FrntSideRdrLeObj9ObjBoxCenterLgt FrntSideRdrLeObj9ObservationHist FrntSideRdrLeObj9QualityBits FrntSideRdrLeObj9RdrObjAx FrntSideRdrLeObj9RdrObjAy FrntSideRdrLeObj9RdrObjBoxLength FrntSideRdrLeObj9RdrObjBoxWidth FrntSideRdrLeObj9RdrObjChks FrntSideRdrLeObj9RdrObjCntr FrntSideRdrLeObj9RdrObjCoastCnt FrntSideRdrLeObj9RdrObjConf FrntSideRdrLeObj9RdrObjDx FrntSideRdrLeObj9RdrObjDxStdDe FrntSideRdrLeObj9RdrObjDy FrntSideRdrLeObj9RdrObjDyStdDe FrntSideRdrLeObj9RdrObjElevnConf FrntSideRdrLeObj9RdrObjElevnSts FrntSideRdrLeObj9RdrObjID FrntSideRdrLeObj9RdrObjIsInFreeSpace FrntSideRdrLeObj9RdrObjMirrProblty FrntSideRdrLeObj9RdrObjMtnPat FrntSideRdrLeObj9RdrObjNotRealProblty FrntSideRdrLeObj9RdrObjStatyCnt FrntSideRdrLeObj9RdrObjTiAlv FrntSideRdrLeObj9RdrObjTrackSts FrntSideRdrLeObj9RdrObjTyp FrntSideRdrLeObj9RdrObjTypConfBike FrntSideRdrLeObj9RdrObjTypConfPed FrntSideRdrLeObj9RdrObjTypConfVeh FrntSideRdrLeObj9RdrObjUsedTracker FrntSideRdrLeObj9RdrObjVx FrntSideRdrLeObj9RdrObjVxStdDe FrntSideRdrLeObj9RdrObjVy FrntSideRdrLeObj9RdrObjVyStdDe FrntSideRdrLeObj9RelVx FrntSideRdrLeObj9RelVy;

// *************************************************************************** *
// *                                                                           *
// * Description:         CANDB File                                           *
// * Generated at:        2023-03-04 22:47                                     *
// * System:              SDB23100                                             *
// * Variant:             DX11_VDDM_CDD3_ADCU3                                 *
// * Network:             SafetyCANFD1                                         *
// *                                                                           *
// *************************************************************************** *
VERSION "SafetyCANFD1"

NS_ :

BS_ :

BU_ :  ASDM ETC FSRL FSRR

BO_ 332 FSRLSafetyCANFD1Frame15 : 64 FSRL
 SG_ FrntSideRdrLeDetn85_UB : 74|1@0+ (1,0) [0|1] "" ASDM
 SG_ FrntSideRdrLeDetn85RdrDetnAzi : 31|11@0+ (0.1,-90.0) [-90.0|90.0] "Deg" ASDM
 SG_ FrntSideRdrLeDetn85RdrDetnChks : 7|8@0+ (1.0,0.0) [0.0|255.0] "Unitless" ASDM
 SG_ FrntSideRdrLeDetn85RdrDetnCntr : 15|4@0+ (1.0,0.0) [0.0|15.0] "Unitless" ASDM
 SG_ FrntSideRdrLeDetn85RdrDetnConf : 71|7@0+ (1.0,0.0) [0.0|100.0] "%" ASDM
 SG_ FrntSideRdrLeDetn85RdrDetnElevn : 79|5@0+ (1.0,-15.0) [-15.0|15.0] "Deg" ASDM
 SG_ FrntSideRdrLeDetn85RdrDetnPwr : 8|9@0+ (0.1,0.0) [0.0|51.1] "dB" ASDM
 SG_ FrntSideRdrLeDetn85RdrDetnRng : 55|14@0+ (0.02,-1.0) [-1.0|200.0] "m" ASDM
 SG_ FrntSideRdrLeDetn85RdrDetnRngV : 36|13@0+ (0.02,-80.0) [-80.0|80.0] "m/s" ASDM
 SG_ FrntSideRdrLeDetn85RdrDetnSts : 11|2@0+ (1,0) [0|3] "" ASDM
 SG_ FrntSideRdrLeDetn86_UB : 154|1@0+ (1,0) [0|1] "" ASDM
 SG_ FrntSideRdrLeDetn86RdrDetnAzi : 119|11@0+ (0.1,-90.0) [-90.0|90.0] "Deg" ASDM
 SG_ FrntSideRdrLeDetn86RdrDetnChks : 87|8@0+ (1.0,0.0) [0.0|255.0] "Unitless" ASDM
 SG_ FrntSideRdrLeDetn86RdrDetnCntr : 95|4@0+ (1.0,0.0) [0.0|15.0] "Unitless" ASDM
 SG_ FrntSideRdrLeDetn86RdrDetnConf : 111|7@0+ (1.0,0.0) [0.0|100.0] "%" ASDM
 SG_ FrntSideRdrLeDetn86RdrDetnElevn : 159|5@0+ (1.0,-15.0) [-15.0|15.0] "Deg" ASDM
 SG_ FrntSideRdrLeDetn86RdrDetnPwr : 89|9@0+ (0.1,0.0) [0.0|51.1] "dB" ASDM
 SG_ FrntSideRdrLeDetn86RdrDetnRng : 143|14@0+ (0.02,-1.0) [-1.0|200.0] "m" ASDM
 SG_ FrntSideRdrLeDetn86RdrDetnRngV : 124|13@0+ (0.02,-80.0) [-80.0|80.0] "m/s" ASDM
 SG_ FrntSideRdrLeDetn86RdrDetnSts : 91|2@0+ (1,0) [0|3] "" ASDM
 SG_ FrntSideRdrLeDetn87_UB : 234|1@0+ (1,0) [0|1] "" ASDM
 SG_ FrntSideRdrLeDetn87RdrDetnAzi : 199|11@0+ (0.1,-90.0) [-90.0|90.0] "Deg" ASDM
 SG_ FrntSideRdrLeDetn87RdrDetnChks : 167|8@0+ (1.0,0.0) [0.0|255.0] "Unitless" ASDM
 SG_ FrntSideRdrLeDetn87RdrDetnCntr : 175|4@0+ (1.0,0.0) [0.0|15.0] "Unitless" ASDM
 SG_ FrntSideRdrLeDetn87RdrDetnConf : 191|7@0+ (1.0,0.0) [0.0|100.0] "%" ASDM
 SG_ FrntSideRdrLeDetn87RdrDetnElevn : 239|5@0+ (1.0,-15.0) [-15.0|15.0] "Deg" ASDM
 SG_ FrntSideRdrLeDetn87RdrDetnPwr : 169|9@0+ (0.1,0.0) [0.0|51.1] "dB" ASDM
 SG_ FrntSideRdrLeDetn87RdrDetnRng : 223|14@0+ (0.02,-1.0) [-1.0|200.0] "m" ASDM
 SG_ FrntSideRdrLeDetn87RdrDetnRngV : 204|13@0+ (0.02,-80.0) [-80.0|80.0] "m/s" ASDM
 SG_ FrntSideRdrLeDetn87RdrDetnSts : 171|2@0+ (1,0) [0|3] "" ASDM
 SG_ FrntSideRdrLeDetn88_UB : 314|1@0+ (1,0) [0|1] "" ASDM
 SG_ FrntSideRdrLeDetn88RdrDetnAzi : 287|11@0+ (0.1,-90.0) [-90.0|90.0] "Deg" ASDM
 SG_ FrntSideRdrLeDetn88RdrDetnChks : 247|8@0+ (1.0,0.0) [0.0|255.0] "Unitless" ASDM
 SG_ FrntSideRdrLeDetn88RdrDetnCntr : 255|4@0+ (1.0,0.0) [0.0|15.0] "Unitless" ASDM
 SG_ FrntSideRdrLeDetn88RdrDetnConf : 311|7@0+ (1.0,0.0) [0.0|100.0] "%" ASDM
 SG_ FrntSideRdrLeDetn88RdrDetnElevn : 319|5@0+ (1.0,-15.0) [-15.0|15.0] "Deg" ASDM
 SG_ FrntSideRdrLeDetn88RdrDetnPwr : 249|9@0+ (0.1,0.0) [0.0|51.1] "dB" ASDM
 SG_ FrntSideRdrLeDetn88RdrDetnRng : 271|14@0+ (0.02,-1.0) [-1.0|200.0] "m" ASDM
 SG_ FrntSideRdrLeDetn88RdrDetnRngV : 292|13@0+ (0.02,-80.0) [-80.0|80.0] "m/s" ASDM
 SG_ FrntSideRdrLeDetn88RdrDetnSts : 251|2@0+ (1,0) [0|3] "" ASDM
 SG_ FrntSideRdrLeDetn89_UB : 394|1@0+ (1,0) [0|1] "" ASDM
 SG_ FrntSideRdrLeDetn89RdrDetnAzi : 367|11@0+ (0.1,-90.0) [-90.0|90.0] "Deg" ASDM
 SG_ FrntSideRdrLeDetn89RdrDetnChks : 327|8@0+ (1.0,0.0) [0.0|255.0] "Unitless" ASDM
 SG_ FrntSideRdrLeDetn89RdrDetnCntr : 335|4@0+ (1.0,0.0) [0.0|15.0] "Unitless" ASDM
 SG_ FrntSideRdrLeDetn89RdrDetnConf : 391|7@0+ (1.0,0.0) [0.0|100.0] "%" ASDM
 SG_ FrntSideRdrLeDetn89RdrDetnElevn : 399|5@0+ (1.0,-15.0) [-15.0|15.0] "Deg" ASDM
 SG_ FrntSideRdrLeDetn89RdrDetnPwr : 329|9@0+ (0.1,0.0) [0.0|51.1] "dB" ASDM
 SG_ FrntSideRdrLeDetn89RdrDetnRng : 351|14@0+ (0.02,-1.0) [-1.0|200.0] "m" ASDM
 SG_ FrntSideRdrLeDetn89RdrDetnRngV : 372|13@0+ (0.02,-80.0) [-80.0|80.0] "m/s" ASDM
 SG_ FrntSideRdrLeDetn89RdrDetnSts : 331|2@0+ (1,0) [0|3] "" ASDM
 SG_ FrntSideRdrLeDetn90_UB : 474|1@0+ (1,0) [0|1] "" ASDM
 SG_ FrntSideRdrLeDetn90RdrDetnAzi : 447|11@0+ (0.1,-90.0) [-90.0|90.0] "Deg" ASDM
 SG_ FrntSideRdrLeDetn90RdrDetnChks : 407|8@0+ (1.0,0.0) [0.0|255.0] "Unitless" ASDM
 SG_ FrntSideRdrLeDetn90RdrDetnCntr : 415|4@0+ (1.0,0.0) [0.0|15.0] "Unitless" ASDM
 SG_ FrntSideRdrLeDetn90RdrDetnConf : 471|7@0+ (1.0,0.0) [0.0|100.0] "%" ASDM
 SG_ FrntSideRdrLeDetn90RdrDetnElevn : 479|5@0+ (1.0,-15.0) [-15.0|15.0] "Deg" ASDM
 SG_ FrntSideRdrLeDetn90RdrDetnPwr : 409|9@0+ (0.1,0.0) [0.0|51.1] "dB" ASDM
 SG_ FrntSideRdrLeDetn90RdrDetnRng : 431|14@0+ (0.02,-1.0) [-1.0|200.0] "m" ASDM
 SG_ FrntSideRdrLeDetn90RdrDetnRngV : 452|13@0+ (0.02,-80.0) [-80.0|80.0] "m/s" ASDM
 SG_ FrntSideRdrLeDetn90RdrDetnSts : 411|2@0+ (1,0) [0|3] "" ASDM

BO_ 334 FSRLSafetyCANFD1Frame16 : 64 FSRL
 SG_ FrntSideRdrLeDetn91_UB : 74|1@0+ (1,0) [0|1] "" ASDM
 SG_ FrntSideRdrLeDetn91RdrDetnAzi : 31|11@0+ (0.1,-90.0) [-90.0|90.0] "Deg" ASDM
 SG_ FrntSideRdrLeDetn91RdrDetnChks : 7|8@0+ (1.0,0.0) [0.0|255.0] "Unitless" ASDM
 SG_ FrntSideRdrLeDetn91RdrDetnCntr : 15|4@0+ (1.0,0.0) [0.0|15.0] "Unitless" ASDM
 SG_ FrntSideRdrLeDetn91RdrDetnConf : 71|7@0+ (1.0,0.0) [0.0|100.0] "%" ASDM
 SG_ FrntSideRdrLeDetn91RdrDetnElevn : 79|5@0+ (1.0,-15.0) [-15.0|15.0] "Deg" ASDM
 SG_ FrntSideRdrLeDetn91RdrDetnPwr : 8|9@0+ (0.1,0.0) [0.0|51.1] "dB" ASDM
 SG_ FrntSideRdrLeDetn91RdrDetnRng : 55|14@0+ (0.02,-1.0) [-1.0|200.0] "m" ASDM
 SG_ FrntSideRdrLeDetn91RdrDetnRngV : 36|13@0+ (0.02,-80.0) [-80.0|80.0] "m/s" ASDM
 SG_ FrntSideRdrLeDetn91RdrDetnSts : 11|2@0+ (1,0) [0|3] "" ASDM
 SG_ FrntSideRdrLeDetn92_UB : 154|1@0+ (1,0) [0|1] "" ASDM
 SG_ FrntSideRdrLeDetn92RdrDetnAzi : 119|11@0+ (0.1,-90.0) [-90.0|90.0] "Deg" ASDM
 SG_ FrntSideRdrLeDetn92RdrDetnChks : 87|8@0+ (1.0,0.0) [0.0|255.0] "Unitless" ASDM
 SG_ FrntSideRdrLeDetn92RdrDetnCntr : 95|4@0+ (1.0,0.0) [0.0|15.0] "Unitless" ASDM
 SG_ FrntSideRdrLeDetn92RdrDetnConf : 111|7@0+ (1.0,0.0) [0.0|100.0] "%" ASDM
 SG_ FrntSideRdrLeDetn92RdrDetnElevn : 159|5@0+ (1.0,-15.0) [-15.0|15.0] "Deg" ASDM
 SG_ FrntSideRdrLeDetn92RdrDetnPwr : 89|9@0+ (0.1,0.0) [0.0|51.1] "dB" ASDM
 SG_ FrntSideRdrLeDetn92RdrDetnRng : 143|14@0+ (0.02,-1.0) [-1.0|200.0] "m" ASDM
 SG_ FrntSideRdrLeDetn92RdrDetnRngV : 124|13@0+ (0.02,-80.0) [-80.0|80.0] "m/s" ASDM
 SG_ FrntSideRdrLeDetn92RdrDetnSts : 91|2@0+ (1,0) [0|3] "" ASDM
 SG_ FrntSideRdrLeDetn93_UB : 234|1@0+ (1,0) [0|1] "" ASDM
 SG_ FrntSideRdrLeDetn93RdrDetnAzi : 199|11@0+ (0.1,-90.0) [-90.0|90.0] "Deg" ASDM
 SG_ FrntSideRdrLeDetn93RdrDetnChks : 167|8@0+ (1.0,0.0) [0.0|255.0] "Unitless" ASDM
 SG_ FrntSideRdrLeDetn93RdrDetnCntr : 175|4@0+ (1.0,0.0) [0.0|15.0] "Unitless" ASDM
 SG_ FrntSideRdrLeDetn93RdrDetnConf : 191|7@0+ (1.0,0.0) [0.0|100.0] "%" ASDM
 SG_ FrntSideRdrLeDetn93RdrDetnElevn : 239|5@0+ (1.0,-15.0) [-15.0|15.0] "Deg" ASDM
 SG_ FrntSideRdrLeDetn93RdrDetnPwr : 169|9@0+ (0.1,0.0) [0.0|51.1] "dB" ASDM
 SG_ FrntSideRdrLeDetn93RdrDetnRng : 223|14@0+ (0.02,-1.0) [-1.0|200.0] "m" ASDM
 SG_ FrntSideRdrLeDetn93RdrDetnRngV : 204|13@0+ (0.02,-80.0) [-80.0|80.0] "m/s" ASDM
 SG_ FrntSideRdrLeDetn93RdrDetnSts : 171|2@0+ (1,0) [0|3] "" ASDM
 SG_ FrntSideRdrLeDetn94_UB : 314|1@0+ (1,0) [0|1] "" ASDM
 SG_ FrntSideRdrLeDetn94RdrDetnAzi : 287|11@0+ (0.1,-90.0) [-90.0|90.0] "Deg" ASDM
 SG_ FrntSideRdrLeDetn94RdrDetnChks : 247|8@0+ (1.0,0.0) [0.0|255.0] "Unitless" ASDM
 SG_ FrntSideRdrLeDetn94RdrDetnCntr : 255|4@0+ (1.0,0.0) [0.0|15.0] "Unitless" ASDM
 SG_ FrntSideRdrLeDetn94RdrDetnConf : 311|7@0+ (1.0,0.0) [0.0|100.0] "%" ASDM
 SG_ FrntSideRdrLeDetn94RdrDetnElevn : 319|5@0+ (1.0,-15.0) [-15.0|15.0] "Deg" ASDM
 SG_ FrntSideRdrLeDetn94RdrDetnPwr : 249|9@0+ (0.1,0.0) [0.0|51.1] "dB" ASDM
 SG_ FrntSideRdrLeDetn94RdrDetnRng : 271|14@0+ (0.02,-1.0) [-1.0|200.0] "m" ASDM
 SG_ FrntSideRdrLeDetn94RdrDetnRngV : 292|13@0+ (0.02,-80.0) [-80.0|80.0] "m/s" ASDM
 SG_ FrntSideRdrLeDetn94RdrDetnSts : 251|2@0+ (1,0) [0|3] "" ASDM
 SG_ FrntSideRdrLeDetn95_UB : 394|1@0+ (1,0) [0|1] "" ASDM
 SG_ FrntSideRdrLeDetn95RdrDetnAzi : 367|11@0+ (0.1,-90.0) [-90.0|90.0] "Deg" ASDM
 SG_ FrntSideRdrLeDetn95RdrDetnChks : 327|8@0+ (1.0,0.0) [0.0|255.0] "Unitless" ASDM
 SG_ FrntSideRdrLeDetn95RdrDetnCntr : 335|4@0+ (1.0,0.0) [0.0|15.0] "Unitless" ASDM
 SG_ FrntSideRdrLeDetn95RdrDetnConf : 391|7@0+ (1.0,0.0) [0.0|100.0] "%" ASDM
 SG_ FrntSideRdrLeDetn95RdrDetnElevn : 399|5@0+ (1.0,-15.0) [-15.0|15.0] "Deg" ASDM
 SG_ FrntSideRdrLeDetn95RdrDetnPwr : 329|9@0+ (0.1,0.0) [0.0|51.1] "dB" ASDM
 SG_ FrntSideRdrLeDetn95RdrDetnRng : 351|14@0+ (0.02,-1.0) [-1.0|200.0] "m" ASDM
 SG_ FrntSideRdrLeDetn95RdrDetnRngV : 372|13@0+ (0.02,-80.0) [-80.0|80.0] "m/s" ASDM
 SG_ FrntSideRdrLeDetn95RdrDetnSts : 331|2@0+ (1,0) [0|3] "" ASDM
 SG_ FrntSideRdrLeDetn96_UB : 474|1@0+ (1,0) [0|1] "" ASDM
 SG_ FrntSideRdrLeDetn96RdrDetnAzi : 447|11@0+ (0.1,-90.0) [-90.0|90.0] "Deg" ASDM
 SG_ FrntSideRdrLeDetn96RdrDetnChks : 407|8@0+ (1.0,0.0) [0.0|255.0] "Unitless" ASDM
 SG_ FrntSideRdrLeDetn96RdrDetnCntr : 415|4@0+ (1.0,0.0) [0.0|15.0] "Unitless" ASDM
 SG_ FrntSideRdrLeDetn96RdrDetnConf : 471|7@0+ (1.0,0.0) [0.0|100.0] "%" ASDM
 SG_ FrntSideRdrLeDetn96RdrDetnElevn : 479|5@0+ (1.0,-15.0) [-15.0|15.0] "Deg" ASDM
 SG_ FrntSideRdrLeDetn96RdrDetnPwr : 409|9@0+ (0.1,0.0) [0.0|51.1] "dB" ASDM
 SG_ FrntSideRdrLeDetn96RdrDetnRng : 431|14@0+ (0.02,-1.0) [-1.0|200.0] "m" ASDM
 SG_ FrntSideRdrLeDetn96RdrDetnRngV : 452|13@0+ (0.02,-80.0) [-80.0|80.0] "m/s" ASDM
 SG_ FrntSideRdrLeDetn96RdrDetnSts : 411|2@0+ (1,0) [0|3] "" ASDM

BO_ 336 FSRLSafetyCANFD1Frame17 : 64 FSRL
 SG_ FrntSideRdrLeDetn100_UB : 314|1@0+ (1,0) [0|1] "" ASDM
 SG_ FrntSideRdrLeDetn100RdrDetnAzi : 287|11@0+ (0.1,-90.0) [-90.0|90.0] "Deg" ASDM
 SG_ FrntSideRdrLeDetn100RdrDetnChks : 247|8@0+ (1.0,0.0) [0.0|255.0] "Unitless" ASDM
 SG_ FrntSideRdrLeDetn100RdrDetnCntr : 255|4@0+ (1.0,0.0) [0.0|15.0] "Unitless" ASDM
 SG_ FrntSideRdrLeDetn100RdrDetnConf : 311|7@0+ (1.0,0.0) [0.0|100.0] "%" ASDM
 SG_ FrntSideRdrLeDetn100RdrDetnElevn : 319|5@0+ (1.0,-15.0) [-15.0|15.0] "Deg" ASDM
 SG_ FrntSideRdrLeDetn100RdrDetnPwr : 249|9@0+ (0.1,0.0) [0.0|51.1] "dB" ASDM
 SG_ FrntSideRdrLeDetn100RdrDetnRng : 271|14@0+ (0.02,-1.0) [-1.0|200.0] "m" ASDM
 SG_ FrntSideRdrLeDetn100RdrDetnRngV : 292|13@0+ (0.02,-80.0) [-80.0|80.0] "m/s" ASDM
 SG_ FrntSideRdrLeDetn100RdrDetnSts : 251|2@0+ (1,0) [0|3] "" ASDM
 SG_ FrntSideRdrLeDetn101_UB : 394|1@0+ (1,0) [0|1] "" ASDM
 SG_ FrntSideRdrLeDetn101RdrDetnAzi : 367|11@0+ (0.1,-90.0) [-90.0|90.0] "Deg" ASDM
 SG_ FrntSideRdrLeDetn101RdrDetnChks : 327|8@0+ (1.0,0.0) [0.0|255.0] "Unitless" ASDM
 SG_ FrntSideRdrLeDetn101RdrDetnCntr : 335|4@0+ (1.0,0.0) [0.0|15.0] "Unitless" ASDM
 SG_ FrntSideRdrLeDetn101RdrDetnConf : 391|7@0+ (1.0,0.0) [0.0|100.0] "%" ASDM
 SG_ FrntSideRdrLeDetn101RdrDetnElevn : 399|5@0+ (1.0,-15.0) [-15.0|15.0] "Deg" ASDM
 SG_ FrntSideRdrLeDetn101RdrDetnPwr : 329|9@0+ (0.1,0.0) [0.0|51.1] "dB" ASDM
 SG_ FrntSideRdrLeDetn101RdrDetnRng : 351|14@0+ (0.02,-1.0) [-1.0|200.0] "m" ASDM
 SG_ FrntSideRdrLeDetn101RdrDetnRngV : 372|13@0+ (0.02,-80.0) [-80.0|80.0] "m/s" ASDM
 SG_ FrntSideRdrLeDetn101RdrDetnSts : 331|2@0+ (1,0) [0|3] "" ASDM
 SG_ FrntSideRdrLeDetn102_UB : 474|1@0+ (1,0) [0|1] "" ASDM
 SG_ FrntSideRdrLeDetn102RdrDetnAzi : 447|11@0+ (0.1,-90.0) [-90.0|90.0] "Deg" ASDM
 SG_ FrntSideRdrLeDetn102RdrDetnChks : 407|8@0+ (1.0,0.0) [0.0|255.0] "Unitless" ASDM
 SG_ FrntSideRdrLeDetn102RdrDetnCntr : 415|4@0+ (1.0,0.0) [0.0|15.0] "Unitless" ASDM
 SG_ FrntSideRdrLeDetn102RdrDetnConf : 471|7@0+ (1.0,0.0) [0.0|100.0] "%" ASDM
 SG_ FrntSideRdrLeDetn102RdrDetnElevn : 479|5@0+ (1.0,-15.0) [-15.0|15.0] "Deg" ASDM
 SG_ FrntSideRdrLeDetn102RdrDetnPwr : 409|9@0+ (0.1,0.0) [0.0|51.1] "dB" ASDM
 SG_ FrntSideRdrLeDetn102RdrDetnRng : 431|14@0+ (0.02,-1.0) [-1.0|200.0] "m" ASDM
 SG_ FrntSideRdrLeDetn102RdrDetnRngV : 452|13@0+ (0.02,-80.0) [-80.0|80.0] "m/s" ASDM
 SG_ FrntSideRdrLeDetn102RdrDetnSts : 411|2@0+ (1,0) [0|3] "" ASDM
 SG_ FrntSideRdrLeDetn97_UB : 74|1@0+ (1,0) [0|1] "" ASDM
 SG_ FrntSideRdrLeDetn97RdrDetnAzi : 31|11@0+ (0.1,-90.0) [-90.0|90.0] "Deg" ASDM
 SG_ FrntSideRdrLeDetn97RdrDetnChks : 7|8@0+ (1.0,0.0) [0.0|255.0] "Unitless" ASDM
 SG_ FrntSideRdrLeDetn97RdrDetnCntr : 15|4@0+ (1.0,0.0) [0.0|15.0] "Unitless" ASDM
 SG_ FrntSideRdrLeDetn97RdrDetnConf : 71|7@0+ (1.0,0.0) [0.0|100.0] "%" ASDM
 SG_ FrntSideRdrLeDetn97RdrDetnElevn : 79|5@0+ (1.0,-15.0) [-15.0|15.0] "Deg" ASDM
 SG_ FrntSideRdrLeDetn97RdrDetnPwr : 8|9@0+ (0.1,0.0) [0.0|51.1] "dB" ASDM
 SG_ FrntSideRdrLeDetn97RdrDetnRng : 55|14@0+ (0.02,-1.0) [-1.0|200.0] "m" ASDM
 SG_ FrntSideRdrLeDetn97RdrDetnRngV : 36|13@0+ (0.02,-80.0) [-80.0|80.0] "m/s" ASDM
 SG_ FrntSideRdrLeDetn97RdrDetnSts : 11|2@0+ (1,0) [0|3] "" ASDM
 SG_ FrntSideRdrLeDetn98_UB : 154|1@0+ (1,0) [0|1] "" ASDM
 SG_ FrntSideRdrLeDetn98RdrDetnAzi : 119|11@0+ (0.1,-90.0) [-90.0|90.0] "Deg" ASDM
 SG_ FrntSideRdrLeDetn98RdrDetnChks : 87|8@0+ (1.0,0.0) [0.0|255.0] "Unitless" ASDM
 SG_ FrntSideRdrLeDetn98RdrDetnCntr : 95|4@0+ (1.0,0.0) [0.0|15.0] "Unitless" ASDM
 SG_ FrntSideRdrLeDetn98RdrDetnConf : 111|7@0+ (1.0,0.0) [0.0|100.0] "%" ASDM
 SG_ FrntSideRdrLeDetn98RdrDetnElevn : 159|5@0+ (1.0,-15.0) [-15.0|15.0] "Deg" ASDM
 SG_ FrntSideRdrLeDetn98RdrDetnPwr : 89|9@0+ (0.1,0.0) [0.0|51.1] "dB" ASDM
 SG_ FrntSideRdrLeDetn98RdrDetnRng : 143|14@0+ (0.02,-1.0) [-1.0|200.0] "m" ASDM
 SG_ FrntSideRdrLeDetn98RdrDetnRngV : 124|13@0+ (0.02,-80.0) [-80.0|80.0] "m/s" ASDM
 SG_ FrntSideRdrLeDetn98RdrDetnSts : 91|2@0+ (1,0) [0|3] "" ASDM
 SG_ FrntSideRdrLeDetn99_UB : 234|1@0+ (1,0) [0|1] "" ASDM
 SG_ FrntSideRdrLeDetn99RdrDetnAzi : 199|11@0+ (0.1,-90.0) [-90.0|90.0] "Deg" ASDM
 SG_ FrntSideRdrLeDetn99RdrDetnChks : 167|8@0+ (1.0,0.0) [0.0|255.0] "Unitless" ASDM
 SG_ FrntSideRdrLeDetn99RdrDetnCntr : 175|4@0+ (1.0,0.0) [0.0|15.0] "Unitless" ASDM
 SG_ FrntSideRdrLeDetn99RdrDetnConf : 191|7@0+ (1.0,0.0) [0.0|100.0] "%" ASDM
 SG_ FrntSideRdrLeDetn99RdrDetnElevn : 239|5@0+ (1.0,-15.0) [-15.0|15.0] "Deg" ASDM
 SG_ FrntSideRdrLeDetn99RdrDetnPwr : 169|9@0+ (0.1,0.0) [0.0|51.1] "dB" ASDM
 SG_ FrntSideRdrLeDetn99RdrDetnRng : 223|14@0+ (0.02,-1.0) [-1.0|200.0] "m" ASDM
 SG_ FrntSideRdrLeDetn99RdrDetnRngV : 204|13@0+ (0.02,-80.0) [-80.0|80.0] "m/s" ASDM
 SG_ FrntSideRdrLeDetn99RdrDetnSts : 171|2@0+ (1,0) [0|3] "" ASDM

BO_ 338 FSRLSafetyCANFD1Frame18 : 64 FSRL
 SG_ FrntSideRdrLeDetn103_UB : 74|1@0+ (1,0) [0|1] "" ASDM
 SG_ FrntSideRdrLeDetn103RdrDetnAzi : 31|11@0+ (0.1,-90.0) [-90.0|90.0] "Deg" ASDM
 SG_ FrntSideRdrLeDetn103RdrDetnChks : 7|8@0+ (1.0,0.0) [0.0|255.0] "Unitless" ASDM
 SG_ FrntSideRdrLeDetn103RdrDetnCntr : 15|4@0+ (1.0,0.0) [0.0|15.0] "Unitless" ASDM
 SG_ FrntSideRdrLeDetn103RdrDetnConf : 71|7@0+ (1.0,0.0) [0.0|100.0] "%" ASDM
 SG_ FrntSideRdrLeDetn103RdrDetnElevn : 79|5@0+ (1.0,-15.0) [-15.0|15.0] "Deg" ASDM
 SG_ FrntSideRdrLeDetn103RdrDetnPwr : 8|9@0+ (0.1,0.0) [0.0|51.1] "dB" ASDM
 SG_ FrntSideRdrLeDetn103RdrDetnRng : 55|14@0+ (0.02,-1.0) [-1.0|200.0] "m" ASDM
 SG_ FrntSideRdrLeDetn103RdrDetnRngV : 36|13@0+ (0.02,-80.0) [-80.0|80.0] "m/s" ASDM
 SG_ FrntSideRdrLeDetn103RdrDetnSts : 11|2@0+ (1,0) [0|3] "" ASDM
 SG_ FrntSideRdrLeDetn104_UB : 154|1@0+ (1,0) [0|1] "" ASDM
 SG_ FrntSideRdrLeDetn104RdrDetnAzi : 119|11@0+ (0.1,-90.0) [-90.0|90.0] "Deg" ASDM
 SG_ FrntSideRdrLeDetn104RdrDetnChks : 87|8@0+ (1.0,0.0) [0.0|255.0] "Unitless" ASDM
 SG_ FrntSideRdrLeDetn104RdrDetnCntr : 95|4@0+ (1.0,0.0) [0.0|15.0] "Unitless" ASDM
 SG_ FrntSideRdrLeDetn104RdrDetnConf : 111|7@0+ (1.0,0.0) [0.0|100.0] "%" ASDM
 SG_ FrntSideRdrLeDetn104RdrDetnElevn : 159|5@0+ (1.0,-15.0) [-15.0|15.0] "Deg" ASDM
 SG_ FrntSideRdrLeDetn104RdrDetnPwr : 89|9@0+ (0.1,0.0) [0.0|51.1] "dB" ASDM
 SG_ FrntSideRdrLeDetn104RdrDetnRng : 143|14@0+ (0.02,-1.0) [-1.0|200.0] "m" ASDM
 SG_ FrntSideRdrLeDetn104RdrDetnRngV : 124|13@0+ (0.02,-80.0) [-80.0|80.0] "m/s" ASDM
 SG_ FrntSideRdrLeDetn104RdrDetnSts : 91|2@0+ (1,0) [0|3] "" ASDM
 SG_ FrntSideRdrLeDetn105_UB : 234|1@0+ (1,0) [0|1] "" ASDM
 SG_ FrntSideRdrLeDetn105RdrDetnAzi : 199|11@0+ (0.1,-90.0) [-90.0|90.0] "Deg" ASDM
 SG_ FrntSideRdrLeDetn105RdrDetnChks : 167|8@0+ (1.0,0.0) [0.0|255.0] "Unitless" ASDM
 SG_ FrntSideRdrLeDetn105RdrDetnCntr : 175|4@0+ (1.0,0.0) [0.0|15.0] "Unitless" ASDM
 SG_ FrntSideRdrLeDetn105RdrDetnConf : 191|7@0+ (1.0,0.0) [0.0|100.0] "%" ASDM
 SG_ FrntSideRdrLeDetn105RdrDetnElevn : 239|5@0+ (1.0,-15.0) [-15.0|15.0] "Deg" ASDM
 SG_ FrntSideRdrLeDetn105RdrDetnPwr : 169|9@0+ (0.1,0.0) [0.0|51.1] "dB" ASDM
 SG_ FrntSideRdrLeDetn105RdrDetnRng : 223|14@0+ (0.02,-1.0) [-1.0|200.0] "m" ASDM
 SG_ FrntSideRdrLeDetn105RdrDetnRngV : 204|13@0+ (0.02,-80.0) [-80.0|80.0] "m/s" ASDM
 SG_ FrntSideRdrLeDetn105RdrDetnSts : 171|2@0+ (1,0) [0|3] "" ASDM
 SG_ FrntSideRdrLeDetn106_UB : 314|1@0+ (1,0) [0|1] "" ASDM
 SG_ FrntSideRdrLeDetn106RdrDetnAzi : 287|11@0+ (0.1,-90.0) [-90.0|90.0] "Deg" ASDM
 SG_ FrntSideRdrLeDetn106RdrDetnChks : 247|8@0+ (1.0,0.0) [0.0|255.0] "Unitless" ASDM
 SG_ FrntSideRdrLeDetn106RdrDetnCntr : 255|4@0+ (1.0,0.0) [0.0|15.0] "Unitless" ASDM
 SG_ FrntSideRdrLeDetn106RdrDetnConf : 311|7@0+ (1.0,0.0) [0.0|100.0] "%" ASDM
 SG_ FrntSideRdrLeDetn106RdrDetnElevn : 319|5@0+ (1.0,-15.0) [-15.0|15.0] "Deg" ASDM
 SG_ FrntSideRdrLeDetn106RdrDetnPwr : 249|9@0+ (0.1,0.0) [0.0|51.1] "dB" ASDM
 SG_ FrntSideRdrLeDetn106RdrDetnRng : 271|14@0+ (0.02,-1.0) [-1.0|200.0] "m" ASDM
 SG_ FrntSideRdrLeDetn106RdrDetnRngV : 292|13@0+ (0.02,-80.0) [-80.0|80.0] "m/s" ASDM
 SG_ FrntSideRdrLeDetn106RdrDetnSts : 251|2@0+ (1,0) [0|3] "" ASDM
 SG_ FrntSideRdrLeDetn107_UB : 394|1@0+ (1,0) [0|1] "" ASDM
 SG_ FrntSideRdrLeDetn107RdrDetnAzi : 367|11@0+ (0.1,-90.0) [-90.0|90.0] "Deg" ASDM
 SG_ FrntSideRdrLeDetn107RdrDetnChks : 327|8@0+ (1.0,0.0) [0.0|255.0] "Unitless" ASDM
 SG_ FrntSideRdrLeDetn107RdrDetnCntr : 335|4@0+ (1.0,0.0) [0.0|15.0] "Unitless" ASDM
 SG_ FrntSideRdrLeDetn107RdrDetnConf : 391|7@0+ (1.0,0.0) [0.0|100.0] "%" ASDM
 SG_ FrntSideRdrLeDetn107RdrDetnElevn : 399|5@0+ (1.0,-15.0) [-15.0|15.0] "Deg" ASDM
 SG_ FrntSideRdrLeDetn107RdrDetnPwr : 329|9@0+ (0.1,0.0) [0.0|51.1] "dB" ASDM
 SG_ FrntSideRdrLeDetn107RdrDetnRng : 351|14@0+ (0.02,-1.0) [-1.0|200.0] "m" ASDM
 SG_ FrntSideRdrLeDetn107RdrDetnRngV : 372|13@0+ (0.02,-80.0) [-80.0|80.0] "m/s" ASDM
 SG_ FrntSideRdrLeDetn107RdrDetnSts : 331|2@0+ (1,0) [0|3] "" ASDM
 SG_ FrntSideRdrLeDetn108_UB : 474|1@0+ (1,0) [0|1] "" ASDM
 SG_ FrntSideRdrLeDetn108RdrDetnAzi : 447|11@0+ (0.1,-90.0) [-90.0|90.0] "Deg" ASDM
 SG_ FrntSideRdrLeDetn108RdrDetnChks : 407|8@0+ (1.0,0.0) [0.0|255.0] "Unitless" ASDM
 SG_ FrntSideRdrLeDetn108RdrDetnCntr : 415|4@0+ (1.0,0.0) [0.0|15.0] "Unitless" ASDM
 SG_ FrntSideRdrLeDetn108RdrDetnConf : 471|7@0+ (1.0,0.0) [0.0|100.0] "%" ASDM
 SG_ FrntSideRdrLeDetn108RdrDetnElevn : 479|5@0+ (1.0,-15.0) [-15.0|15.0] "Deg" ASDM
 SG_ FrntSideRdrLeDetn108RdrDetnPwr : 409|9@0+ (0.1,0.0) [0.0|51.1] "dB" ASDM
 SG_ FrntSideRdrLeDetn108RdrDetnRng : 431|14@0+ (0.02,-1.0) [-1.0|200.0] "m" ASDM
 SG_ FrntSideRdrLeDetn108RdrDetnRngV : 452|13@0+ (0.02,-80.0) [-80.0|80.0] "m/s" ASDM
 SG_ FrntSideRdrLeDetn108RdrDetnSts : 411|2@0+ (1,0) [0|3] "" ASDM

BO_ 340 FSRLSafetyCANFD1Frame19 : 64 FSRL
 SG_ FrntSideRdrLeDetn109_UB : 74|1@0+ (1,0) [0|1] "" ASDM
 SG_ FrntSideRdrLeDetn109RdrDetnAzi : 31|11@0+ (0.1,-90.0) [-90.0|90.0] "Deg" ASDM
 SG_ FrntSideRdrLeDetn109RdrDetnChks : 7|8@0+ (1.0,0.0) [0.0|255.0] "Unitless" ASDM
 SG_ FrntSideRdrLeDetn109RdrDetnCntr : 15|4@0+ (1.0,0.0) [0.0|15.0] "Unitless" ASDM
 SG_ FrntSideRdrLeDetn109RdrDetnConf : 71|7@0+ (1.0,0.0) [0.0|100.0] "%" ASDM
 SG_ FrntSideRdrLeDetn109RdrDetnElevn : 79|5@0+ (1.0,-15.0) [-15.0|15.0] "Deg" ASDM
 SG_ FrntSideRdrLeDetn109RdrDetnPwr : 8|9@0+ (0.1,0.0) [0.0|51.1] "dB" ASDM
 SG_ FrntSideRdrLeDetn109RdrDetnRng : 55|14@0+ (0.02,-1.0) [-1.0|200.0] "m" ASDM
 SG_ FrntSideRdrLeDetn109RdrDetnRngV : 36|13@0+ (0.02,-80.0) [-80.0|80.0] "m/s" ASDM
 SG_ FrntSideRdrLeDetn109RdrDetnSts : 11|2@0+ (1,0) [0|3] "" ASDM
 SG_ FrntSideRdrLeDetn110_UB : 154|1@0+ (1,0) [0|1] "" ASDM
 SG_ FrntSideRdrLeDetn110RdrDetnAzi : 119|11@0+ (0.1,-90.0) [-90.0|90.0] "Deg" ASDM
 SG_ FrntSideRdrLeDetn110RdrDetnChks : 87|8@0+ (1.0,0.0) [0.0|255.0] "Unitless" ASDM
 SG_ FrntSideRdrLeDetn110RdrDetnCntr : 95|4@0+ (1.0,0.0) [0.0|15.0] "Unitless" ASDM
 SG_ FrntSideRdrLeDetn110RdrDetnConf : 111|7@0+ (1.0,0.0) [0.0|100.0] "%" ASDM
 SG_ FrntSideRdrLeDetn110RdrDetnElevn : 159|5@0+ (1.0,-15.0) [-15.0|15.0] "Deg" ASDM
 SG_ FrntSideRdrLeDetn110RdrDetnPwr : 89|9@0+ (0.1,0.0) [0.0|51.1] "dB" ASDM
 SG_ FrntSideRdrLeDetn110RdrDetnRng : 143|14@0+ (0.02,-1.0) [-1.0|200.0] "m" ASDM
 SG_ FrntSideRdrLeDetn110RdrDetnRngV : 124|13@0+ (0.02,-80.0) [-80.0|80.0] "m/s" ASDM
 SG_ FrntSideRdrLeDetn110RdrDetnSts : 91|2@0+ (1,0) [0|3] "" ASDM
 SG_ FrntSideRdrLeDetn111_UB : 234|1@0+ (1,0) [0|1] "" ASDM
 SG_ FrntSideRdrLeDetn111RdrDetnAzi : 199|11@0+ (0.1,-90.0) [-90.0|90.0] "Deg" ASDM
 SG_ FrntSideRdrLeDetn111RdrDetnChks : 167|8@0+ (1.0,0.0) [0.0|255.0] "Unitless" ASDM
 SG_ FrntSideRdrLeDetn111RdrDetnCntr : 175|4@0+ (1.0,0.0) [0.0|15.0] "Unitless" ASDM
 SG_ FrntSideRdrLeDetn111RdrDetnConf : 191|7@0+ (1.0,0.0) [0.0|100.0] "%" ASDM
 SG_ FrntSideRdrLeDetn111RdrDetnElevn : 239|5@0+ (1.0,-15.0) [-15.0|15.0] "Deg" ASDM
 SG_ FrntSideRdrLeDetn111RdrDetnPwr : 169|9@0+ (0.1,0.0) [0.0|51.1] "dB" ASDM
 SG_ FrntSideRdrLeDetn111RdrDetnRng : 223|14@0+ (0.02,-1.0) [-1.0|200.0] "m" ASDM
 SG_ FrntSideRdrLeDetn111RdrDetnRngV : 204|13@0+ (0.02,-80.0) [-80.0|80.0] "m/s" ASDM
 SG_ FrntSideRdrLeDetn111RdrDetnSts : 171|2@0+ (1,0) [0|3] "" ASDM
 SG_ FrntSideRdrLeDetn112_UB : 314|1@0+ (1,0) [0|1] "" ASDM
 SG_ FrntSideRdrLeDetn112RdrDetnAzi : 287|11@0+ (0.1,-90.0) [-90.0|90.0] "Deg" ASDM
 SG_ FrntSideRdrLeDetn112RdrDetnChks : 247|8@0+ (1.0,0.0) [0.0|255.0] "Unitless" ASDM
 SG_ FrntSideRdrLeDetn112RdrDetnCntr : 255|4@0+ (1.0,0.0) [0.0|15.0] "Unitless" ASDM
 SG_ FrntSideRdrLeDetn112RdrDetnConf : 311|7@0+ (1.0,0.0) [0.0|100.0] "%" ASDM
 SG_ FrntSideRdrLeDetn112RdrDetnElevn : 319|5@0+ (1.0,-15.0) [-15.0|15.0] "Deg" ASDM
 SG_ FrntSideRdrLeDetn112RdrDetnPwr : 249|9@0+ (0.1,0.0) [0.0|51.1] "dB" ASDM
 SG_ FrntSideRdrLeDetn112RdrDetnRng : 271|14@0+ (0.02,-1.0) [-1.0|200.0] "m" ASDM
 SG_ FrntSideRdrLeDetn112RdrDetnRngV : 292|13@0+ (0.02,-80.0) [-80.0|80.0] "m/s" ASDM
 SG_ FrntSideRdrLeDetn112RdrDetnSts : 251|2@0+ (1,0) [0|3] "" ASDM
 SG_ FrntSideRdrLeDetn113_UB : 394|1@0+ (1,0) [0|1] "" ASDM
 SG_ FrntSideRdrLeDetn113RdrDetnAzi : 367|11@0+ (0.1,-90.0) [-90.0|90.0] "Deg" ASDM
 SG_ FrntSideRdrLeDetn113RdrDetnChks : 327|8@0+ (1.0,0.0) [0.0|255.0] "Unitless" ASDM
 SG_ FrntSideRdrLeDetn113RdrDetnCntr : 335|4@0+ (1.0,0.0) [0.0|15.0] "Unitless" ASDM
 SG_ FrntSideRdrLeDetn113RdrDetnConf : 391|7@0+ (1.0,0.0) [0.0|100.0] "%" ASDM
 SG_ FrntSideRdrLeDetn113RdrDetnElevn : 399|5@0+ (1.0,-15.0) [-15.0|15.0] "Deg" ASDM
 SG_ FrntSideRdrLeDetn113RdrDetnPwr : 329|9@0+ (0.1,0.0) [0.0|51.1] "dB" ASDM
 SG_ FrntSideRdrLeDetn113RdrDetnRng : 351|14@0+ (0.02,-1.0) [-1.0|200.0] "m" ASDM
 SG_ FrntSideRdrLeDetn113RdrDetnRngV : 372|13@0+ (0.02,-80.0) [-80.0|80.0] "m/s" ASDM
 SG_ FrntSideRdrLeDetn113RdrDetnSts : 331|2@0+ (1,0) [0|3] "" ASDM
 SG_ FrntSideRdrLeDetn114_UB : 474|1@0+ (1,0) [0|1] "" ASDM
 SG_ FrntSideRdrLeDetn114RdrDetnAzi : 447|11@0+ (0.1,-90.0) [-90.0|90.0] "Deg" ASDM
 SG_ FrntSideRdrLeDetn114RdrDetnChks : 407|8@0+ (1.0,0.0) [0.0|255.0] "Unitless" ASDM
 SG_ FrntSideRdrLeDetn114RdrDetnCntr : 415|4@0+ (1.0,0.0) [0.0|15.0] "Unitless" ASDM
 SG_ FrntSideRdrLeDetn114RdrDetnConf : 471|7@0+ (1.0,0.0) [0.0|100.0] "%" ASDM
 SG_ FrntSideRdrLeDetn114RdrDetnElevn : 479|5@0+ (1.0,-15.0) [-15.0|15.0] "Deg" ASDM
 SG_ FrntSideRdrLeDetn114RdrDetnPwr : 409|9@0+ (0.1,0.0) [0.0|51.1] "dB" ASDM
 SG_ FrntSideRdrLeDetn114RdrDetnRng : 431|14@0+ (0.02,-1.0) [-1.0|200.0] "m" ASDM
 SG_ FrntSideRdrLeDetn114RdrDetnRngV : 452|13@0+ (0.02,-80.0) [-80.0|80.0] "m/s" ASDM
 SG_ FrntSideRdrLeDetn114RdrDetnSts : 411|2@0+ (1,0) [0|3] "" ASDM

BO_ 342 FSRLSafetyCANFD1Frame20 : 64 FSRL
 SG_ FrntSideRdrLeDetn115_UB : 74|1@0+ (1,0) [0|1] "" ASDM
 SG_ FrntSideRdrLeDetn115RdrDetnAzi : 31|11@0+ (0.1,-90.0) [-90.0|90.0] "Deg" ASDM
 SG_ FrntSideRdrLeDetn115RdrDetnChks : 7|8@0+ (1.0,0.0) [0.0|255.0] "Unitless" ASDM
 SG_ FrntSideRdrLeDetn115RdrDetnCntr : 15|4@0+ (1.0,0.0) [0.0|15.0] "Unitless" ASDM
 SG_ FrntSideRdrLeDetn115RdrDetnConf : 71|7@0+ (1.0,0.0) [0.0|100.0] "%" ASDM
 SG_ FrntSideRdrLeDetn115RdrDetnElevn : 79|5@0+ (1.0,-15.0) [-15.0|15.0] "Deg" ASDM
 SG_ FrntSideRdrLeDetn115RdrDetnPwr : 8|9@0+ (0.1,0.0) [0.0|51.1] "dB" ASDM
 SG_ FrntSideRdrLeDetn115RdrDetnRng : 55|14@0+ (0.02,-1.0) [-1.0|200.0] "m" ASDM
 SG_ FrntSideRdrLeDetn115RdrDetnRngV : 36|13@0+ (0.02,-80.0) [-80.0|80.0] "m/s" ASDM
 SG_ FrntSideRdrLeDetn115RdrDetnSts : 11|2@0+ (1,0) [0|3] "" ASDM
 SG_ FrntSideRdrLeDetn116_UB : 154|1@0+ (1,0) [0|1] "" ASDM
 SG_ FrntSideRdrLeDetn116RdrDetnAzi : 119|11@0+ (0.1,-90.0) [-90.0|90.0] "Deg" ASDM
 SG_ FrntSideRdrLeDetn116RdrDetnChks : 87|8@0+ (1.0,0.0) [0.0|255.0] "Unitless" ASDM
 SG_ FrntSideRdrLeDetn116RdrDetnCntr : 95|4@0+ (1.0,0.0) [0.0|15.0] "Unitless" ASDM
 SG_ FrntSideRdrLeDetn116RdrDetnConf : 111|7@0+ (1.0,0.0) [0.0|100.0] "%" ASDM
 SG_ FrntSideRdrLeDetn116RdrDetnElevn : 159|5@0+ (1.0,-15.0) [-15.0|15.0] "Deg" ASDM
 SG_ FrntSideRdrLeDetn116RdrDetnPwr : 89|9@0+ (0.1,0.0) [0.0|51.1] "dB" ASDM
 SG_ FrntSideRdrLeDetn116RdrDetnRng : 143|14@0+ (0.02,-1.0) [-1.0|200.0] "m" ASDM
 SG_ FrntSideRdrLeDetn116RdrDetnRngV : 124|13@0+ (0.02,-80.0) [-80.0|80.0] "m/s" ASDM
 SG_ FrntSideRdrLeDetn116RdrDetnSts : 91|2@0+ (1,0) [0|3] "" ASDM
 SG_ FrntSideRdrLeDetn117_UB : 234|1@0+ (1,0) [0|1] "" ASDM
 SG_ FrntSideRdrLeDetn117RdrDetnAzi : 199|11@0+ (0.1,-90.0) [-90.0|90.0] "Deg" ASDM
 SG_ FrntSideRdrLeDetn117RdrDetnChks : 167|8@0+ (1.0,0.0) [0.0|255.0] "Unitless" ASDM
 SG_ FrntSideRdrLeDetn117RdrDetnCntr : 175|4@0+ (1.0,0.0) [0.0|15.0] "Unitless" ASDM
 SG_ FrntSideRdrLeDetn117RdrDetnConf : 191|7@0+ (1.0,0.0) [0.0|100.0] "%" ASDM
 SG_ FrntSideRdrLeDetn117RdrDetnElevn : 239|5@0+ (1.0,-15.0) [-15.0|15.0] "Deg" ASDM
 SG_ FrntSideRdrLeDetn117RdrDetnPwr : 169|9@0+ (0.1,0.0) [0.0|51.1] "dB" ASDM
 SG_ FrntSideRdrLeDetn117RdrDetnRng : 223|14@0+ (0.02,-1.0) [-1.0|200.0] "m" ASDM
 SG_ FrntSideRdrLeDetn117RdrDetnRngV : 204|13@0+ (0.02,-80.0) [-80.0|80.0] "m/s" ASDM
 SG_ FrntSideRdrLeDetn117RdrDetnSts : 171|2@0+ (1,0) [0|3] "" ASDM
 SG_ FrntSideRdrLeDetn118_UB : 314|1@0+ (1,0) [0|1] "" ASDM
 SG_ FrntSideRdrLeDetn118RdrDetnAzi : 287|11@0+ (0.1,-90.0) [-90.0|90.0] "Deg" ASDM
 SG_ FrntSideRdrLeDetn118RdrDetnChks : 247|8@0+ (1.0,0.0) [0.0|255.0] "Unitless" ASDM
 SG_ FrntSideRdrLeDetn118RdrDetnCntr : 255|4@0+ (1.0,0.0) [0.0|15.0] "Unitless" ASDM
 SG_ FrntSideRdrLeDetn118RdrDetnConf : 311|7@0+ (1.0,0.0) [0.0|100.0] "%" ASDM
 SG_ FrntSideRdrLeDetn118RdrDetnElevn : 319|5@0+ (1.0,-15.0) [-15.0|15.0] "Deg" ASDM
 SG_ FrntSideRdrLeDetn118RdrDetnPwr : 249|9@0+ (0.1,0.0) [0.0|51.1] "dB" ASDM
 SG_ FrntSideRdrLeDetn118RdrDetnRng : 271|14@0+ (0.02,-1.0) [-1.0|200.0] "m" ASDM
 SG_ FrntSideRdrLeDetn118RdrDetnRngV : 292|13@0+ (0.02,-80.0) [-80.0|80.0] "m/s" ASDM
 SG_ FrntSideRdrLeDetn118RdrDetnSts : 251|2@0+ (1,0) [0|3] "" ASDM
 SG_ FrntSideRdrLeDetn119_UB : 394|1@0+ (1,0) [0|1] "" ASDM
 SG_ FrntSideRdrLeDetn119RdrDetnAzi : 367|11@0+ (0.1,-90.0) [-90.0|90.0] "Deg" ASDM
 SG_ FrntSideRdrLeDetn119RdrDetnChks : 327|8@0+ (1.0,0.0) [0.0|255.0] "Unitless" ASDM
 SG_ FrntSideRdrLeDetn119RdrDetnCntr : 335|4@0+ (1.0,0.0) [0.0|15.0] "Unitless" ASDM
 SG_ FrntSideRdrLeDetn119RdrDetnConf : 391|7@0+ (1.0,0.0) [0.0|100.0] "%" ASDM
 SG_ FrntSideRdrLeDetn119RdrDetnElevn : 399|5@0+ (1.0,-15.0) [-15.0|15.0] "Deg" ASDM
 SG_ FrntSideRdrLeDetn119RdrDetnPwr : 329|9@0+ (0.1,0.0) [0.0|51.1] "dB" ASDM
 SG_ FrntSideRdrLeDetn119RdrDetnRng : 351|14@0+ (0.02,-1.0) [-1.0|200.0] "m" ASDM
 SG_ FrntSideRdrLeDetn119RdrDetnRngV : 372|13@0+ (0.02,-80.0) [-80.0|80.0] "m/s" ASDM
 SG_ FrntSideRdrLeDetn119RdrDetnSts : 331|2@0+ (1,0) [0|3] "" ASDM
 SG_ FrntSideRdrLeDetn120_UB : 474|1@0+ (1,0) [0|1] "" ASDM
 SG_ FrntSideRdrLeDetn120RdrDetnAzi : 447|11@0+ (0.1,-90.0) [-90.0|90.0] "Deg" ASDM
 SG_ FrntSideRdrLeDetn120RdrDetnChks : 407|8@0+ (1.0,0.0) [0.0|255.0] "Unitless" ASDM
 SG_ FrntSideRdrLeDetn120RdrDetnCntr : 415|4@0+ (1.0,0.0) [0.0|15.0] "Unitless" ASDM
 SG_ FrntSideRdrLeDetn120RdrDetnConf : 471|7@0+ (1.0,0.0) [0.0|100.0] "%" ASDM
 SG_ FrntSideRdrLeDetn120RdrDetnElevn : 479|5@0+ (1.0,-15.0) [-15.0|15.0] "Deg" ASDM
 SG_ FrntSideRdrLeDetn120RdrDetnPwr : 409|9@0+ (0.1,0.0) [0.0|51.1] "dB" ASDM
 SG_ FrntSideRdrLeDetn120RdrDetnRng : 431|14@0+ (0.02,-1.0) [-1.0|200.0] "m" ASDM
 SG_ FrntSideRdrLeDetn120RdrDetnRngV : 452|13@0+ (0.02,-80.0) [-80.0|80.0] "m/s" ASDM
 SG_ FrntSideRdrLeDetn120RdrDetnSts : 411|2@0+ (1,0) [0|3] "" ASDM

BO_ 344 FSRLSafetyCANFD1Frame21 : 64 FSRL
 SG_ FrntSideRdrLeDetn121_UB : 74|1@0+ (1,0) [0|1] "" ASDM
 SG_ FrntSideRdrLeDetn121RdrDetnAzi : 31|11@0+ (0.1,-90.0) [-90.0|90.0] "Deg" ASDM
 SG_ FrntSideRdrLeDetn121RdrDetnChks : 7|8@0+ (1.0,0.0) [0.0|255.0] "Unitless" ASDM
 SG_ FrntSideRdrLeDetn121RdrDetnCntr : 15|4@0+ (1.0,0.0) [0.0|15.0] "Unitless" ASDM
 SG_ FrntSideRdrLeDetn121RdrDetnConf : 71|7@0+ (1.0,0.0) [0.0|100.0] "%" ASDM
 SG_ FrntSideRdrLeDetn121RdrDetnElevn : 79|5@0+ (1.0,-15.0) [-15.0|15.0] "Deg" ASDM
 SG_ FrntSideRdrLeDetn121RdrDetnPwr : 8|9@0+ (0.1,0.0) [0.0|51.1] "dB" ASDM
 SG_ FrntSideRdrLeDetn121RdrDetnRng : 55|14@0+ (0.02,-1.0) [-1.0|200.0] "m" ASDM
 SG_ FrntSideRdrLeDetn121RdrDetnRngV : 36|13@0+ (0.02,-80.0) [-80.0|80.0] "m/s" ASDM
 SG_ FrntSideRdrLeDetn121RdrDetnSts : 11|2@0+ (1,0) [0|3] "" ASDM
 SG_ FrntSideRdrLeDetn122_UB : 154|1@0+ (1,0) [0|1] "" ASDM
 SG_ FrntSideRdrLeDetn122RdrDetnAzi : 119|11@0+ (0.1,-90.0) [-90.0|90.0] "Deg" ASDM
 SG_ FrntSideRdrLeDetn122RdrDetnChks : 87|8@0+ (1.0,0.0) [0.0|255.0] "Unitless" ASDM
 SG_ FrntSideRdrLeDetn122RdrDetnCntr : 95|4@0+ (1.0,0.0) [0.0|15.0] "Unitless" ASDM
 SG_ FrntSideRdrLeDetn122RdrDetnConf : 111|7@0+ (1.0,0.0) [0.0|100.0] "%" ASDM
 SG_ FrntSideRdrLeDetn122RdrDetnElevn : 159|5@0+ (1.0,-15.0) [-15.0|15.0] "Deg" ASDM
 SG_ FrntSideRdrLeDetn122RdrDetnPwr : 89|9@0+ (0.1,0.0) [0.0|51.1] "dB" ASDM
 SG_ FrntSideRdrLeDetn122RdrDetnRng : 143|14@0+ (0.02,-1.0) [-1.0|200.0] "m" ASDM
 SG_ FrntSideRdrLeDetn122RdrDetnRngV : 124|13@0+ (0.02,-80.0) [-80.0|80.0] "m/s" ASDM
 SG_ FrntSideRdrLeDetn122RdrDetnSts : 91|2@0+ (1,0) [0|3] "" ASDM
 SG_ FrntSideRdrLeDetn123_UB : 234|1@0+ (1,0) [0|1] "" ASDM
 SG_ FrntSideRdrLeDetn123RdrDetnAzi : 199|11@0+ (0.1,-90.0) [-90.0|90.0] "Deg" ASDM
 SG_ FrntSideRdrLeDetn123RdrDetnChks : 167|8@0+ (1.0,0.0) [0.0|255.0] "Unitless" ASDM
 SG_ FrntSideRdrLeDetn123RdrDetnCntr : 175|4@0+ (1.0,0.0) [0.0|15.0] "Unitless" ASDM
 SG_ FrntSideRdrLeDetn123RdrDetnConf : 191|7@0+ (1.0,0.0) [0.0|100.0] "%" ASDM
 SG_ FrntSideRdrLeDetn123RdrDetnElevn : 239|5@0+ (1.0,-15.0) [-15.0|15.0] "Deg" ASDM
 SG_ FrntSideRdrLeDetn123RdrDetnPwr : 169|9@0+ (0.1,0.0) [0.0|51.1] "dB" ASDM
 SG_ FrntSideRdrLeDetn123RdrDetnRng : 223|14@0+ (0.02,-1.0) [-1.0|200.0] "m" ASDM
 SG_ FrntSideRdrLeDetn123RdrDetnRngV : 204|13@0+ (0.02,-80.0) [-80.0|80.0] "m/s" ASDM
 SG_ FrntSideRdrLeDetn123RdrDetnSts : 171|2@0+ (1,0) [0|3] "" ASDM
 SG_ FrntSideRdrLeDetn124_UB : 314|1@0+ (1,0) [0|1] "" ASDM
 SG_ FrntSideRdrLeDetn124RdrDetnAzi : 287|11@0+ (0.1,-90.0) [-90.0|90.0] "Deg" ASDM
 SG_ FrntSideRdrLeDetn124RdrDetnChks : 247|8@0+ (1.0,0.0) [0.0|255.0] "Unitless" ASDM
 SG_ FrntSideRdrLeDetn124RdrDetnCntr : 255|4@0+ (1.0,0.0) [0.0|15.0] "Unitless" ASDM
 SG_ FrntSideRdrLeDetn124RdrDetnConf : 311|7@0+ (1.0,0.0) [0.0|100.0] "%" ASDM
 SG_ FrntSideRdrLeDetn124RdrDetnElevn : 319|5@0+ (1.0,-15.0) [-15.0|15.0] "Deg" ASDM
 SG_ FrntSideRdrLeDetn124RdrDetnPwr : 249|9@0+ (0.1,0.0) [0.0|51.1] "dB" ASDM
 SG_ FrntSideRdrLeDetn124RdrDetnRng : 271|14@0+ (0.02,-1.0) [-1.0|200.0] "m" ASDM
 SG_ FrntSideRdrLeDetn124RdrDetnRngV : 292|13@0+ (0.02,-80.0) [-80.0|80.0] "m/s" ASDM
 SG_ FrntSideRdrLeDetn124RdrDetnSts : 251|2@0+ (1,0) [0|3] "" ASDM
 SG_ FrntSideRdrLeDetn125_UB : 394|1@0+ (1,0) [0|1] "" ASDM
 SG_ FrntSideRdrLeDetn125RdrDetnAzi : 367|11@0+ (0.1,-90.0) [-90.0|90.0] "Deg" ASDM
 SG_ FrntSideRdrLeDetn125RdrDetnChks : 327|8@0+ (1.0,0.0) [0.0|255.0] "Unitless" ASDM
 SG_ FrntSideRdrLeDetn125RdrDetnCntr : 335|4@0+ (1.0,0.0) [0.0|15.0] "Unitless" ASDM
 SG_ FrntSideRdrLeDetn125RdrDetnConf : 391|7@0+ (1.0,0.0) [0.0|100.0] "%" ASDM
 SG_ FrntSideRdrLeDetn125RdrDetnElevn : 399|5@0+ (1.0,-15.0) [-15.0|15.0] "Deg" ASDM
 SG_ FrntSideRdrLeDetn125RdrDetnPwr : 329|9@0+ (0.1,0.0) [0.0|51.1] "dB" ASDM
 SG_ FrntSideRdrLeDetn125RdrDetnRng : 351|14@0+ (0.02,-1.0) [-1.0|200.0] "m" ASDM
 SG_ FrntSideRdrLeDetn125RdrDetnRngV : 372|13@0+ (0.02,-80.0) [-80.0|80.0] "m/s" ASDM
 SG_ FrntSideRdrLeDetn125RdrDetnSts : 331|2@0+ (1,0) [0|3] "" ASDM
 SG_ FrntSideRdrLeDetn126_UB : 474|1@0+ (1,0) [0|1] "" ASDM
 SG_ FrntSideRdrLeDetn126RdrDetnAzi : 447|11@0+ (0.1,-90.0) [-90.0|90.0] "Deg" ASDM
 SG_ FrntSideRdrLeDetn126RdrDetnChks : 407|8@0+ (1.0,0.0) [0.0|255.0] "Unitless" ASDM
 SG_ FrntSideRdrLeDetn126RdrDetnCntr : 415|4@0+ (1.0,0.0) [0.0|15.0] "Unitless" ASDM
 SG_ FrntSideRdrLeDetn126RdrDetnConf : 471|7@0+ (1.0,0.0) [0.0|100.0] "%" ASDM
 SG_ FrntSideRdrLeDetn126RdrDetnElevn : 479|5@0+ (1.0,-15.0) [-15.0|15.0] "Deg" ASDM
 SG_ FrntSideRdrLeDetn126RdrDetnPwr : 409|9@0+ (0.1,0.0) [0.0|51.1] "dB" ASDM
 SG_ FrntSideRdrLeDetn126RdrDetnRng : 431|14@0+ (0.02,-1.0) [-1.0|200.0] "m" ASDM
 SG_ FrntSideRdrLeDetn126RdrDetnRngV : 452|13@0+ (0.02,-80.0) [-80.0|80.0] "m/s" ASDM
 SG_ FrntSideRdrLeDetn126RdrDetnSts : 411|2@0+ (1,0) [0|3] "" ASDM

BO_ 346 FSRLSafetyCANFD1Frame22 : 64 FSRL
 SG_ FrntSideRdrLeDetn127_UB : 74|1@0+ (1,0) [0|1] "" ASDM
 SG_ FrntSideRdrLeDetn127RdrDetnAzi : 31|11@0+ (0.1,-90.0) [-90.0|90.0] "Deg" ASDM
 SG_ FrntSideRdrLeDetn127RdrDetnChks : 7|8@0+ (1.0,0.0) [0.0|255.0] "Unitless" ASDM
 SG_ FrntSideRdrLeDetn127RdrDetnCntr : 15|4@0+ (1.0,0.0) [0.0|15.0] "Unitless" ASDM
 SG_ FrntSideRdrLeDetn127RdrDetnConf : 71|7@0+ (1.0,0.0) [0.0|100.0] "%" ASDM
 SG_ FrntSideRdrLeDetn127RdrDetnElevn : 79|5@0+ (1.0,-15.0) [-15.0|15.0] "Deg" ASDM
 SG_ FrntSideRdrLeDetn127RdrDetnPwr : 8|9@0+ (0.1,0.0) [0.0|51.1] "dB" ASDM
 SG_ FrntSideRdrLeDetn127RdrDetnRng : 55|14@0+ (0.02,-1.0) [-1.0|200.0] "m" ASDM
 SG_ FrntSideRdrLeDetn127RdrDetnRngV : 36|13@0+ (0.02,-80.0) [-80.0|80.0] "m/s" ASDM
 SG_ FrntSideRdrLeDetn127RdrDetnSts : 11|2@0+ (1,0) [0|3] "" ASDM
 SG_ FrntSideRdrLeDetn128_UB : 154|1@0+ (1,0) [0|1] "" ASDM
 SG_ FrntSideRdrLeDetn128RdrDetnAzi : 119|11@0+ (0.1,-90.0) [-90.0|90.0] "Deg" ASDM
 SG_ FrntSideRdrLeDetn128RdrDetnChks : 87|8@0+ (1.0,0.0) [0.0|255.0] "Unitless" ASDM
 SG_ FrntSideRdrLeDetn128RdrDetnCntr : 95|4@0+ (1.0,0.0) [0.0|15.0] "Unitless" ASDM
 SG_ FrntSideRdrLeDetn128RdrDetnConf : 111|7@0+ (1.0,0.0) [0.0|100.0] "%" ASDM
 SG_ FrntSideRdrLeDetn128RdrDetnElevn : 159|5@0+ (1.0,-15.0) [-15.0|15.0] "Deg" ASDM
 SG_ FrntSideRdrLeDetn128RdrDetnPwr : 89|9@0+ (0.1,0.0) [0.0|51.1] "dB" ASDM
 SG_ FrntSideRdrLeDetn128RdrDetnRng : 143|14@0+ (0.02,-1.0) [-1.0|200.0] "m" ASDM
 SG_ FrntSideRdrLeDetn128RdrDetnRngV : 124|13@0+ (0.02,-80.0) [-80.0|80.0] "m/s" ASDM
 SG_ FrntSideRdrLeDetn128RdrDetnSts : 91|2@0+ (1,0) [0|3] "" ASDM

BO_ 348 FSRLSafetyCANFD1Frame23 : 64 FSRL
 SG_ FrntSideRdrLeObj1_UB : 319|1@0+ (1,0) [0|1] "" ASDM
 SG_ FrntSideRdrLeObj1Heading : 287|12@0+ (0.1,-180.0) [-180.0|180.0] "Deg" ASDM
 SG_ FrntSideRdrLeObj1ObjBoxCenterLat : 23|9@0+ (0.1,-25.0) [-25.0|25.0] "m" ASDM
 SG_ FrntSideRdrLeObj1ObjBoxCenterLgt : 30|9@0+ (0.1,-25.0) [-25.0|25.0] "m" ASDM
 SG_ FrntSideRdrLeObj1ObservationHist : 63|32@0+ (1.0,0.0) [0.0|4294967295.0] "Unitless" ASDM
 SG_ FrntSideRdrLeObj1QualityBits : 289|18@0+ (1.0,0.0) [0.0|262143.0] "Unitless" ASDM
 SG_ FrntSideRdrLeObj1RdrObjAx : 7|8@0- (0.1,0.0) [-12.8|12.700000000000001] "m/s^2" ASDM
 SG_ FrntSideRdrLeObj1RdrObjAy : 15|8@0- (0.1,0.0) [-12.8|12.700000000000001] "m/s^2" ASDM
 SG_ FrntSideRdrLeObj1RdrObjBoxLength : 37|9@0+ (0.1,0.0) [0.0|50.0] "m" ASDM
 SG_ FrntSideRdrLeObj1RdrObjBoxWidth : 44|9@0+ (0.1,0.0) [0.0|50.0] "m" ASDM
 SG_ FrntSideRdrLeObj1RdrObjChks : 95|8@0+ (1.0,0.0) [0.0|255.0] "Unitless" ASDM
 SG_ FrntSideRdrLeObj1RdrObjCntr : 103|4@0+ (1.0,0.0) [0.0|15.0] "Unitless" ASDM
 SG_ FrntSideRdrLeObj1RdrObjCoastCnt : 279|5@0+ (1.0,0.0) [0.0|31.0] "Unitless" ASDM
 SG_ FrntSideRdrLeObj1RdrObjConf : 99|4@0+ (7.0,0.0) [0.0|105.0] "%" ASDM
 SG_ FrntSideRdrLeObj1RdrObjDx : 191|13@0+ (0.05,-200.0) [-200.0|200.0] "m" ASDM
 SG_ FrntSideRdrLeObj1RdrObjDxStdDe : 111|8@0+ (0.05,0.0) [0.0|12.700000000000001] "m" ASDM
 SG_ FrntSideRdrLeObj1RdrObjDy : 119|13@0+ (0.05,-200.0) [-200.0|200.0] "m" ASDM
 SG_ FrntSideRdrLeObj1RdrObjDyStdDe : 183|8@0+ (0.05,0.0) [0.0|12.700000000000001] "m" ASDM
 SG_ FrntSideRdrLeObj1RdrObjElevnConf : 223|4@0+ (7.0,0.0) [0.0|105.0] "%" ASDM
 SG_ FrntSideRdrLeObj1RdrObjElevnSts : 153|2@0+ (1,0) [0|3] "" ASDM
 SG_ FrntSideRdrLeObj1RdrObjID : 167|8@0+ (1.0,0.0) [0.0|255.0] "Unitless" ASDM
 SG_ FrntSideRdrLeObj1RdrObjIsInFreeSpace : 192|1@0+ (1,0) [0|1] "" ASDM
 SG_ FrntSideRdrLeObj1RdrObjMirrProblty : 219|4@0+ (7.0,0.0) [0.0|105.0] "%" ASDM
 SG_ FrntSideRdrLeObj1RdrObjMtnPat : 122|3@0+ (1,0) [0|7] "" ASDM
 SG_ FrntSideRdrLeObj1RdrObjNotRealProblty : 231|4@0+ (7.0,0.0) [0.0|105.0] "%" ASDM
 SG_ FrntSideRdrLeObj1RdrObjStatyCnt : 239|7@0+ (1.0,0.0) [0.0|127.0] "Unitless" ASDM
 SG_ FrntSideRdrLeObj1RdrObjTiAlv : 247|7@0+ (1.0,0.0) [0.0|127.0] "Unitless" ASDM
 SG_ FrntSideRdrLeObj1RdrObjTrackSts : 194|2@0+ (1,0) [0|3] "" ASDM
 SG_ FrntSideRdrLeObj1RdrObjTyp : 51|4@0+ (1,0) [0|15] "" ASDM
 SG_ FrntSideRdrLeObj1RdrObjTypConfBike : 175|4@0+ (7.0,0.0) [0.0|105.0] "%" ASDM
 SG_ FrntSideRdrLeObj1RdrObjTypConfPed : 171|4@0+ (7.0,0.0) [0.0|105.0] "%" ASDM
 SG_ FrntSideRdrLeObj1RdrObjTypConfVeh : 227|4@0+ (7.0,0.0) [0.0|105.0] "%" ASDM
 SG_ FrntSideRdrLeObj1RdrObjUsedTracker : 291|2@0+ (1,0) [0|3] "" ASDM
 SG_ FrntSideRdrLeObj1RdrObjVx : 255|14@0+ (0.02,-128.0) [-128.0|128.0] "m/s" ASDM
 SG_ FrntSideRdrLeObj1RdrObjVxStdDe : 271|6@0+ (0.05,0.0) [0.0|2.0] "m/s" ASDM
 SG_ FrntSideRdrLeObj1RdrObjVy : 207|14@0+ (0.02,-128.0) [-128.0|128.0] "m/s" ASDM
 SG_ FrntSideRdrLeObj1RdrObjVyStdDe : 159|6@0+ (0.05,0.0) [0.0|2.0] "m/s" ASDM
 SG_ FrntSideRdrLeObj1RelVx : 135|12@0+ (0.02,-35.6) [-35.6|35.6] "m/s" ASDM
 SG_ FrntSideRdrLeObj1RelVy : 139|12@0+ (0.02,-35.6) [-35.6|35.6] "m/s" ASDM

BO_ 350 FSRLSafetyCANFD1Frame24 : 64 FSRL
 SG_ FrntSideRdrLeObj2_UB : 319|1@0+ (1,0) [0|1] "" ASDM
 SG_ FrntSideRdrLeObj2Heading : 287|12@0+ (0.1,-180.0) [-180.0|180.0] "Deg" ASDM
 SG_ FrntSideRdrLeObj2ObjBoxCenterLat : 23|9@0+ (0.1,-25.0) [-25.0|25.0] "m" ASDM
 SG_ FrntSideRdrLeObj2ObjBoxCenterLgt : 30|9@0+ (0.1,-25.0) [-25.0|25.0] "m" ASDM
 SG_ FrntSideRdrLeObj2ObservationHist : 63|32@0+ (1.0,0.0) [0.0|4294967295.0] "Unitless" ASDM
 SG_ FrntSideRdrLeObj2QualityBits : 289|18@0+ (1.0,0.0) [0.0|262143.0] "Unitless" ASDM
 SG_ FrntSideRdrLeObj2RdrObjAx : 7|8@0- (0.1,0.0) [-12.8|12.700000000000001] "m/s^2" ASDM
 SG_ FrntSideRdrLeObj2RdrObjAy : 15|8@0- (0.1,0.0) [-12.8|12.700000000000001] "m/s^2" ASDM
 SG_ FrntSideRdrLeObj2RdrObjBoxLength : 37|9@0+ (0.1,0.0) [0.0|50.0] "m" ASDM
 SG_ FrntSideRdrLeObj2RdrObjBoxWidth : 44|9@0+ (0.1,0.0) [0.0|50.0] "m" ASDM
 SG_ FrntSideRdrLeObj2RdrObjChks : 95|8@0+ (1.0,0.0) [0.0|255.0] "Unitless" ASDM
 SG_ FrntSideRdrLeObj2RdrObjCntr : 103|4@0+ (1.0,0.0) [0.0|15.0] "Unitless" ASDM
 SG_ FrntSideRdrLeObj2RdrObjCoastCnt : 279|5@0+ (1.0,0.0) [0.0|31.0] "Unitless" ASDM
 SG_ FrntSideRdrLeObj2RdrObjConf : 99|4@0+ (7.0,0.0) [0.0|105.0] "%" ASDM
 SG_ FrntSideRdrLeObj2RdrObjDx : 191|13@0+ (0.05,-200.0) [-200.0|200.0] "m" ASDM
 SG_ FrntSideRdrLeObj2RdrObjDxStdDe : 111|8@0+ (0.05,0.0) [0.0|12.700000000000001] "m" ASDM
 SG_ FrntSideRdrLeObj2RdrObjDy : 119|13@0+ (0.05,-200.0) [-200.0|200.0] "m" ASDM
 SG_ FrntSideRdrLeObj2RdrObjDyStdDe : 183|8@0+ (0.05,0.0) [0.0|12.700000000000001] "m" ASDM
 SG_ FrntSideRdrLeObj2RdrObjElevnConf : 223|4@0+ (7.0,0.0) [0.0|105.0] "%" ASDM
 SG_ FrntSideRdrLeObj2RdrObjElevnSts : 153|2@0+ (1,0) [0|3] "" ASDM
 SG_ FrntSideRdrLeObj2RdrObjID : 167|8@0+ (1.0,0.0) [0.0|255.0] "Unitless" ASDM
 SG_ FrntSideRdrLeObj2RdrObjIsInFreeSpace : 192|1@0+ (1,0) [0|1] "" ASDM
 SG_ FrntSideRdrLeObj2RdrObjMirrProblty : 219|4@0+ (7.0,0.0) [0.0|105.0] "%" ASDM
 SG_ FrntSideRdrLeObj2RdrObjMtnPat : 122|3@0+ (1,0) [0|7] "" ASDM
 SG_ FrntSideRdrLeObj2RdrObjNotRealProblty : 231|4@0+ (7.0,0.0) [0.0|105.0] "%" ASDM
 SG_ FrntSideRdrLeObj2RdrObjStatyCnt : 239|7@0+ (1.0,0.0) [0.0|127.0] "Unitless" ASDM
 SG_ FrntSideRdrLeObj2RdrObjTiAlv : 247|7@0+ (1.0,0.0) [0.0|127.0] "Unitless" ASDM
 SG_ FrntSideRdrLeObj2RdrObjTrackSts : 194|2@0+ (1,0) [0|3] "" ASDM
 SG_ FrntSideRdrLeObj2RdrObjTyp : 51|4@0+ (1,0) [0|15] "" ASDM
 SG_ FrntSideRdrLeObj2RdrObjTypConfBike : 175|4@0+ (7.0,0.0) [0.0|105.0] "%" ASDM
 SG_ FrntSideRdrLeObj2RdrObjTypConfPed : 171|4@0+ (7.0,0.0) [0.0|105.0] "%" ASDM
 SG_ FrntSideRdrLeObj2RdrObjTypConfVeh : 227|4@0+ (7.0,0.0) [0.0|105.0] "%" ASDM
 SG_ FrntSideRdrLeObj2RdrObjUsedTracker : 291|2@0+ (1,0) [0|3] "" ASDM
 SG_ FrntSideRdrLeObj2RdrObjVx : 255|14@0+ (0.02,-128.0) [-128.0|128.0] "m/s" ASDM
 SG_ FrntSideRdrLeObj2RdrObjVxStdDe : 271|6@0+ (0.05,0.0) [0.0|2.0] "m/s" ASDM
 SG_ FrntSideRdrLeObj2RdrObjVy : 207|14@0+ (0.02,-128.0) [-128.0|128.0] "m/s" ASDM
 SG_ FrntSideRdrLeObj2RdrObjVyStdDe : 159|6@0+ (0.05,0.0) [0.0|2.0] "m/s" ASDM
 SG_ FrntSideRdrLeObj2RelVx : 135|12@0+ (0.02,-35.6) [-35.6|35.6] "m/s" ASDM
 SG_ FrntSideRdrLeObj2RelVy : 139|12@0+ (0.02,-35.6) [-35.6|35.6] "m/s" ASDM

CM_ SG_ 332 FrntSideRdrLeDetn85RdrDetnAzi "Refer to the data element description in FrntSideRdrLeDetn1 with the same data element name.";
CM_ SG_ 332 FrntSideRdrLeDetn85RdrDetnChks "Refer to the data element description in FrntSideRdrLeDetn1 with the same data element name.";
CM_ SG_ 332 FrntSideRdrLeDetn85RdrDetnCntr "Refer to the data element description in FrntSideRdrLeDetn1 with the same data element name.";
CM_ SG_ 332 FrntSideRdrLeDetn85RdrDetnConf "Refer to the data element description in FrntSideRdrLeDetn1 with the same data element name.";
CM_ SG_ 332 FrntSideRdrLeDetn85RdrDetnElevn "Refer to the data element description in FrntSideRdrLeDetn1 with the same data element name.";
CM_ SG_ 332 FrntSideRdrLeDetn85RdrDetnPwr "Refer to the data element description in FrntSideRdrLeDetn1 with the same data element name.";
CM_ SG_ 332 FrntSideRdrLeDetn85RdrDetnRng "Refer to the data element description in FrntSideRdrLeDetn1 with the same data element name.";
CM_ SG_ 332 FrntSideRdrLeDetn85RdrDetnRngV "Range Velocity";
CM_ SG_ 332 FrntSideRdrLeDetn85RdrDetnSts "Refer to the data element description in FrntSideRdrLeDetn1 with the same data element name.";
CM_ SG_ 332 FrntSideRdrLeDetn86RdrDetnAzi "Refer to the data element description in FrntSideRdrLeDetn1 with the same data element name.";
CM_ SG_ 332 FrntSideRdrLeDetn86RdrDetnChks "Refer to the data element description in FrntSideRdrLeDetn1 with the same data element name.";
CM_ SG_ 332 FrntSideRdrLeDetn86RdrDetnCntr "Refer to the data element description in FrntSideRdrLeDetn1 with the same data element name.";
CM_ SG_ 332 FrntSideRdrLeDetn86RdrDetnConf "Refer to the data element description in FrntSideRdrLeDetn1 with the same data element name.";
CM_ SG_ 332 FrntSideRdrLeDetn86RdrDetnElevn "Refer to the data element description in FrntSideRdrLeDetn1 with the same data element name.";
CM_ SG_ 332 FrntSideRdrLeDetn86RdrDetnPwr "Refer to the data element description in FrntSideRdrLeDetn1 with the same data element name.";
CM_ SG_ 332 FrntSideRdrLeDetn86RdrDetnRng "Refer to the data element description in FrntSideRdrLeDetn1 with the same data element name.";
CM_ SG_ 332 FrntSideRdrLeDetn86RdrDetnRngV "Range Velocity";
CM_ SG_ 332 FrntSideRdrLeDetn86RdrDetnSts "Refer to the data element description in FrntSideRdrLeDetn1 with the same data element name.";
CM_ SG_ 332 FrntSideRdrLeDetn87RdrDetnAzi "Refer to the data element description in FrntSideRdrLeDetn1 with the same data element name.";
CM_ SG_ 332 FrntSideRdrLeDetn87RdrDetnChks "Refer to the data element description in FrntSideRdrLeDetn1 with the same data element name.";
CM_ SG_ 332 FrntSideRdrLeDetn87RdrDetnCntr "Refer to the data element description in FrntSideRdrLeDetn1 with the same data element name.";
CM_ SG_ 332 FrntSideRdrLeDetn87RdrDetnConf "Refer to the data element description in FrntSideRdrLeDetn1 with the same data element name.";
CM_ SG_ 332 FrntSideRdrLeDetn87RdrDetnElevn "Refer to the data element description in FrntSideRdrLeDetn1 with the same data element name.";
CM_ SG_ 332 FrntSideRdrLeDetn87RdrDetnPwr "Refer to the data element description in FrntSideRdrLeDetn1 with the same data element name.";
CM_ SG_ 332 FrntSideRdrLeDetn87RdrDetnRng "Refer to the data element description in FrntSideRdrLeDetn1 with the same data element name.";
CM_ SG_ 332 FrntSideRdrLeDetn87RdrDetnRngV "Range Velocity";
CM_ SG_ 332 FrntSideRdrLeDetn87RdrDetnSts "Refer to the data element description in FrntSideRdrLeDetn1 with the same data element name.";
CM_ SG_ 332 FrntSideRdrLeDetn88RdrDetnAzi "Refer to the data element description in FrntSideRdrLeDetn1 with the same data element name.";
CM_ SG_ 332 FrntSideRdrLeDetn88RdrDetnChks "Refer to the data element description in FrntSideRdrLeDetn1 with the same data element name.";
CM_ SG_ 332 FrntSideRdrLeDetn88RdrDetnCntr "Refer to the data element description in FrntSideRdrLeDetn1 with the same data element name.";
CM_ SG_ 332 FrntSideRdrLeDetn88RdrDetnConf "Refer to the data element description in FrntSideRdrLeDetn1 with the same data element name.";
CM_ SG_ 332 FrntSideRdrLeDetn88RdrDetnElevn "Refer to the data element description in FrntSideRdrLeDetn1 with the same data element name.";
CM_ SG_ 332 FrntSideRdrLeDetn88RdrDetnPwr "Refer to the data element description in FrntSideRdrLeDetn1 with the same data element name.";
CM_ SG_ 332 FrntSideRdrLeDetn88RdrDetnRng "Refer to the data element description in FrntSideRdrLeDetn1 with the same data element name.";
CM_ SG_ 332 FrntSideRdrLeDetn88RdrDetnRngV "Range Velocity";
CM_ SG_ 332 FrntSideRdrLeDetn88RdrDetnSts "Refer to the data element description in FrntSideRdrLeDetn1 with the same data element name.";
CM_ SG_ 332 FrntSideRdrLeDetn89RdrDetnAzi "Refer to the data element description in FrntSideRdrLeDetn1 with the same data element name.";
CM_ SG_ 332 FrntSideRdrLeDetn89RdrDetnChks "Refer to the data element description in FrntSideRdrLeDetn1 with the same data element name.";
CM_ SG_ 332 FrntSideRdrLeDetn89RdrDetnCntr "Refer to the data element description in FrntSideRdrLeDetn1 with the same data element name.";
CM_ SG_ 332 FrntSideRdrLeDetn89RdrDetnConf "Refer to the data element description in FrntSideRdrLeDetn1 with the same data element name.";
CM_ SG_ 332 FrntSideRdrLeDetn89RdrDetnElevn "Refer to the data element description in FrntSideRdrLeDetn1 with the same data element name.";
CM_ SG_ 332 FrntSideRdrLeDetn89RdrDetnPwr "Refer to the data element description in FrntSideRdrLeDetn1 with the same data element name.";
CM_ SG_ 332 FrntSideRdrLeDetn89RdrDetnRng "Refer to the data element description in FrntSideRdrLeDetn1 with the same data element name.";
CM_ SG_ 332 FrntSideRdrLeDetn89RdrDetnRngV "Range Velocity";
CM_ SG_ 332 FrntSideRdrLeDetn89RdrDetnSts "Refer to the data element description in FrntSideRdrLeDetn1 with the same data element name.";
CM_ SG_ 332 FrntSideRdrLeDetn90RdrDetnAzi "Refer to the data element description in FrntSideRdrLeDetn1 with the same data element name.";
CM_ SG_ 332 FrntSideRdrLeDetn90RdrDetnChks "Refer to the data element description in FrntSideRdrLeDetn1 with the same data element name.";
CM_ SG_ 332 FrntSideRdrLeDetn90RdrDetnCntr "Refer to the data element description in FrntSideRdrLeDetn1 with the same data element name.";
CM_ SG_ 332 FrntSideRdrLeDetn90RdrDetnConf "Refer to the data element description in FrntSideRdrLeDetn1 with the same data element name.";
CM_ SG_ 332 FrntSideRdrLeDetn90RdrDetnElevn "Refer to the data element description in FrntSideRdrLeDetn1 with the same data element name.";
CM_ SG_ 332 FrntSideRdrLeDetn90RdrDetnPwr "Refer to the data element description in FrntSideRdrLeDetn1 with the same data element name.";
CM_ SG_ 332 FrntSideRdrLeDetn90RdrDetnRng "Refer to the data element description in FrntSideRdrLeDetn1 with the same data element name.";
CM_ SG_ 332 FrntSideRdrLeDetn90RdrDetnRngV "Range Velocity";
CM_ SG_ 332 FrntSideRdrLeDetn90RdrDetnSts "Refer to the data element description in FrntSideRdrLeDetn1 with the same data element name.";
CM_ SG_ 334 FrntSideRdrLeDetn91RdrDetnAzi "Refer to the data element description in FrntSideRdrLeDetn1 with the same data element name.";
CM_ SG_ 334 FrntSideRdrLeDetn91RdrDetnChks "Refer to the data element description in FrntSideRdrLeDetn1 with the same data element name.";
CM_ SG_ 334 FrntSideRdrLeDetn91RdrDetnCntr "Refer to the data element description in FrntSideRdrLeDetn1 with the same data element name.";
CM_ SG_ 334 FrntSideRdrLeDetn91RdrDetnConf "Refer to the data element description in FrntSideRdrLeDetn1 with the same data element name.";
CM_ SG_ 334 FrntSideRdrLeDetn91RdrDetnElevn "Refer to the data element description in FrntSideRdrLeDetn1 with the same data element name.";
CM_ SG_ 334 FrntSideRdrLeDetn91RdrDetnPwr "Refer to the data element description in FrntSideRdrLeDetn1 with the same data element name.";
CM_ SG_ 334 FrntSideRdrLeDetn91RdrDetnRng "Refer to the data element description in FrntSideRdrLeDetn1 with the same data element name.";
CM_ SG_ 334 FrntSideRdrLeDetn91RdrDetnRngV "Range Velocity";
CM_ SG_ 334 FrntSideRdrLeDetn91RdrDetnSts "Refer to the data element description in FrntSideRdrLeDetn1 with the same data element name.";
CM_ SG_ 334 FrntSideRdrLeDetn92RdrDetnAzi "Refer to the data element description in FrntSideRdrLeDetn1 with the same data element name.";
CM_ SG_ 334 FrntSideRdrLeDetn92RdrDetnChks "Refer to the data element description in FrntSideRdrLeDetn1 with the same data element name.";
CM_ SG_ 334 FrntSideRdrLeDetn92RdrDetnCntr "Refer to the data element description in FrntSideRdrLeDetn1 with the same data element name.";
CM_ SG_ 334 FrntSideRdrLeDetn92RdrDetnConf "Refer to the data element description in FrntSideRdrLeDetn1 with the same data element name.";
CM_ SG_ 334 FrntSideRdrLeDetn92RdrDetnElevn "Refer to the data element description in FrntSideRdrLeDetn1 with the same data element name.";
CM_ SG_ 334 FrntSideRdrLeDetn92RdrDetnPwr "Refer to the data element description in FrntSideRdrLeDetn1 with the same data element name.";
CM_ SG_ 334 FrntSideRdrLeDetn92RdrDetnRng "Refer to the data element description in FrntSideRdrLeDetn1 with the same data element name.";
CM_ SG_ 334 FrntSideRdrLeDetn92RdrDetnRngV "Range Velocity";
CM_ SG_ 334 FrntSideRdrLeDetn92RdrDetnSts "Refer to the data element description in FrntSideRdrLeDetn1 with the same data element name.";
CM_ SG_ 334 FrntSideRdrLeDetn93RdrDetnAzi "Refer to the data element description in FrntSideRdrLeDetn1 with the same data element name.";
CM_ SG_ 334 FrntSideRdrLeDetn93RdrDetnChks "Refer to the data element description in FrntSideRdrLeDetn1 with the same data element name.";
CM_ SG_ 334 FrntSideRdrLeDetn93RdrDetnCntr "Refer to the data element description in FrntSideRdrLeDetn1 with the same data element name.";
CM_ SG_ 334 FrntSideRdrLeDetn93RdrDetnConf "Refer to the data element description in FrntSideRdrLeDetn1 with the same data element name.";
CM_ SG_ 334 FrntSideRdrLeDetn93RdrDetnElevn "Refer to the data element description in FrntSideRdrLeDetn1 with the same data element name.";
CM_ SG_ 334 FrntSideRdrLeDetn93RdrDetnPwr "Refer to the data element description in FrntSideRdrLeDetn1 with the same data element name.";
CM_ SG_ 334 FrntSideRdrLeDetn93RdrDetnRng "Refer to the data element description in FrntSideRdrLeDetn1 with the same data element name.";
CM_ SG_ 334 FrntSideRdrLeDetn93RdrDetnRngV "Range Velocity";
CM_ SG_ 334 FrntSideRdrLeDetn93RdrDetnSts "Refer to the data element description in FrntSideRdrLeDetn1 with the same data element name.";
CM_ SG_ 334 FrntSideRdrLeDetn94RdrDetnAzi "Refer to the data element description in FrntSideRdrLeDetn1 with the same data element name.";
CM_ SG_ 334 FrntSideRdrLeDetn94RdrDetnChks "Refer to the data element description in FrntSideRdrLeDetn1 with the same data element name.";
CM_ SG_ 334 FrntSideRdrLeDetn94RdrDetnCntr "Refer to the data element description in FrntSideRdrLeDetn1 with the same data element name.";
CM_ SG_ 334 FrntSideRdrLeDetn94RdrDetnConf "Refer to the data element description in FrntSideRdrLeDetn1 with the same data element name.";
CM_ SG_ 334 FrntSideRdrLeDetn94RdrDetnElevn "Refer to the data element description in FrntSideRdrLeDetn1 with the same data element name.";
CM_ SG_ 334 FrntSideRdrLeDetn94RdrDetnPwr "Refer to the data element description in FrntSideRdrLeDetn1 with the same data element name.";
CM_ SG_ 334 FrntSideRdrLeDetn94RdrDetnRng "Refer to the data element description in FrntSideRdrLeDetn1 with the same data element name.";
CM_ SG_ 334 FrntSideRdrLeDetn94RdrDetnRngV "Range Velocity";
CM_ SG_ 334 FrntSideRdrLeDetn94RdrDetnSts "Refer to the data element description in FrntSideRdrLeDetn1 with the same data element name.";
CM_ SG_ 334 FrntSideRdrLeDetn95RdrDetnAzi "Refer to the data element description in FrntSideRdrLeDetn1 with the same data element name.";
CM_ SG_ 334 FrntSideRdrLeDetn95RdrDetnChks "Refer to the data element description in FrntSideRdrLeDetn1 with the same data element name.";
CM_ SG_ 334 FrntSideRdrLeDetn95RdrDetnCntr "Refer to the data element description in FrntSideRdrLeDetn1 with the same data element name.";
CM_ SG_ 334 FrntSideRdrLeDetn95RdrDetnConf "Refer to the data element description in FrntSideRdrLeDetn1 with the same data element name.";
CM_ SG_ 334 FrntSideRdrLeDetn95RdrDetnElevn "Refer to the data element description in FrntSideRdrLeDetn1 with the same data element name.";
CM_ SG_ 334 FrntSideRdrLeDetn95RdrDetnPwr "Refer to the data element description in FrntSideRdrLeDetn1 with the same data element name.";
CM_ SG_ 334 FrntSideRdrLeDetn95RdrDetnRng "Refer to the data element description in FrntSideRdrLeDetn1 with the same data element name.";
CM_ SG_ 334 FrntSideRdrLeDetn95RdrDetnRngV "Range Velocity";
CM_ SG_ 334 FrntSideRdrLeDetn95RdrDetnSts "Refer to the data element description in FrntSideRdrLeDetn1 with the same data element name.";
CM_ SG_ 334 FrntSideRdrLeDetn96RdrDetnAzi "Refer to the data element description in FrntSideRdrLeDetn1 with the same data element name.";
CM_ SG_ 334 FrntSideRdrLeDetn96RdrDetnChks "Refer to the data element description in FrntSideRdrLeDetn1 with the same data element name.";
CM_ SG_ 334 FrntSideRdrLeDetn96RdrDetnCntr "Refer to the data element description in FrntSideRdrLeDetn1 with the same data element name.";
CM_ SG_ 334 FrntSideRdrLeDetn96RdrDetnConf "Refer to the data element description in FrntSideRdrLeDetn1 with the same data element name.";
CM_ SG_ 334 FrntSideRdrLeDetn96RdrDetnElevn "Refer to the data element description in FrntSideRdrLeDetn1 with the same data element name.";
CM_ SG_ 334 FrntSideRdrLeDetn96RdrDetnPwr "Refer to the data element description in FrntSideRdrLeDetn1 with the same data element name.";
CM_ SG_ 334 FrntSideRdrLeDetn96RdrDetnRng "Refer to the data element description in FrntSideRdrLeDetn1 with the same data element name.";
CM_ SG_ 334 FrntSideRdrLeDetn96RdrDetnRngV "Range Velocity";
CM_ SG_ 334 FrntSideRdrLeDetn96RdrDetnSts "Refer to the data element description in FrntSideRdrLeDetn1 with the same data element name.";
CM_ SG_ 336 FrntSideRdrLeDetn100RdrDetnAzi "Refer to the data element description in FrntSideRdrLeDetn1 with the same data element name.";
CM_ SG_ 336 FrntSideRdrLeDetn100RdrDetnChks "Refer to the data element description in FrntSideRdrLeDetn1 with the same data element name.";
CM_ SG_ 336 FrntSideRdrLeDetn100RdrDetnCntr "Refer to the data element description in FrntSideRdrLeDetn1 with the same data element name.";
CM_ SG_ 336 FrntSideRdrLeDetn100RdrDetnConf "Refer to the data element description in FrntSideRdrLeDetn1 with the same data element name.";
CM_ SG_ 336 FrntSideRdrLeDetn100RdrDetnElevn "Refer to the data element description in FrntSideRdrLeDetn1 with the same data element name.";
CM_ SG_ 336 FrntSideRdrLeDetn100RdrDetnPwr "Refer to the data element description in FrntSideRdrLeDetn1 with the same data element name.";
CM_ SG_ 336 FrntSideRdrLeDetn100RdrDetnRng "Refer to the data element description in FrntSideRdrLeDetn1 with the same data element name.";
CM_ SG_ 336 FrntSideRdrLeDetn100RdrDetnRngV "Range Velocity";
CM_ SG_ 336 FrntSideRdrLeDetn100RdrDetnSts "Refer to the data element description in FrntSideRdrLeDetn1 with the same data element name.";
CM_ SG_ 336 FrntSideRdrLeDetn101RdrDetnAzi "Refer to the data element description in FrntSideRdrLeDetn1 with the same data element name.";
CM_ SG_ 336 FrntSideRdrLeDetn101RdrDetnChks "Refer to the data element description in FrntSideRdrLeDetn1 with the same data element name.";
CM_ SG_ 336 FrntSideRdrLeDetn101RdrDetnCntr "Refer to the data element description in FrntSideRdrLeDetn1 with the same data element name.";
CM_ SG_ 336 FrntSideRdrLeDetn101RdrDetnConf "Refer to the data element description in FrntSideRdrLeDetn1 with the same data element name.";
CM_ SG_ 336 FrntSideRdrLeDetn101RdrDetnElevn "Refer to the data element description in FrntSideRdrLeDetn1 with the same data element name.";
CM_ SG_ 336 FrntSideRdrLeDetn101RdrDetnPwr "Refer to the data element description in FrntSideRdrLeDetn1 with the same data element name.";
CM_ SG_ 336 FrntSideRdrLeDetn101RdrDetnRng "Refer to the data element description in FrntSideRdrLeDetn1 with the same data element name.";
CM_ SG_ 336 FrntSideRdrLeDetn101RdrDetnRngV "Range Velocity";
CM_ SG_ 336 FrntSideRdrLeDetn101RdrDetnSts "Refer to the data element description in FrntSideRdrLeDetn1 with the same data element name.";
CM_ SG_ 336 FrntSideRdrLeDetn102RdrDetnAzi "Refer to the data element description in FrntSideRdrLeDetn1 with the same data element name.";
CM_ SG_ 336 FrntSideRdrLeDetn102RdrDetnChks "Refer to the data element description in FrntSideRdrLeDetn1 with the same data element name.";
CM_ SG_ 336 FrntSideRdrLeDetn102RdrDetnCntr "Refer to the data element description in FrntSideRdrLeDetn1 with the same data element name.";
CM_ SG_ 336 FrntSideRdrLeDetn102RdrDetnConf "Refer to the data element description in FrntSideRdrLeDetn1 with the same data element name.";
CM_ SG_ 336 FrntSideRdrLeDetn102RdrDetnElevn "Refer to the data element description in FrntSideRdrLeDetn1 with the same data element name.";
CM_ SG_ 336 FrntSideRdrLeDetn102RdrDetnPwr "Refer to the data element description in FrntSideRdrLeDetn1 with the same data element name.";
CM_ SG_ 336 FrntSideRdrLeDetn102RdrDetnRng "Refer to the data element description in FrntSideRdrLeDetn1 with the same data element name.";
CM_ SG_ 336 FrntSideRdrLeDetn102RdrDetnRngV "Range Velocity";
CM_ SG_ 336 FrntSideRdrLeDetn102RdrDetnSts "Refer to the data element description in FrntSideRdrLeDetn1 with the same data element name.";
CM_ SG_ 336 FrntSideRdrLeDetn97RdrDetnAzi "Refer to the data element description in FrntSideRdrLeDetn1 with the same data element name.";
CM_ SG_ 336 FrntSideRdrLeDetn97RdrDetnChks "Refer to the data element description in FrntSideRdrLeDetn1 with the same data element name.";
CM_ SG_ 336 FrntSideRdrLeDetn97RdrDetnCntr "Refer to the data element description in FrntSideRdrLeDetn1 with the same data element name.";
CM_ SG_ 336 FrntSideRdrLeDetn97RdrDetnConf "Refer to the data element description in FrntSideRdrLeDetn1 with the same data element name.";
CM_ SG_ 336 FrntSideRdrLeDetn97RdrDetnElevn "Refer to the data element description in FrntSideRdrLeDetn1 with the same data element name.";
CM_ SG_ 336 FrntSideRdrLeDetn97RdrDetnPwr "Refer to the data element description in FrntSideRdrLeDetn1 with the same data element name.";
CM_ SG_ 336 FrntSideRdrLeDetn97RdrDetnRng "Refer to the data element description in FrntSideRdrLeDetn1 with the same data element name.";
CM_ SG_ 336 FrntSideRdrLeDetn97RdrDetnRngV "Range Velocity";
CM_ SG_ 336 FrntSideRdrLeDetn97RdrDetnSts "Refer to the data element description in FrntSideRdrLeDetn1 with the same data element name.";
CM_ SG_ 336 FrntSideRdrLeDetn98RdrDetnAzi "Refer to the data element description in FrntSideRdrLeDetn1 with the same data element name.";
CM_ SG_ 336 FrntSideRdrLeDetn98RdrDetnChks "Refer to the data element description in FrntSideRdrLeDetn1 with the same data element name.";
CM_ SG_ 336 FrntSideRdrLeDetn98RdrDetnCntr "Refer to the data element description in FrntSideRdrLeDetn1 with the same data element name.";
CM_ SG_ 336 FrntSideRdrLeDetn98RdrDetnConf "Refer to the data element description in FrntSideRdrLeDetn1 with the same data element name.";
CM_ SG_ 336 FrntSideRdrLeDetn98RdrDetnElevn "Refer to the data element description in FrntSideRdrLeDetn1 with the same data element name.";
CM_ SG_ 336 FrntSideRdrLeDetn98RdrDetnPwr "Refer to the data element description in FrntSideRdrLeDetn1 with the same data element name.";
CM_ SG_ 336 FrntSideRdrLeDetn98RdrDetnRng "Refer to the data element description in FrntSideRdrLeDetn1 with the same data element name.";
CM_ SG_ 336 FrntSideRdrLeDetn98RdrDetnRngV "Range Velocity";
CM_ SG_ 336 FrntSideRdrLeDetn98RdrDetnSts "Refer to the data element description in FrntSideRdrLeDetn1 with the same data element name.";
CM_ SG_ 336 FrntSideRdrLeDetn99RdrDetnAzi "Refer to the data element description in FrntSideRdrLeDetn1 with the same data element name.";
CM_ SG_ 336 FrntSideRdrLeDetn99RdrDetnChks "Refer to the data element description in FrntSideRdrLeDetn1 with the same data element name.";
CM_ SG_ 336 FrntSideRdrLeDetn99RdrDetnCntr "Refer to the data element description in FrntSideRdrLeDetn1 with the same data element name.";
CM_ SG_ 336 FrntSideRdrLeDetn99RdrDetnConf "Refer to the data element description in FrntSideRdrLeDetn1 with the same data element name.";
CM_ SG_ 336 FrntSideRdrLeDetn99RdrDetnElevn "Refer to the data element description in FrntSideRdrLeDetn1 with the same data element name.";
CM_ SG_ 336 FrntSideRdrLeDetn99RdrDetnPwr "Refer to the data element description in FrntSideRdrLeDetn1 with the same data element name.";
CM_ SG_ 336 FrntSideRdrLeDetn99RdrDetnRng "Refer to the data element description in FrntSideRdrLeDetn1 with the same data element name.";
CM_ SG_ 336 FrntSideRdrLeDetn99RdrDetnRngV "Range Velocity";
CM_ SG_ 336 FrntSideRdrLeDetn99RdrDetnSts "Refer to the data element description in FrntSideRdrLeDetn1 with the same data element name.";
CM_ SG_ 338 FrntSideRdrLeDetn103RdrDetnAzi "Refer to the data element description in FrntSideRdrLeDetn1 with the same data element name.";
CM_ SG_ 338 FrntSideRdrLeDetn103RdrDetnChks "Refer to the data element description in FrntSideRdrLeDetn1 with the same data element name.";
CM_ SG_ 338 FrntSideRdrLeDetn103RdrDetnCntr "Refer to the data element description in FrntSideRdrLeDetn1 with the same data element name.";
CM_ SG_ 338 FrntSideRdrLeDetn103RdrDetnConf "Refer to the data element description in FrntSideRdrLeDetn1 with the same data element name.";
CM_ SG_ 338 FrntSideRdrLeDetn103RdrDetnElevn "Refer to the data element description in FrntSideRdrLeDetn1 with the same data element name.";
CM_ SG_ 338 FrntSideRdrLeDetn103RdrDetnPwr "Refer to the data element description in FrntSideRdrLeDetn1 with the same data element name.";
CM_ SG_ 338 FrntSideRdrLeDetn103RdrDetnRng "Refer to the data element description in FrntSideRdrLeDetn1 with the same data element name.";
CM_ SG_ 338 FrntSideRdrLeDetn103RdrDetnRngV "Range Velocity";
CM_ SG_ 338 FrntSideRdrLeDetn103RdrDetnSts "Refer to the data element description in FrntSideRdrLeDetn1 with the same data element name.";
CM_ SG_ 338 FrntSideRdrLeDetn104RdrDetnAzi "Refer to the data element description in FrntSideRdrLeDetn1 with the same data element name.";
CM_ SG_ 338 FrntSideRdrLeDetn104RdrDetnChks "Refer to the data element description in FrntSideRdrLeDetn1 with the same data element name.";
CM_ SG_ 338 FrntSideRdrLeDetn104RdrDetnCntr "Refer to the data element description in FrntSideRdrLeDetn1 with the same data element name.";
CM_ SG_ 338 FrntSideRdrLeDetn104RdrDetnConf "Refer to the data element description in FrntSideRdrLeDetn1 with the same data element name.";
CM_ SG_ 338 FrntSideRdrLeDetn104RdrDetnElevn "Refer to the data element description in FrntSideRdrLeDetn1 with the same data element name.";
CM_ SG_ 338 FrntSideRdrLeDetn104RdrDetnPwr "Refer to the data element description in FrntSideRdrLeDetn1 with the same data element name.";
CM_ SG_ 338 FrntSideRdrLeDetn104RdrDetnRng "Refer to the data element description in FrntSideRdrLeDetn1 with the same data element name.";
CM_ SG_ 338 FrntSideRdrLeDetn104RdrDetnRngV "Range Velocity";
CM_ SG_ 338 FrntSideRdrLeDetn104RdrDetnSts "Refer to the data element description in FrntSideRdrLeDetn1 with the same data element name.";
CM_ SG_ 338 FrntSideRdrLeDetn105RdrDetnAzi "Refer to the data element description in FrntSideRdrLeDetn1 with the same data element name.";
CM_ SG_ 338 FrntSideRdrLeDetn105RdrDetnChks "Refer to the data element description in FrntSideRdrLeDetn1 with the same data element name.";
CM_ SG_ 338 FrntSideRdrLeDetn105RdrDetnCntr "Refer to the data element description in FrntSideRdrLeDetn1 with the same data element name.";
CM_ SG_ 338 FrntSideRdrLeDetn105RdrDetnConf "Refer to the data element description in FrntSideRdrLeDetn1 with the same data element name.";
CM_ SG_ 338 FrntSideRdrLeDetn105RdrDetnElevn "Refer to the data element description in FrntSideRdrLeDetn1 with the same data element name.";
CM_ SG_ 338 FrntSideRdrLeDetn105RdrDetnPwr "Refer to the data element description in FrntSideRdrLeDetn1 with the same data element name.";
CM_ SG_ 338 FrntSideRdrLeDetn105RdrDetnRng "Refer to the data element description in FrntSideRdrLeDetn1 with the same data element name.";
CM_ SG_ 338 FrntSideRdrLeDetn105RdrDetnRngV "Range Velocity";
CM_ SG_ 338 FrntSideRdrLeDetn105RdrDetnSts "Refer to the data element description in FrntSideRdrLeDetn1 with the same data element name.";
CM_ SG_ 338 FrntSideRdrLeDetn106RdrDetnAzi "Refer to the data element description in FrntSideRdrLeDetn1 with the same data element name.";
CM_ SG_ 338 FrntSideRdrLeDetn106RdrDetnChks "Refer to the data element description in FrntSideRdrLeDetn1 with the same data element name.";
CM_ SG_ 338 FrntSideRdrLeDetn106RdrDetnCntr "Refer to the data element description in FrntSideRdrLeDetn1 with the same data element name.";
CM_ SG_ 338 FrntSideRdrLeDetn106RdrDetnConf "Refer to the data element description in FrntSideRdrLeDetn1 with the same data element name.";
CM_ SG_ 338 FrntSideRdrLeDetn106RdrDetnElevn "Refer to the data element description in FrntSideRdrLeDetn1 with the same data element name.";
CM_ SG_ 338 FrntSideRdrLeDetn106RdrDetnPwr "Refer to the data element description in FrntSideRdrLeDetn1 with the same data element name.";
CM_ SG_ 338 FrntSideRdrLeDetn106RdrDetnRng "Refer to the data element description in FrntSideRdrLeDetn1 with the same data element name.";
CM_ SG_ 338 FrntSideRdrLeDetn106RdrDetnRngV "Range Velocity";
CM_ SG_ 338 FrntSideRdrLeDetn106RdrDetnSts "Refer to the data element description in FrntSideRdrLeDetn1 with the same data element name.";
CM_ SG_ 338 FrntSideRdrLeDetn107RdrDetnAzi "Refer to the data element description in FrntSideRdrLeDetn1 with the same data element name.";
CM_ SG_ 338 FrntSideRdrLeDetn107RdrDetnChks "Refer to the data element description in FrntSideRdrLeDetn1 with the same data element name.";
CM_ SG_ 338 FrntSideRdrLeDetn107RdrDetnCntr "Refer to the data element description in FrntSideRdrLeDetn1 with the same data element name.";
CM_ SG_ 338 FrntSideRdrLeDetn107RdrDetnConf "Refer to the data element description in FrntSideRdrLeDetn1 with the same data element name.";
CM_ SG_ 338 FrntSideRdrLeDetn107RdrDetnElevn "Refer to the data element description in FrntSideRdrLeDetn1 with the same data element name.";
CM_ SG_ 338 FrntSideRdrLeDetn107RdrDetnPwr "Refer to the data element description in FrntSideRdrLeDetn1 with the same data element name.";
CM_ SG_ 338 FrntSideRdrLeDetn107RdrDetnRng "Refer to the data element description in FrntSideRdrLeDetn1 with the same data element name.";
CM_ SG_ 338 FrntSideRdrLeDetn107RdrDetnRngV "Range Velocity";
CM_ SG_ 338 FrntSideRdrLeDetn107RdrDetnSts "Refer to the data element description in FrntSideRdrLeDetn1 with the same data element name.";
CM_ SG_ 338 FrntSideRdrLeDetn108RdrDetnAzi "Refer to the data element description in FrntSideRdrLeDetn1 with the same data element name.";
CM_ SG_ 338 FrntSideRdrLeDetn108RdrDetnChks "Refer to the data element description in FrntSideRdrLeDetn1 with the same data element name.";
CM_ SG_ 338 FrntSideRdrLeDetn108RdrDetnCntr "Refer to the data element description in FrntSideRdrLeDetn1 with the same data element name.";
CM_ SG_ 338 FrntSideRdrLeDetn108RdrDetnConf "Refer to the data element description in FrntSideRdrLeDetn1 with the same data element name.";
CM_ SG_ 338 FrntSideRdrLeDetn108RdrDetnElevn "Refer to the data element description in FrntSideRdrLeDetn1 with the same data element name.";
CM_ SG_ 338 FrntSideRdrLeDetn108RdrDetnPwr "Refer to the data element description in FrntSideRdrLeDetn1 with the same data element name.";
CM_ SG_ 338 FrntSideRdrLeDetn108RdrDetnRng "Refer to the data element description in FrntSideRdrLeDetn1 with the same data element name.";
CM_ SG_ 338 FrntSideRdrLeDetn108RdrDetnRngV "Range Velocity";
CM_ SG_ 338 FrntSideRdrLeDetn108RdrDetnSts "Refer to the data element description in FrntSideRdrLeDetn1 with the same data element name.";
CM_ SG_ 340 FrntSideRdrLeDetn109RdrDetnAzi "Refer to the data element description in FrntSideRdrLeDetn1 with the same data element name.";
CM_ SG_ 340 FrntSideRdrLeDetn109RdrDetnChks "Refer to the data element description in FrntSideRdrLeDetn1 with the same data element name.";
CM_ SG_ 340 FrntSideRdrLeDetn109RdrDetnCntr "Refer to the data element description in FrntSideRdrLeDetn1 with the same data element name.";
CM_ SG_ 340 FrntSideRdrLeDetn109RdrDetnConf "Refer to the data element description in FrntSideRdrLeDetn1 with the same data element name.";
CM_ SG_ 340 FrntSideRdrLeDetn109RdrDetnElevn "Refer to the data element description in FrntSideRdrLeDetn1 with the same data element name.";
CM_ SG_ 340 FrntSideRdrLeDetn109RdrDetnPwr "Refer to the data element description in FrntSideRdrLeDetn1 with the same data element name.";
CM_ SG_ 340 FrntSideRdrLeDetn109RdrDetnRng "Refer to the data element description in FrntSideRdrLeDetn1 with the same data element name.";
CM_ SG_ 340 FrntSideRdrLeDetn109RdrDetnRngV "Range Velocity";
CM_ SG_ 340 FrntSideRdrLeDetn109RdrDetnSts "Refer to the data element description in FrntSideRdrLeDetn1 with the same data element name.";
CM_ SG_ 340 FrntSideRdrLeDetn110RdrDetnAzi "Refer to the data element description in FrntSideRdrLeDetn1 with the same data element name.";
CM_ SG_ 340 FrntSideRdrLeDetn110RdrDetnChks "Refer to the data element description in FrntSideRdrLeDetn1 with the same data element name.";
CM_ SG_ 340 FrntSideRdrLeDetn110RdrDetnCntr "Refer to the data element description in FrntSideRdrLeDetn1 with the same data element name.";
CM_ SG_ 340 FrntSideRdrLeDetn110RdrDetnConf "Refer to the data element description in FrntSideRdrLeDetn1 with the same data element name.";
CM_ SG_ 340 FrntSideRdrLeDetn110RdrDetnElevn "Refer to the data element description in FrntSideRdrLeDetn1 with the same data element name.";
CM_ SG_ 340 FrntSideRdrLeDetn110RdrDetnPwr "Refer to the data element description in FrntSideRdrLeDetn1 with the same data element name.";
CM_ SG_ 340 FrntSideRdrLeDetn110RdrDetnRng "Refer to the data element description in FrntSideRdrLeDetn1 with the same data element name.";
CM_ SG_ 340 FrntSideRdrLeDetn110RdrDetnRngV "Range Velocity";
CM_ SG_ 340 FrntSideRdrLeDetn110RdrDetnSts "Refer to the data element description in FrntSideRdrLeDetn1 with the same data element name.";
CM_ SG_ 340 FrntSideRdrLeDetn111RdrDetnAzi "Refer to the data element description in FrntSideRdrLeDetn1 with the same data element name.";
CM_ SG_ 340 FrntSideRdrLeDetn111RdrDetnChks "Refer to the data element description in FrntSideRdrLeDetn1 with the same data element name.";
CM_ SG_ 340 FrntSideRdrLeDetn111RdrDetnCntr "Refer to the data element description in FrntSideRdrLeDetn1 with the same data element name.";
CM_ SG_ 340 FrntSideRdrLeDetn111RdrDetnConf "Refer to the data element description in FrntSideRdrLeDetn1 with the same data element name.";
CM_ SG_ 340 FrntSideRdrLeDetn111RdrDetnElevn "Refer to the data element description in FrntSideRdrLeDetn1 with the same data element name.";
CM_ SG_ 340 FrntSideRdrLeDetn111RdrDetnPwr "Refer to the data element description in FrntSideRdrLeDetn1 with the same data element name.";
CM_ SG_ 340 FrntSideRdrLeDetn111RdrDetnRng "Refer to the data element description in FrntSideRdrLeDetn1 with the same data element name.";
CM_ SG_ 340 FrntSideRdrLeDetn111RdrDetnRngV "Range Velocity";
CM_ SG_ 340 FrntSideRdrLeDetn111RdrDetnSts "Refer to the data element description in FrntSideRdrLeDetn1 with the same data element name.";
CM_ SG_ 340 FrntSideRdrLeDetn112RdrDetnAzi "Refer to the data element description in FrntSideRdrLeDetn1 with the same data element name.";
CM_ SG_ 340 FrntSideRdrLeDetn112RdrDetnChks "Refer to the data element description in FrntSideRdrLeDetn1 with the same data element name.";
CM_ SG_ 340 FrntSideRdrLeDetn112RdrDetnCntr "Refer to the data element description in FrntSideRdrLeDetn1 with the same data element name.";
CM_ SG_ 340 FrntSideRdrLeDetn112RdrDetnConf "Refer to the data element description in FrntSideRdrLeDetn1 with the same data element name.";
CM_ SG_ 340 FrntSideRdrLeDetn112RdrDetnElevn "Refer to the data element description in FrntSideRdrLeDetn1 with the same data element name.";
CM_ SG_ 340 FrntSideRdrLeDetn112RdrDetnPwr "Refer to the data element description in FrntSideRdrLeDetn1 with the same data element name.";
CM_ SG_ 340 FrntSideRdrLeDetn112RdrDetnRng "Refer to the data element description in FrntSideRdrLeDetn1 with the same data element name.";
CM_ SG_ 340 FrntSideRdrLeDetn112RdrDetnRngV "Range Velocity";
CM_ SG_ 340 FrntSideRdrLeDetn112RdrDetnSts "Refer to the data element description in FrntSideRdrLeDetn1 with the same data element name.";
CM_ SG_ 340 FrntSideRdrLeDetn113RdrDetnAzi "Refer to the data element description in FrntSideRdrLeDetn1 with the same data element name.";
CM_ SG_ 340 FrntSideRdrLeDetn113RdrDetnChks "Refer to the data element description in FrntSideRdrLeDetn1 with the same data element name.";
CM_ SG_ 340 FrntSideRdrLeDetn113RdrDetnCntr "Refer to the data element description in FrntSideRdrLeDetn1 with the same data element name.";
CM_ SG_ 340 FrntSideRdrLeDetn113RdrDetnConf "Refer to the data element description in FrntSideRdrLeDetn1 with the same data element name.";
CM_ SG_ 340 FrntSideRdrLeDetn113RdrDetnElevn "Refer to the data element description in FrntSideRdrLeDetn1 with the same data element name.";
CM_ SG_ 340 FrntSideRdrLeDetn113RdrDetnPwr "Refer to the data element description in FrntSideRdrLeDetn1 with the same data element name.";
CM_ SG_ 340 FrntSideRdrLeDetn113RdrDetnRng "Refer to the data element description in FrntSideRdrLeDetn1 with the same data element name.";
CM_ SG_ 340 FrntSideRdrLeDetn113RdrDetnRngV "Range Velocity";
CM_ SG_ 340 FrntSideRdrLeDetn113RdrDetnSts "Refer to the data element description in FrntSideRdrLeDetn1 with the same data element name.";
CM_ SG_ 340 FrntSideRdrLeDetn114RdrDetnAzi "Refer to the data element description in FrntSideRdrLeDetn1 with the same data element name.";
CM_ SG_ 340 FrntSideRdrLeDetn114RdrDetnChks "Refer to the data element description in FrntSideRdrLeDetn1 with the same data element name.";
CM_ SG_ 340 FrntSideRdrLeDetn114RdrDetnCntr "Refer to the data element description in FrntSideRdrLeDetn1 with the same data element name.";
CM_ SG_ 340 FrntSideRdrLeDetn114RdrDetnConf "Refer to the data element description in FrntSideRdrLeDetn1 with the same data element name.";
CM_ SG_ 340 FrntSideRdrLeDetn114RdrDetnElevn "Refer to the data element description in FrntSideRdrLeDetn1 with the same data element name.";
CM_ SG_ 340 FrntSideRdrLeDetn114RdrDetnPwr "Refer to the data element description in FrntSideRdrLeDetn1 with the same data element name.";
CM_ SG_ 340 FrntSideRdrLeDetn114RdrDetnRng "Refer to the data element description in FrntSideRdrLeDetn1 with the same data element name.";
CM_ SG_ 340 FrntSideRdrLeDetn114RdrDetnRngV "Range Velocity";
CM_ SG_ 340 FrntSideRdrLeDetn114RdrDetnSts "Refer to the data element description in FrntSideRdrLeDetn1 with the same data element name.";
CM_ SG_ 342 FrntSideRdrLeDetn115RdrDetnAzi "Refer to the data element description in FrntSideRdrLeDetn1 with the same data element name.";
CM_ SG_ 342 FrntSideRdrLeDetn115RdrDetnChks "Refer to the data element description in FrntSideRdrLeDetn1 with the same data element name.";
CM_ SG_ 342 FrntSideRdrLeDetn115RdrDetnCntr "Refer to the data element description in FrntSideRdrLeDetn1 with the same data element name.";
CM_ SG_ 342 FrntSideRdrLeDetn115RdrDetnConf "Refer to the data element description in FrntSideRdrLeDetn1 with the same data element name.";
CM_ SG_ 342 FrntSideRdrLeDetn115RdrDetnElevn "Refer to the data element description in FrntSideRdrLeDetn1 with the same data element name.";
CM_ SG_ 342 FrntSideRdrLeDetn115RdrDetnPwr "Refer to the data element description in FrntSideRdrLeDetn1 with the same data element name.";
CM_ SG_ 342 FrntSideRdrLeDetn115RdrDetnRng "Refer to the data element description in FrntSideRdrLeDetn1 with the same data element name.";
CM_ SG_ 342 FrntSideRdrLeDetn115RdrDetnRngV "Range Velocity";
CM_ SG_ 342 FrntSideRdrLeDetn115RdrDetnSts "Refer to the data element description in FrntSideRdrLeDetn1 with the same data element name.";
CM_ SG_ 342 FrntSideRdrLeDetn116RdrDetnAzi "Refer to the data element description in FrntSideRdrLeDetn1 with the same data element name.";
CM_ SG_ 342 FrntSideRdrLeDetn116RdrDetnChks "Refer to the data element description in FrntSideRdrLeDetn1 with the same data element name.";
CM_ SG_ 342 FrntSideRdrLeDetn116RdrDetnCntr "Refer to the data element description in FrntSideRdrLeDetn1 with the same data element name.";
CM_ SG_ 342 FrntSideRdrLeDetn116RdrDetnConf "Refer to the data element description in FrntSideRdrLeDetn1 with the same data element name.";
CM_ SG_ 342 FrntSideRdrLeDetn116RdrDetnElevn "Refer to the data element description in FrntSideRdrLeDetn1 with the same data element name.";
CM_ SG_ 342 FrntSideRdrLeDetn116RdrDetnPwr "Refer to the data element description in FrntSideRdrLeDetn1 with the same data element name.";
CM_ SG_ 342 FrntSideRdrLeDetn116RdrDetnRng "Refer to the data element description in FrntSideRdrLeDetn1 with the same data element name.";
CM_ SG_ 342 FrntSideRdrLeDetn116RdrDetnRngV "Range Velocity";
CM_ SG_ 342 FrntSideRdrLeDetn116RdrDetnSts "Refer to the data element description in FrntSideRdrLeDetn1 with the same data element name.";
CM_ SG_ 342 FrntSideRdrLeDetn117RdrDetnAzi "Refer to the data element description in FrntSideRdrLeDetn1 with the same data element name.";
CM_ SG_ 342 FrntSideRdrLeDetn117RdrDetnChks "Refer to the data element description in FrntSideRdrLeDetn1 with the same data element name.";
CM_ SG_ 342 FrntSideRdrLeDetn117RdrDetnCntr "Refer to the data element description in FrntSideRdrLeDetn1 with the same data element name.";
CM_ SG_ 342 FrntSideRdrLeDetn117RdrDetnConf "Refer to the data element description in FrntSideRdrLeDetn1 with the same data element name.";
CM_ SG_ 342 FrntSideRdrLeDetn117RdrDetnElevn "Refer to the data element description in FrntSideRdrLeDetn1 with the same data element name.";
CM_ SG_ 342 FrntSideRdrLeDetn117RdrDetnPwr "Refer to the data element description in FrntSideRdrLeDetn1 with the same data element name.";
CM_ SG_ 342 FrntSideRdrLeDetn117RdrDetnRng "Refer to the data element description in FrntSideRdrLeDetn1 with the same data element name.";
CM_ SG_ 342 FrntSideRdrLeDetn117RdrDetnRngV "Range Velocity";
CM_ SG_ 342 FrntSideRdrLeDetn117RdrDetnSts "Refer to the data element description in FrntSideRdrLeDetn1 with the same data element name.";
CM_ SG_ 342 FrntSideRdrLeDetn118RdrDetnAzi "Refer to the data element description in FrntSideRdrLeDetn1 with the same data element name.";
CM_ SG_ 342 FrntSideRdrLeDetn118RdrDetnChks "Refer to the data element description in FrntSideRdrLeDetn1 with the same data element name.";
CM_ SG_ 342 FrntSideRdrLeDetn118RdrDetnCntr "Refer to the data element description in FrntSideRdrLeDetn1 with the same data element name.";
CM_ SG_ 342 FrntSideRdrLeDetn118RdrDetnConf "Refer to the data element description in FrntSideRdrLeDetn1 with the same data element name.";
CM_ SG_ 342 FrntSideRdrLeDetn118RdrDetnElevn "Refer to the data element description in FrntSideRdrLeDetn1 with the same data element name.";
CM_ SG_ 342 FrntSideRdrLeDetn118RdrDetnPwr "Refer to the data element description in FrntSideRdrLeDetn1 with the same data element name.";
CM_ SG_ 342 FrntSideRdrLeDetn118RdrDetnRng "Refer to the data element description in FrntSideRdrLeDetn1 with the same data element name.";
CM_ SG_ 342 FrntSideRdrLeDetn118RdrDetnRngV "Range Velocity";
CM_ SG_ 342 FrntSideRdrLeDetn118RdrDetnSts "Refer to the data element description in FrntSideRdrLeDetn1 with the same data element name.";
CM_ SG_ 342 FrntSideRdrLeDetn119RdrDetnAzi "Refer to the data element description in FrntSideRdrLeDetn1 with the same data element name.";
CM_ SG_ 342 FrntSideRdrLeDetn119RdrDetnChks "Refer to the data element description in FrntSideRdrLeDetn1 with the same data element name.";
CM_ SG_ 342 FrntSideRdrLeDetn119RdrDetnCntr "Refer to the data element description in FrntSideRdrLeDetn1 with the same data element name.";
CM_ SG_ 342 FrntSideRdrLeDetn119RdrDetnConf "Refer to the data element description in FrntSideRdrLeDetn1 with the same data element name.";
CM_ SG_ 342 FrntSideRdrLeDetn119RdrDetnElevn "Refer to the data element description in FrntSideRdrLeDetn1 with the same data element name.";
CM_ SG_ 342 FrntSideRdrLeDetn119RdrDetnPwr "Refer to the data element description in FrntSideRdrLeDetn1 with the same data element name.";
CM_ SG_ 342 FrntSideRdrLeDetn119RdrDetnRng "Refer to the data element description in FrntSideRdrLeDetn1 with the same data element name.";
CM_ SG_ 342 FrntSideRdrLeDetn119RdrDetnRngV "Range Velocity";
CM_ SG_ 342 FrntSideRdrLeDetn119RdrDetnSts "Refer to the data element description in FrntSideRdrLeDetn1 with the same data element name.";
CM_ SG_ 342 FrntSideRdrLeDetn120RdrDetnAzi "Refer to the data element description in FrntSideRdrLeDetn1 with the same data element name.";
CM_ SG_ 342 FrntSideRdrLeDetn120RdrDetnChks "Refer to the data element description in FrntSideRdrLeDetn1 with the same data element name.";
CM_ SG_ 342 FrntSideRdrLeDetn120RdrDetnCntr "Refer to the data element description in FrntSideRdrLeDetn1 with the same data element name.";
CM_ SG_ 342 FrntSideRdrLeDetn120RdrDetnConf "Refer to the data element description in FrntSideRdrLeDetn1 with the same data element name.";
CM_ SG_ 342 FrntSideRdrLeDetn120RdrDetnElevn "Refer to the data element description in FrntSideRdrLeDetn1 with the same data element name.";
CM_ SG_ 342 FrntSideRdrLeDetn120RdrDetnPwr "Refer to the data element description in FrntSideRdrLeDetn1 with the same data element name.";
CM_ SG_ 342 FrntSideRdrLeDetn120RdrDetnRng "Refer to the data element description in FrntSideRdrLeDetn1 with the same data element name.";
CM_ SG_ 342 FrntSideRdrLeDetn120RdrDetnRngV "Range Velocity";
CM_ SG_ 342 FrntSideRdrLeDetn120RdrDetnSts "Refer to the data element description in FrntSideRdrLeDetn1 with the same data element name.";
CM_ SG_ 344 FrntSideRdrLeDetn121RdrDetnAzi "Refer to the data element description in FrntSideRdrLeDetn1 with the same data element name.";
CM_ SG_ 344 FrntSideRdrLeDetn121RdrDetnChks "Refer to the data element description in FrntSideRdrLeDetn1 with the same data element name.";
CM_ SG_ 344 FrntSideRdrLeDetn121RdrDetnCntr "Refer to the data element description in FrntSideRdrLeDetn1 with the same data element name.";
CM_ SG_ 344 FrntSideRdrLeDetn121RdrDetnConf "Refer to the data element description in FrntSideRdrLeDetn1 with the same data element name.";
CM_ SG_ 344 FrntSideRdrLeDetn121RdrDetnElevn "Refer to the data element description in FrntSideRdrLeDetn1 with the same data element name.";
CM_ SG_ 344 FrntSideRdrLeDetn121RdrDetnPwr "Refer to the data element description in FrntSideRdrLeDetn1 with the same data element name.";
CM_ SG_ 344 FrntSideRdrLeDetn121RdrDetnRng "Refer to the data element description in FrntSideRdrLeDetn1 with the same data element name.";
CM_ SG_ 344 FrntSideRdrLeDetn121RdrDetnRngV "Range Velocity";
CM_ SG_ 344 FrntSideRdrLeDetn121RdrDetnSts "Refer to the data element description in FrntSideRdrLeDetn1 with the same data element name.";
CM_ SG_ 344 FrntSideRdrLeDetn122RdrDetnAzi "Refer to the data element description in FrntSideRdrLeDetn1 with the same data element name.";
CM_ SG_ 344 FrntSideRdrLeDetn122RdrDetnChks "Refer to the data element description in FrntSideRdrLeDetn1 with the same data element name.";
CM_ SG_ 344 FrntSideRdrLeDetn122RdrDetnCntr "Refer to the data element description in FrntSideRdrLeDetn1 with the same data element name.";
CM_ SG_ 344 FrntSideRdrLeDetn122RdrDetnConf "Refer to the data element description in FrntSideRdrLeDetn1 with the same data element name.";
CM_ SG_ 344 FrntSideRdrLeDetn122RdrDetnElevn "Refer to the data element description in FrntSideRdrLeDetn1 with the same data element name.";
CM_ SG_ 344 FrntSideRdrLeDetn122RdrDetnPwr "Refer to the data element description in FrntSideRdrLeDetn1 with the same data element name.";
CM_ SG_ 344 FrntSideRdrLeDetn122RdrDetnRng "Refer to the data element description in FrntSideRdrLeDetn1 with the same data element name.";
CM_ SG_ 344 FrntSideRdrLeDetn122RdrDetnRngV "Range Velocity";
CM_ SG_ 344 FrntSideRdrLeDetn122RdrDetnSts "Refer to the data element description in FrntSideRdrLeDetn1 with the same data element name.";
CM_ SG_ 344 FrntSideRdrLeDetn123RdrDetnAzi "Refer to the data element description in FrntSideRdrLeDetn1 with the same data element name.";
CM_ SG_ 344 FrntSideRdrLeDetn123RdrDetnChks "Refer to the data element description in FrntSideRdrLeDetn1 with the same data element name.";
CM_ SG_ 344 FrntSideRdrLeDetn123RdrDetnCntr "Refer to the data element description in FrntSideRdrLeDetn1 with the same data element name.";
CM_ SG_ 344 FrntSideRdrLeDetn123RdrDetnConf "Refer to the data element description in FrntSideRdrLeDetn1 with the same data element name.";
CM_ SG_ 344 FrntSideRdrLeDetn123RdrDetnElevn "Refer to the data element description in FrntSideRdrLeDetn1 with the same data element name.";
CM_ SG_ 344 FrntSideRdrLeDetn123RdrDetnPwr "Refer to the data element description in FrntSideRdrLeDetn1 with the same data element name.";
CM_ SG_ 344 FrntSideRdrLeDetn123RdrDetnRng "Refer to the data element description in FrntSideRdrLeDetn1 with the same data element name.";
CM_ SG_ 344 FrntSideRdrLeDetn123RdrDetnRngV "Range Velocity";
CM_ SG_ 344 FrntSideRdrLeDetn123RdrDetnSts "Refer to the data element description in FrntSideRdrLeDetn1 with the same data element name.";
CM_ SG_ 344 FrntSideRdrLeDetn124RdrDetnAzi "Refer to the data element description in FrntSideRdrLeDetn1 with the same data element name.";
CM_ SG_ 344 FrntSideRdrLeDetn124RdrDetnChks "Refer to the data element description in FrntSideRdrLeDetn1 with the same data element name.";
CM_ SG_ 344 FrntSideRdrLeDetn124RdrDetnCntr "Refer to the data element description in FrntSideRdrLeDetn1 with the same data element name.";
CM_ SG_ 344 FrntSideRdrLeDetn124RdrDetnConf "Refer to the data element description in FrntSideRdrLeDetn1 with the same data element name.";
CM_ SG_ 344 FrntSideRdrLeDetn124RdrDetnElevn "Refer to the data element description in FrntSideRdrLeDetn1 with the same data element name.";
CM_ SG_ 344 FrntSideRdrLeDetn124RdrDetnPwr "Refer to the data element description in FrntSideRdrLeDetn1 with the same data element name.";
CM_ SG_ 344 FrntSideRdrLeDetn124RdrDetnRng "Refer to the data element description in FrntSideRdrLeDetn1 with the same data element name.";
CM_ SG_ 344 FrntSideRdrLeDetn124RdrDetnRngV "Range Velocity";
CM_ SG_ 344 FrntSideRdrLeDetn124RdrDetnSts "Refer to the data element description in FrntSideRdrLeDetn1 with the same data element name.";
CM_ SG_ 344 FrntSideRdrLeDetn125RdrDetnAzi "Refer to the data element description in FrntSideRdrLeDetn1 with the same data element name.";
CM_ SG_ 344 FrntSideRdrLeDetn125RdrDetnChks "Refer to the data element description in FrntSideRdrLeDetn1 with the same data element name.";
CM_ SG_ 344 FrntSideRdrLeDetn125RdrDetnCntr "Refer to the data element description in FrntSideRdrLeDetn1 with the same data element name.";
CM_ SG_ 344 FrntSideRdrLeDetn125RdrDetnConf "Refer to the data element description in FrntSideRdrLeDetn1 with the same data element name.";
CM_ SG_ 344 FrntSideRdrLeDetn125RdrDetnElevn "Refer to the data element description in FrntSideRdrLeDetn1 with the same data element name.";
CM_ SG_ 344 FrntSideRdrLeDetn125RdrDetnPwr "Refer to the data element description in FrntSideRdrLeDetn1 with the same data element name.";
CM_ SG_ 344 FrntSideRdrLeDetn125RdrDetnRng "Refer to the data element description in FrntSideRdrLeDetn1 with the same data element name.";
CM_ SG_ 344 FrntSideRdrLeDetn125RdrDetnRngV "Range Velocity";
CM_ SG_ 344 FrntSideRdrLeDetn125RdrDetnSts "Refer to the data element description in FrntSideRdrLeDetn1 with the same data element name.";
CM_ SG_ 344 FrntSideRdrLeDetn126RdrDetnAzi "Refer to the data element description in FrntSideRdrLeDetn1 with the same data element name.";
CM_ SG_ 344 FrntSideRdrLeDetn126RdrDetnChks "Refer to the data element description in FrntSideRdrLeDetn1 with the same data element name.";
CM_ SG_ 344 FrntSideRdrLeDetn126RdrDetnCntr "Refer to the data element description in FrntSideRdrLeDetn1 with the same data element name.";
CM_ SG_ 344 FrntSideRdrLeDetn126RdrDetnConf "Refer to the data element description in FrntSideRdrLeDetn1 with the same data element name.";
CM_ SG_ 344 FrntSideRdrLeDetn126RdrDetnElevn "Refer to the data element description in FrntSideRdrLeDetn1 with the same data element name.";
CM_ SG_ 344 FrntSideRdrLeDetn126RdrDetnPwr "Refer to the data element description in FrntSideRdrLeDetn1 with the same data element name.";
CM_ SG_ 344 FrntSideRdrLeDetn126RdrDetnRng "Refer to the data element description in FrntSideRdrLeDetn1 with the same data element name.";
CM_ SG_ 344 FrntSideRdrLeDetn126RdrDetnRngV "Range Velocity";
CM_ SG_ 344 FrntSideRdrLeDetn126RdrDetnSts "Refer to the data element description in FrntSideRdrLeDetn1 with the same data element name.";
CM_ SG_ 346 FrntSideRdrLeDetn127RdrDetnAzi "Refer to the data element description in FrntSideRdrLeDetn1 with the same data element name.";
CM_ SG_ 346 FrntSideRdrLeDetn127RdrDetnChks "Refer to the data element description in FrntSideRdrLeDetn1 with the same data element name.";
CM_ SG_ 346 FrntSideRdrLeDetn127RdrDetnCntr "Refer to the data element description in FrntSideRdrLeDetn1 with the same data element name.";
CM_ SG_ 346 FrntSideRdrLeDetn127RdrDetnConf "Refer to the data element description in FrntSideRdrLeDetn1 with the same data element name.";
CM_ SG_ 346 FrntSideRdrLeDetn127RdrDetnElevn "Refer to the data element description in FrntSideRdrLeDetn1 with the same data element name.";
CM_ SG_ 346 FrntSideRdrLeDetn127RdrDetnPwr "Refer to the data element description in FrntSideRdrLeDetn1 with the same data element name.";
CM_ SG_ 346 FrntSideRdrLeDetn127RdrDetnRng "Refer to the data element description in FrntSideRdrLeDetn1 with the same data element name.";
CM_ SG_ 346 FrntSideRdrLeDetn127RdrDetnRngV "Range Velocity";
CM_ SG_ 346 FrntSideRdrLeDetn127RdrDetnSts "Refer to the data element description in FrntSideRdrLeDetn1 with the same data element name.";
CM_ SG_ 346 FrntSideRdrLeDetn128RdrDetnAzi "Refer to the data element description in FrntSideRdrLeDetn1 with the same data element name.";
CM_ SG_ 346 FrntSideRdrLeDetn128RdrDetnChks "Refer to the data element description in FrntSideRdrLeDetn1 with the same data element name.";
CM_ SG_ 346 FrntSideRdrLeDetn128RdrDetnCntr "Refer to the data element description in FrntSideRdrLeDetn1 with the same data element name.";
CM_ SG_ 346 FrntSideRdrLeDetn128RdrDetnConf "Refer to the data element description in FrntSideRdrLeDetn1 with the same data element name.";
CM_ SG_ 346 FrntSideRdrLeDetn128RdrDetnElevn "Refer to the data element description in FrntSideRdrLeDetn1 with the same data element name.";
CM_ SG_ 346 FrntSideRdrLeDetn128RdrDetnPwr "Refer to the data element description in FrntSideRdrLeDetn1 with the same data element name.";
CM_ SG_ 346 FrntSideRdrLeDetn128RdrDetnRng "Refer to the data element description in FrntSideRdrLeDetn1 with the same data element name.";
CM_ SG_ 346 FrntSideRdrLeDetn128RdrDetnRngV "Range Velocity";
CM_ SG_ 346 FrntSideRdrLeDetn128RdrDetnSts "Refer to the data element description in FrntSideRdrLeDetn1 with the same data element name.";
CM_ SG_ 348 FrntSideRdrLeObj1Heading "Heading angle";
CM_ SG_ 348 FrntSideRdrLeObj1ObjBoxCenterLat "Box center y coordinate (relative closest point)";
CM_ SG_ 348 FrntSideRdrLeObj1ObjBoxCenterLgt "Box center x coordinate (relative closest point)";
CM_ SG_ 348 FrntSideRdrLeObj1ObservationHist "The result of target association in each cycle, if target is associated,the bit value should be 1, if not,the bit value should be 0.there are 32 bits";
CM_ SG_ 348 FrntSideRdrLeObj1QualityBits "Reserved. If this signal is needed, it means: Signal to illustrate radar object detailed status.";
CM_ SG_ 348 FrntSideRdrLeObj1RdrObjAx "Longitudinal acceleration";
CM_ SG_ 348 FrntSideRdrLeObj1RdrObjAy "Lateral acceleration";
CM_ SG_ 348 FrntSideRdrLeObj1RdrObjBoxLength "Box length (box extent that is parallel to objects heading angle)";
CM_ SG_ 348 FrntSideRdrLeObj1RdrObjBoxWidth "Box width (box extent that is perpendicular to objects heading angle)";
CM_ SG_ 348 FrntSideRdrLeObj1RdrObjChks "CRC";
CM_ SG_ 348 FrntSideRdrLeObj1RdrObjCntr "Counter";
CM_ SG_ 348 FrntSideRdrLeObj1RdrObjCoastCnt "Number of cycles during which the object is not associated to anything";
CM_ SG_ 348 FrntSideRdrLeObj1RdrObjConf "Confidence";
CM_ SG_ 348 FrntSideRdrLeObj1RdrObjDx "Longitudinal position";
CM_ SG_ 348 FrntSideRdrLeObj1RdrObjDxStdDe "Standard deviation longitudinal position";
CM_ SG_ 348 FrntSideRdrLeObj1RdrObjDy "Lateral position";
CM_ SG_ 348 FrntSideRdrLeObj1RdrObjDyStdDe " Standard deviation lateral position";
CM_ SG_ 348 FrntSideRdrLeObj1RdrObjElevnConf "Elevation confidence";
CM_ SG_ 348 FrntSideRdrLeObj1RdrObjElevnSts "Elevation Status";
CM_ SG_ 348 FrntSideRdrLeObj1RdrObjID "Object ID";
CM_ SG_ 348 FrntSideRdrLeObj1RdrObjIsInFreeSpace "Indication if the object is inside freespace";
CM_ SG_ 348 FrntSideRdrLeObj1RdrObjMirrProblty "Probability of mirrored object";
CM_ SG_ 348 FrntSideRdrLeObj1RdrObjMtnPat "Object Motion Pattern (crossing, receding and oncoming) is not used here, as reserved)";
CM_ SG_ 348 FrntSideRdrLeObj1RdrObjNotRealProblty "Probability of ghost track";
CM_ SG_ 348 FrntSideRdrLeObj1RdrObjStatyCnt "Stationary Count";
CM_ SG_ 348 FrntSideRdrLeObj1RdrObjTiAlv "Lifetime";
CM_ SG_ 348 FrntSideRdrLeObj1RdrObjTrackSts "Track Status 0. it is not a valid track 1. the track has been updated 2. the track is new 3. the track is coasted (means the result is a prediction and that there was no detected measurement in the current look interval";
CM_ SG_ 348 FrntSideRdrLeObj1RdrObjTyp "Classification object (Only 0 Unkown, 4 Pedestrain, 9 Bicycle and 10 Vehicle of unknown class are used actually in radar, the other types are not used but the datatype is designed so that it can be reused with camera";
CM_ SG_ 348 FrntSideRdrLeObj1RdrObjTypConfBike "Confidence of tracked object type classification bike";
CM_ SG_ 348 FrntSideRdrLeObj1RdrObjTypConfPed "Confidence of tracked object type classification pedestrian";
CM_ SG_ 348 FrntSideRdrLeObj1RdrObjTypConfVeh "Confidence of tracked object type classification vehicle";
CM_ SG_ 348 FrntSideRdrLeObj1RdrObjUsedTracker "Reserved. If this signal is needed, it means: Assist to identify motion pattern. Better solution for stationary object.";
CM_ SG_ 348 FrntSideRdrLeObj1RdrObjVx "Longitudinal velocity";
CM_ SG_ 348 FrntSideRdrLeObj1RdrObjVxStdDe " Standard deviation longitudinal velocity";
CM_ SG_ 348 FrntSideRdrLeObj1RdrObjVy "Lateral velocity";
CM_ SG_ 348 FrntSideRdrLeObj1RdrObjVyStdDe "Standard deviation lateral velocity";
CM_ SG_ 348 FrntSideRdrLeObj1RelVx "Relative velocity in X";
CM_ SG_ 348 FrntSideRdrLeObj1RelVy "Relative velocity in Y
";
CM_ SG_ 350 FrntSideRdrLeObj2Heading "Refer to the data element description in FrntSideRdrLeObj1 with the same data element name.";
CM_ SG_ 350 FrntSideRdrLeObj2ObjBoxCenterLat "Box center y coordinate (relative closest point)";
CM_ SG_ 350 FrntSideRdrLeObj2ObjBoxCenterLgt "Box center x coordinate (relative closest point)";
CM_ SG_ 350 FrntSideRdrLeObj2ObservationHist "Refer to the data element description in FrntSideRdrLeObj1 with the same data element name.";
CM_ SG_ 350 FrntSideRdrLeObj2QualityBits "Refer to the data element description in FrntSideRdrLeObj1 with the same data element name.";
CM_ SG_ 350 FrntSideRdrLeObj2RdrObjAx "Refer to the data element description in FrntSideRdrLeObj1 with the same data element name.";
CM_ SG_ 350 FrntSideRdrLeObj2RdrObjAy "Refer to the data element description in FrntSideRdrLeObj1 with the same data element name.";
CM_ SG_ 350 FrntSideRdrLeObj2RdrObjBoxLength "Box length (box extent that is parallel to objects heading angle)";
CM_ SG_ 350 FrntSideRdrLeObj2RdrObjBoxWidth "Box width (box extent that is perpendicular to objects heading angle)";
CM_ SG_ 350 FrntSideRdrLeObj2RdrObjChks "Refer to the data element description in FrntSideRdrLeObj1 with the same data element name.";
CM_ SG_ 350 FrntSideRdrLeObj2RdrObjCntr "Refer to the data element description in FrntSideRdrLeObj1 with the same data element name.";
CM_ SG_ 350 FrntSideRdrLeObj2RdrObjCoastCnt "Refer to the data element description in FrntSideRdrLeObj1 with the same data element name.";
CM_ SG_ 350 FrntSideRdrLeObj2RdrObjConf "Refer to the data element description in FrntSideRdrLeObj1 with the same data element name.";
CM_ SG_ 350 FrntSideRdrLeObj2RdrObjDx "Refer to the data element description in FrntSideRdrLeObj1 with the same data element name.";
CM_ SG_ 350 FrntSideRdrLeObj2RdrObjDxStdDe "Refer to the data element description in FrntSideRdrLeObj1 with the same data element name.";
CM_ SG_ 350 FrntSideRdrLeObj2RdrObjDy "Refer to the data element description in FrntSideRdrLeObj1 with the same data element name.";
CM_ SG_ 350 FrntSideRdrLeObj2RdrObjDyStdDe "Refer to the data element description in FrntSideRdrLeObj1 with the same data element name.";
CM_ SG_ 350 FrntSideRdrLeObj2RdrObjElevnConf "Refer to the data element description in FrntSideRdrLeObj1 with the same data element name.";
CM_ SG_ 350 FrntSideRdrLeObj2RdrObjElevnSts "Refer to the data element description in FrntSideRdrLeObj1 with the same data element name.";
CM_ SG_ 350 FrntSideRdrLeObj2RdrObjID "Refer to the data element description in FrntSideRdrLeObj1 with the same data element name.";
CM_ SG_ 350 FrntSideRdrLeObj2RdrObjIsInFreeSpace "Refer to the data element description in FrntSideRdrLeObj1 with the same data element name.";
CM_ SG_ 350 FrntSideRdrLeObj2RdrObjMirrProblty "Refer to the data element description in FrntSideRdrLeObj1 with the same data element name.";
CM_ SG_ 350 FrntSideRdrLeObj2RdrObjMtnPat "Refer to the data element description in FrntSideRdrLeObj1 with the same data element name.";
CM_ SG_ 350 FrntSideRdrLeObj2RdrObjNotRealProblty "Refer to the data element description in FrntSideRdrLeObj1 with the same data element name.";
CM_ SG_ 350 FrntSideRdrLeObj2RdrObjStatyCnt "Refer to the data element description in FrntSideRdrLeObj1 with the same data element name.";
CM_ SG_ 350 FrntSideRdrLeObj2RdrObjTiAlv "Refer to the data element description in FrntSideRdrLeObj1 with the same data element name.";
CM_ SG_ 350 FrntSideRdrLeObj2RdrObjTrackSts "Refer to the data element description in FrntSideRdrLeObj1 with the same data element name.";
CM_ SG_ 350 FrntSideRdrLeObj2RdrObjTyp "Refer to the data element description in FrntSideRdrLeObj1 with the same data element name.";
CM_ SG_ 350 FrntSideRdrLeObj2RdrObjTypConfBike "Refer to the data element description in FrntSideRdrLeObj1 with the same data element name.";
CM_ SG_ 350 FrntSideRdrLeObj2RdrObjTypConfPed "Refer to the data element description in FrntSideRdrLeObj1 with the same data element name.";
CM_ SG_ 350 FrntSideRdrLeObj2RdrObjTypConfVeh "Refer to the data element description in FrntSideRdrLeObj1 with the same data element name.";
CM_ SG_ 350 FrntSideRdrLeObj2RdrObjUsedTracker "Refer to the data element description in FrntSideRdrLeObj1 with the same data element name.";
CM_ SG_ 350 FrntSideRdrLeObj2RdrObjVx "Refer to the data element description in FrntSideRdrLeObj1 with the same data element name.";
CM_ SG_ 350 FrntSideRdrLeObj2RdrObjVxStdDe "Refer to the data element description in FrntSideRdrLeObj1 with the same data element name.";
CM_ SG_ 350 FrntSideRdrLeObj2RdrObjVy "Refer to the data element description in FrntSideRdrLeObj1 with the same data element name.";
CM_ SG_ 350 FrntSideRdrLeObj2RdrObjVyStdDe "Refer to the data element description in FrntSideRdrLeObj1 with the same data element name.";
CM_ SG_ 350 FrntSideRdrLeObj2RelVx "Refer to the data element description in FrntSideRdrLeObj1 with the same data element name.";
CM_ SG_ 350 FrntSideRdrLeObj2RelVy "Refer to the data element description in FrntSideRdrLeObj1 with the same data element name.";
BA_DEF_ BO_ "CANFD_BRS" ENUM "0","1";
BA_DEF_ BO_ "GenMsgCycleTime" INT 0 65536; // [ms]
BA_DEF_ BO_ "GenMsgDelayTime" INT 0 65536; // [ms]
BA_DEF_ BO_ "GenMsgSendType" ENUM "cyclic", "spontaneous", "not-used", "not-used", "not-used", "cyclicAndSpontaneous", "not-used", "cyclicIfActive", "NoMsgSendType"; // [us]
BA_DEF_ BO_ "GenMsgStartDelayTime" INT 0 65536; // [ms]
BA_DEF_ BO_ "VFrameFormat" ENUM "StandardCAN","ExtendedCAN","reserved","J1939PG","reserved","reserved","reserved","reserved","reserved","reserved","reserved","reserved","reserved","reserved","StandardCAN_FD","ExtendedCAN_FD";
BA_DEF_ SG_ "GenSigSendType" ENUM "Cyclic","OnWrite","OnWriteWithRepetition","OnChange","OnChangeWithRepetition","IfActive","IfActiveWithRepetition","NoSigSendType";
BA_DEF_ SG_ "GenSigStartValue" HEX 0 80000000;
BA_DEF_ BO_ "GenMsgILSupport" ENUM "No","Yes";
BA_DEF_ BO_ "NmAsrMessage" ENUM "No","Yes";
BA_DEF_ SG_ "GenSigFuncType" ENUM "NoFunction","n/a","n/a","n/a","n/a","n/a","n/a","n/a","n/a","n/a","n/a","n/a","n/a","n/a","n/a","CHK","CNTR","n/a","n/a","n/a","CNTR_AR_01","CRC_AR_01_BOTH","CRC_AR_01_ALT","CRC_AR_01_LOW","CRC_AR_01_NIBBLE","CNTR_AR_04","CRC_AR_04A","CNTR_AR_05","CRC_AR_05";
BA_DEF_ SG_ "GenSigDataID" STRING;
BA_DEF_DEF_ "CANFD_BRS" "1";
BA_DEF_DEF_ "GenSigStartValue" 0;
BA_DEF_DEF_ "VFrameFormat" "J1939PG";
BA_DEF_DEF_ "GenSigSendType" "NoSigSendType";
BA_DEF_DEF_ "GenMsgCycleTime" 0;
BA_DEF_DEF_ "GenMsgDelayTime" 0;
BA_DEF_DEF_ "GenMsgStartDelayTime" 0;
BA_DEF_DEF_ "GenMsgSendType" "NoMsgSendType";
BA_DEF_DEF_ "GenMsgILSupport" "Yes";
BA_DEF_DEF_ "NmAsrMessage" "No";
BA_DEF_DEF_ "GenSigFuncType" "NoFunction";
BA_DEF_DEF_ "GenSigDataID" "";
// Frame: FSRLSafetyCANFD1Frame15
BA_ "GenMsgCycleTime" BO_ 332 50.000;
BA_ "GenMsgSendType" BO_ 332 0;
BA_ "VFrameFormat" BO_ 332 14;
// Frame: FSRLSafetyCANFD1Frame16
BA_ "GenMsgCycleTime" BO_ 334 50.000;
BA_ "GenMsgSendType" BO_ 334 0;
BA_ "VFrameFormat" BO_ 334 14;
// Frame: FSRLSafetyCANFD1Frame17
BA_ "GenMsgCycleTime" BO_ 336 50.000;
BA_ "GenMsgSendType" BO_ 336 0;
BA_ "VFrameFormat" BO_ 336 14;
// Frame: FSRLSafetyCANFD1Frame18
BA_ "GenMsgCycleTime" BO_ 338 50.000;
BA_ "GenMsgSendType" BO_ 338 0;
BA_ "VFrameFormat" BO_ 338 14;
// Frame: FSRLSafetyCANFD1Frame19
BA_ "GenMsgCycleTime" BO_ 340 50.000;
BA_ "GenMsgSendType" BO_ 340 0;
BA_ "VFrameFormat" BO_ 340 14;
// Frame: FSRLSafetyCANFD1Frame20
BA_ "GenMsgCycleTime" BO_ 342 50.000;
BA_ "GenMsgSendType" BO_ 342 0;
BA_ "VFrameFormat" BO_ 342 14;
// Frame: FSRLSafetyCANFD1Frame21
BA_ "GenMsgCycleTime" BO_ 344 50.000;
BA_ "GenMsgSendType" BO_ 344 0;
BA_ "VFrameFormat" BO_ 344 14;
// Frame: FSRLSafetyCANFD1Frame22
BA_ "GenMsgCycleTime" BO_ 346 50.000;
BA_ "GenMsgSendType" BO_ 346 0;
BA_ "VFrameFormat" BO_ 346 14;
// Frame: FSRLSafetyCANFD1Frame23
BA_ "GenMsgCycleTime" BO_ 348 50.000;
BA_ "GenMsgSendType" BO_ 348 0;
BA_ "VFrameFormat" BO_ 348 14;
// Frame: FSRLSafetyCANFD1Frame24
BA_ "GenMsgCycleTime" BO_ 350 50.000;
BA_ "GenMsgSendType" BO_ 350 0;
BA_ "VFrameFormat" BO_ 350 14;
BA_ "GenSigSendType" SG_ 336 FrntSideRdrLeDetn100RdrDetnAzi 0;
BA_ "GenSigStartValue" SG_ 336 FrntSideRdrLeDetn100RdrDetnAzi 900;
BA_ "GenSigDataID" SG_ 336 FrntSideRdrLeDetn100RdrDetnChks "0x897";
BA_ "GenSigFuncType" SG_ 336 FrntSideRdrLeDetn100RdrDetnChks 15;
BA_ "GenSigSendType" SG_ 336 FrntSideRdrLeDetn100RdrDetnChks 0;
BA_ "GenSigFuncType" SG_ 336 FrntSideRdrLeDetn100RdrDetnCntr 16;
BA_ "GenSigSendType" SG_ 336 FrntSideRdrLeDetn100RdrDetnCntr 0;
BA_ "GenSigSendType" SG_ 336 FrntSideRdrLeDetn100RdrDetnConf 0;
BA_ "GenSigSendType" SG_ 336 FrntSideRdrLeDetn100RdrDetnElevn 0;
BA_ "GenSigStartValue" SG_ 336 FrntSideRdrLeDetn100RdrDetnElevn 15;
BA_ "GenSigSendType" SG_ 336 FrntSideRdrLeDetn100RdrDetnPwr 0;
BA_ "GenSigSendType" SG_ 336 FrntSideRdrLeDetn100RdrDetnRng 0;
BA_ "GenSigStartValue" SG_ 336 FrntSideRdrLeDetn100RdrDetnRng 10050;
BA_ "GenSigSendType" SG_ 336 FrntSideRdrLeDetn100RdrDetnRngV 0;
BA_ "GenSigStartValue" SG_ 336 FrntSideRdrLeDetn100RdrDetnRngV 4000;
BA_ "GenSigSendType" SG_ 336 FrntSideRdrLeDetn100RdrDetnSts 0;
BA_ "GenSigStartValue" SG_ 336 FrntSideRdrLeDetn100RdrDetnSts 3;
BA_ "GenSigSendType" SG_ 336 FrntSideRdrLeDetn101RdrDetnAzi 0;
BA_ "GenSigStartValue" SG_ 336 FrntSideRdrLeDetn101RdrDetnAzi 900;
BA_ "GenSigDataID" SG_ 336 FrntSideRdrLeDetn101RdrDetnChks "0x898";
BA_ "GenSigFuncType" SG_ 336 FrntSideRdrLeDetn101RdrDetnChks 15;
BA_ "GenSigSendType" SG_ 336 FrntSideRdrLeDetn101RdrDetnChks 0;
BA_ "GenSigFuncType" SG_ 336 FrntSideRdrLeDetn101RdrDetnCntr 16;
BA_ "GenSigSendType" SG_ 336 FrntSideRdrLeDetn101RdrDetnCntr 0;
BA_ "GenSigSendType" SG_ 336 FrntSideRdrLeDetn101RdrDetnConf 0;
BA_ "GenSigSendType" SG_ 336 FrntSideRdrLeDetn101RdrDetnElevn 0;
BA_ "GenSigStartValue" SG_ 336 FrntSideRdrLeDetn101RdrDetnElevn 15;
BA_ "GenSigSendType" SG_ 336 FrntSideRdrLeDetn101RdrDetnPwr 0;
BA_ "GenSigSendType" SG_ 336 FrntSideRdrLeDetn101RdrDetnRng 0;
BA_ "GenSigStartValue" SG_ 336 FrntSideRdrLeDetn101RdrDetnRng 10050;
BA_ "GenSigSendType" SG_ 336 FrntSideRdrLeDetn101RdrDetnRngV 0;
BA_ "GenSigStartValue" SG_ 336 FrntSideRdrLeDetn101RdrDetnRngV 4000;
BA_ "GenSigSendType" SG_ 336 FrntSideRdrLeDetn101RdrDetnSts 0;
BA_ "GenSigStartValue" SG_ 336 FrntSideRdrLeDetn101RdrDetnSts 3;
BA_ "GenSigSendType" SG_ 336 FrntSideRdrLeDetn102RdrDetnAzi 0;
BA_ "GenSigStartValue" SG_ 336 FrntSideRdrLeDetn102RdrDetnAzi 900;
BA_ "GenSigDataID" SG_ 336 FrntSideRdrLeDetn102RdrDetnChks "0x899";
BA_ "GenSigFuncType" SG_ 336 FrntSideRdrLeDetn102RdrDetnChks 15;
BA_ "GenSigSendType" SG_ 336 FrntSideRdrLeDetn102RdrDetnChks 0;
BA_ "GenSigFuncType" SG_ 336 FrntSideRdrLeDetn102RdrDetnCntr 16;
BA_ "GenSigSendType" SG_ 336 FrntSideRdrLeDetn102RdrDetnCntr 0;
BA_ "GenSigSendType" SG_ 336 FrntSideRdrLeDetn102RdrDetnConf 0;
BA_ "GenSigSendType" SG_ 336 FrntSideRdrLeDetn102RdrDetnElevn 0;
BA_ "GenSigStartValue" SG_ 336 FrntSideRdrLeDetn102RdrDetnElevn 15;
BA_ "GenSigSendType" SG_ 336 FrntSideRdrLeDetn102RdrDetnPwr 0;
BA_ "GenSigSendType" SG_ 336 FrntSideRdrLeDetn102RdrDetnRng 0;
BA_ "GenSigStartValue" SG_ 336 FrntSideRdrLeDetn102RdrDetnRng 10050;
BA_ "GenSigSendType" SG_ 336 FrntSideRdrLeDetn102RdrDetnRngV 0;
BA_ "GenSigStartValue" SG_ 336 FrntSideRdrLeDetn102RdrDetnRngV 4000;
BA_ "GenSigSendType" SG_ 336 FrntSideRdrLeDetn102RdrDetnSts 0;
BA_ "GenSigStartValue" SG_ 336 FrntSideRdrLeDetn102RdrDetnSts 3;
BA_ "GenSigSendType" SG_ 338 FrntSideRdrLeDetn103RdrDetnAzi 0;
BA_ "GenSigStartValue" SG_ 338 FrntSideRdrLeDetn103RdrDetnAzi 900;
BA_ "GenSigDataID" SG_ 338 FrntSideRdrLeDetn103RdrDetnChks "0x89A";
BA_ "GenSigFuncType" SG_ 338 FrntSideRdrLeDetn103RdrDetnChks 15;
BA_ "GenSigSendType" SG_ 338 FrntSideRdrLeDetn103RdrDetnChks 0;
BA_ "GenSigFuncType" SG_ 338 FrntSideRdrLeDetn103RdrDetnCntr 16;
BA_ "GenSigSendType" SG_ 338 FrntSideRdrLeDetn103RdrDetnCntr 0;
BA_ "GenSigSendType" SG_ 338 FrntSideRdrLeDetn103RdrDetnConf 0;
BA_ "GenSigSendType" SG_ 338 FrntSideRdrLeDetn103RdrDetnElevn 0;
BA_ "GenSigStartValue" SG_ 338 FrntSideRdrLeDetn103RdrDetnElevn 15;
BA_ "GenSigSendType" SG_ 338 FrntSideRdrLeDetn103RdrDetnPwr 0;
BA_ "GenSigSendType" SG_ 338 FrntSideRdrLeDetn103RdrDetnRng 0;
BA_ "GenSigStartValue" SG_ 338 FrntSideRdrLeDetn103RdrDetnRng 10050;
BA_ "GenSigSendType" SG_ 338 FrntSideRdrLeDetn103RdrDetnRngV 0;
BA_ "GenSigStartValue" SG_ 338 FrntSideRdrLeDetn103RdrDetnRngV 4000;
BA_ "GenSigSendType" SG_ 338 FrntSideRdrLeDetn103RdrDetnSts 0;
BA_ "GenSigStartValue" SG_ 338 FrntSideRdrLeDetn103RdrDetnSts 3;
BA_ "GenSigSendType" SG_ 338 FrntSideRdrLeDetn104RdrDetnAzi 0;
BA_ "GenSigStartValue" SG_ 338 FrntSideRdrLeDetn104RdrDetnAzi 900;
BA_ "GenSigDataID" SG_ 338 FrntSideRdrLeDetn104RdrDetnChks "0x89B";
BA_ "GenSigFuncType" SG_ 338 FrntSideRdrLeDetn104RdrDetnChks 15;
BA_ "GenSigSendType" SG_ 338 FrntSideRdrLeDetn104RdrDetnChks 0;
BA_ "GenSigFuncType" SG_ 338 FrntSideRdrLeDetn104RdrDetnCntr 16;
BA_ "GenSigSendType" SG_ 338 FrntSideRdrLeDetn104RdrDetnCntr 0;
BA_ "GenSigSendType" SG_ 338 FrntSideRdrLeDetn104RdrDetnConf 0;
BA_ "GenSigSendType" SG_ 338 FrntSideRdrLeDetn104RdrDetnElevn 0;
BA_ "GenSigStartValue" SG_ 338 FrntSideRdrLeDetn104RdrDetnElevn 15;
BA_ "GenSigSendType" SG_ 338 FrntSideRdrLeDetn104RdrDetnPwr 0;
BA_ "GenSigSendType" SG_ 338 FrntSideRdrLeDetn104RdrDetnRng 0;
BA_ "GenSigStartValue" SG_ 338 FrntSideRdrLeDetn104RdrDetnRng 10050;
BA_ "GenSigSendType" SG_ 338 FrntSideRdrLeDetn104RdrDetnRngV 0;
BA_ "GenSigStartValue" SG_ 338 FrntSideRdrLeDetn104RdrDetnRngV 4000;
BA_ "GenSigSendType" SG_ 338 FrntSideRdrLeDetn104RdrDetnSts 0;
BA_ "GenSigStartValue" SG_ 338 FrntSideRdrLeDetn104RdrDetnSts 3;
BA_ "GenSigSendType" SG_ 338 FrntSideRdrLeDetn105RdrDetnAzi 0;
BA_ "GenSigStartValue" SG_ 338 FrntSideRdrLeDetn105RdrDetnAzi 900;
BA_ "GenSigDataID" SG_ 338 FrntSideRdrLeDetn105RdrDetnChks "0x89C";
BA_ "GenSigFuncType" SG_ 338 FrntSideRdrLeDetn105RdrDetnChks 15;
BA_ "GenSigSendType" SG_ 338 FrntSideRdrLeDetn105RdrDetnChks 0;
BA_ "GenSigFuncType" SG_ 338 FrntSideRdrLeDetn105RdrDetnCntr 16;
BA_ "GenSigSendType" SG_ 338 FrntSideRdrLeDetn105RdrDetnCntr 0;
BA_ "GenSigSendType" SG_ 338 FrntSideRdrLeDetn105RdrDetnConf 0;
BA_ "GenSigSendType" SG_ 338 FrntSideRdrLeDetn105RdrDetnElevn 0;
BA_ "GenSigStartValue" SG_ 338 FrntSideRdrLeDetn105RdrDetnElevn 15;
BA_ "GenSigSendType" SG_ 338 FrntSideRdrLeDetn105RdrDetnPwr 0;
BA_ "GenSigSendType" SG_ 338 FrntSideRdrLeDetn105RdrDetnRng 0;
BA_ "GenSigStartValue" SG_ 338 FrntSideRdrLeDetn105RdrDetnRng 10050;
BA_ "GenSigSendType" SG_ 338 FrntSideRdrLeDetn105RdrDetnRngV 0;
BA_ "GenSigStartValue" SG_ 338 FrntSideRdrLeDetn105RdrDetnRngV 4000;
BA_ "GenSigSendType" SG_ 338 FrntSideRdrLeDetn105RdrDetnSts 0;
BA_ "GenSigStartValue" SG_ 338 FrntSideRdrLeDetn105RdrDetnSts 3;
BA_ "GenSigSendType" SG_ 338 FrntSideRdrLeDetn106RdrDetnAzi 0;
BA_ "GenSigStartValue" SG_ 338 FrntSideRdrLeDetn106RdrDetnAzi 900;
BA_ "GenSigDataID" SG_ 338 FrntSideRdrLeDetn106RdrDetnChks "0x89D";
BA_ "GenSigFuncType" SG_ 338 FrntSideRdrLeDetn106RdrDetnChks 15;
BA_ "GenSigSendType" SG_ 338 FrntSideRdrLeDetn106RdrDetnChks 0;
BA_ "GenSigFuncType" SG_ 338 FrntSideRdrLeDetn106RdrDetnCntr 16;
BA_ "GenSigSendType" SG_ 338 FrntSideRdrLeDetn106RdrDetnCntr 0;
BA_ "GenSigSendType" SG_ 338 FrntSideRdrLeDetn106RdrDetnConf 0;
BA_ "GenSigSendType" SG_ 338 FrntSideRdrLeDetn106RdrDetnElevn 0;
BA_ "GenSigStartValue" SG_ 338 FrntSideRdrLeDetn106RdrDetnElevn 15;
BA_ "GenSigSendType" SG_ 338 FrntSideRdrLeDetn106RdrDetnPwr 0;
BA_ "GenSigSendType" SG_ 338 FrntSideRdrLeDetn106RdrDetnRng 0;
BA_ "GenSigStartValue" SG_ 338 FrntSideRdrLeDetn106RdrDetnRng 10050;
BA_ "GenSigSendType" SG_ 338 FrntSideRdrLeDetn106RdrDetnRngV 0;
BA_ "GenSigStartValue" SG_ 338 FrntSideRdrLeDetn106RdrDetnRngV 4000;
BA_ "GenSigSendType" SG_ 338 FrntSideRdrLeDetn106RdrDetnSts 0;
BA_ "GenSigStartValue" SG_ 338 FrntSideRdrLeDetn106RdrDetnSts 3;
BA_ "GenSigSendType" SG_ 338 FrntSideRdrLeDetn107RdrDetnAzi 0;
BA_ "GenSigStartValue" SG_ 338 FrntSideRdrLeDetn107RdrDetnAzi 900;
BA_ "GenSigDataID" SG_ 338 FrntSideRdrLeDetn107RdrDetnChks "0x89E";
BA_ "GenSigFuncType" SG_ 338 FrntSideRdrLeDetn107RdrDetnChks 15;
BA_ "GenSigSendType" SG_ 338 FrntSideRdrLeDetn107RdrDetnChks 0;
BA_ "GenSigFuncType" SG_ 338 FrntSideRdrLeDetn107RdrDetnCntr 16;
BA_ "GenSigSendType" SG_ 338 FrntSideRdrLeDetn107RdrDetnCntr 0;
BA_ "GenSigSendType" SG_ 338 FrntSideRdrLeDetn107RdrDetnConf 0;
BA_ "GenSigSendType" SG_ 338 FrntSideRdrLeDetn107RdrDetnElevn 0;
BA_ "GenSigStartValue" SG_ 338 FrntSideRdrLeDetn107RdrDetnElevn 15;
BA_ "GenSigSendType" SG_ 338 FrntSideRdrLeDetn107RdrDetnPwr 0;
BA_ "GenSigSendType" SG_ 338 FrntSideRdrLeDetn107RdrDetnRng 0;
BA_ "GenSigStartValue" SG_ 338 FrntSideRdrLeDetn107RdrDetnRng 10050;
BA_ "GenSigSendType" SG_ 338 FrntSideRdrLeDetn107RdrDetnRngV 0;
BA_ "GenSigStartValue" SG_ 338 FrntSideRdrLeDetn107RdrDetnRngV 4000;
BA_ "GenSigSendType" SG_ 338 FrntSideRdrLeDetn107RdrDetnSts 0;
BA_ "GenSigStartValue" SG_ 338 FrntSideRdrLeDetn107RdrDetnSts 3;
BA_ "GenSigSendType" SG_ 338 FrntSideRdrLeDetn108RdrDetnAzi 0;
BA_ "GenSigStartValue" SG_ 338 FrntSideRdrLeDetn108RdrDetnAzi 900;
BA_ "GenSigDataID" SG_ 338 FrntSideRdrLeDetn108RdrDetnChks "0x89F";
BA_ "GenSigFuncType" SG_ 338 FrntSideRdrLeDetn108RdrDetnChks 15;
BA_ "GenSigSendType" SG_ 338 FrntSideRdrLeDetn108RdrDetnChks 0;
BA_ "GenSigFuncType" SG_ 338 FrntSideRdrLeDetn108RdrDetnCntr 16;
BA_ "GenSigSendType" SG_ 338 FrntSideRdrLeDetn108RdrDetnCntr 0;
BA_ "GenSigSendType" SG_ 338 FrntSideRdrLeDetn108RdrDetnConf 0;
BA_ "GenSigSendType" SG_ 338 FrntSideRdrLeDetn108RdrDetnElevn 0;
BA_ "GenSigStartValue" SG_ 338 FrntSideRdrLeDetn108RdrDetnElevn 15;
BA_ "GenSigSendType" SG_ 338 FrntSideRdrLeDetn108RdrDetnPwr 0;
BA_ "GenSigSendType" SG_ 338 FrntSideRdrLeDetn108RdrDetnRng 0;
BA_ "GenSigStartValue" SG_ 338 FrntSideRdrLeDetn108RdrDetnRng 10050;
BA_ "GenSigSendType" SG_ 338 FrntSideRdrLeDetn108RdrDetnRngV 0;
BA_ "GenSigStartValue" SG_ 338 FrntSideRdrLeDetn108RdrDetnRngV 4000;
BA_ "GenSigSendType" SG_ 338 FrntSideRdrLeDetn108RdrDetnSts 0;
BA_ "GenSigStartValue" SG_ 338 FrntSideRdrLeDetn108RdrDetnSts 3;
BA_ "GenSigSendType" SG_ 340 FrntSideRdrLeDetn109RdrDetnAzi 0;
BA_ "GenSigStartValue" SG_ 340 FrntSideRdrLeDetn109RdrDetnAzi 900;
BA_ "GenSigDataID" SG_ 340 FrntSideRdrLeDetn109RdrDetnChks "0x8A0";
BA_ "GenSigFuncType" SG_ 340 FrntSideRdrLeDetn109RdrDetnChks 15;
BA_ "GenSigSendType" SG_ 340 FrntSideRdrLeDetn109RdrDetnChks 0;
BA_ "GenSigFuncType" SG_ 340 FrntSideRdrLeDetn109RdrDetnCntr 16;
BA_ "GenSigSendType" SG_ 340 FrntSideRdrLeDetn109RdrDetnCntr 0;
BA_ "GenSigSendType" SG_ 340 FrntSideRdrLeDetn109RdrDetnConf 0;
BA_ "GenSigSendType" SG_ 340 FrntSideRdrLeDetn109RdrDetnElevn 0;
BA_ "GenSigStartValue" SG_ 340 FrntSideRdrLeDetn109RdrDetnElevn 15;
BA_ "GenSigSendType" SG_ 340 FrntSideRdrLeDetn109RdrDetnPwr 0;
BA_ "GenSigSendType" SG_ 340 FrntSideRdrLeDetn109RdrDetnRng 0;
BA_ "GenSigStartValue" SG_ 340 FrntSideRdrLeDetn109RdrDetnRng 10050;
BA_ "GenSigSendType" SG_ 340 FrntSideRdrLeDetn109RdrDetnRngV 0;
BA_ "GenSigStartValue" SG_ 340 FrntSideRdrLeDetn109RdrDetnRngV 4000;
BA_ "GenSigSendType" SG_ 340 FrntSideRdrLeDetn109RdrDetnSts 0;
BA_ "GenSigStartValue" SG_ 340 FrntSideRdrLeDetn109RdrDetnSts 3;
BA_ "GenSigSendType" SG_ 340 FrntSideRdrLeDetn110RdrDetnAzi 0;
BA_ "GenSigStartValue" SG_ 340 FrntSideRdrLeDetn110RdrDetnAzi 900;
BA_ "GenSigDataID" SG_ 340 FrntSideRdrLeDetn110RdrDetnChks "0x8A1";
BA_ "GenSigFuncType" SG_ 340 FrntSideRdrLeDetn110RdrDetnChks 15;
BA_ "GenSigSendType" SG_ 340 FrntSideRdrLeDetn110RdrDetnChks 0;
BA_ "GenSigFuncType" SG_ 340 FrntSideRdrLeDetn110RdrDetnCntr 16;
BA_ "GenSigSendType" SG_ 340 FrntSideRdrLeDetn110RdrDetnCntr 0;
BA_ "GenSigSendType" SG_ 340 FrntSideRdrLeDetn110RdrDetnConf 0;
BA_ "GenSigSendType" SG_ 340 FrntSideRdrLeDetn110RdrDetnElevn 0;
BA_ "GenSigStartValue" SG_ 340 FrntSideRdrLeDetn110RdrDetnElevn 15;
BA_ "GenSigSendType" SG_ 340 FrntSideRdrLeDetn110RdrDetnPwr 0;
BA_ "GenSigSendType" SG_ 340 FrntSideRdrLeDetn110RdrDetnRng 0;
BA_ "GenSigStartValue" SG_ 340 FrntSideRdrLeDetn110RdrDetnRng 10050;
BA_ "GenSigSendType" SG_ 340 FrntSideRdrLeDetn110RdrDetnRngV 0;
BA_ "GenSigStartValue" SG_ 340 FrntSideRdrLeDetn110RdrDetnRngV 4000;
BA_ "GenSigSendType" SG_ 340 FrntSideRdrLeDetn110RdrDetnSts 0;
BA_ "GenSigStartValue" SG_ 340 FrntSideRdrLeDetn110RdrDetnSts 3;
BA_ "GenSigSendType" SG_ 340 FrntSideRdrLeDetn111RdrDetnAzi 0;
BA_ "GenSigStartValue" SG_ 340 FrntSideRdrLeDetn111RdrDetnAzi 900;
BA_ "GenSigDataID" SG_ 340 FrntSideRdrLeDetn111RdrDetnChks "0x8A2";
BA_ "GenSigFuncType" SG_ 340 FrntSideRdrLeDetn111RdrDetnChks 15;
BA_ "GenSigSendType" SG_ 340 FrntSideRdrLeDetn111RdrDetnChks 0;
BA_ "GenSigFuncType" SG_ 340 FrntSideRdrLeDetn111RdrDetnCntr 16;
BA_ "GenSigSendType" SG_ 340 FrntSideRdrLeDetn111RdrDetnCntr 0;
BA_ "GenSigSendType" SG_ 340 FrntSideRdrLeDetn111RdrDetnConf 0;
BA_ "GenSigSendType" SG_ 340 FrntSideRdrLeDetn111RdrDetnElevn 0;
BA_ "GenSigStartValue" SG_ 340 FrntSideRdrLeDetn111RdrDetnElevn 15;
BA_ "GenSigSendType" SG_ 340 FrntSideRdrLeDetn111RdrDetnPwr 0;
BA_ "GenSigSendType" SG_ 340 FrntSideRdrLeDetn111RdrDetnRng 0;
BA_ "GenSigStartValue" SG_ 340 FrntSideRdrLeDetn111RdrDetnRng 10050;
BA_ "GenSigSendType" SG_ 340 FrntSideRdrLeDetn111RdrDetnRngV 0;
BA_ "GenSigStartValue" SG_ 340 FrntSideRdrLeDetn111RdrDetnRngV 4000;
BA_ "GenSigSendType" SG_ 340 FrntSideRdrLeDetn111RdrDetnSts 0;
BA_ "GenSigStartValue" SG_ 340 FrntSideRdrLeDetn111RdrDetnSts 3;
BA_ "GenSigSendType" SG_ 340 FrntSideRdrLeDetn112RdrDetnAzi 0;
BA_ "GenSigStartValue" SG_ 340 FrntSideRdrLeDetn112RdrDetnAzi 900;
BA_ "GenSigDataID" SG_ 340 FrntSideRdrLeDetn112RdrDetnChks "0x8A3";
BA_ "GenSigFuncType" SG_ 340 FrntSideRdrLeDetn112RdrDetnChks 15;
BA_ "GenSigSendType" SG_ 340 FrntSideRdrLeDetn112RdrDetnChks 0;
BA_ "GenSigFuncType" SG_ 340 FrntSideRdrLeDetn112RdrDetnCntr 16;
BA_ "GenSigSendType" SG_ 340 FrntSideRdrLeDetn112RdrDetnCntr 0;
BA_ "GenSigSendType" SG_ 340 FrntSideRdrLeDetn112RdrDetnConf 0;
BA_ "GenSigSendType" SG_ 340 FrntSideRdrLeDetn112RdrDetnElevn 0;
BA_ "GenSigStartValue" SG_ 340 FrntSideRdrLeDetn112RdrDetnElevn 15;
BA_ "GenSigSendType" SG_ 340 FrntSideRdrLeDetn112RdrDetnPwr 0;
BA_ "GenSigSendType" SG_ 340 FrntSideRdrLeDetn112RdrDetnRng 0;
BA_ "GenSigStartValue" SG_ 340 FrntSideRdrLeDetn112RdrDetnRng 10050;
BA_ "GenSigSendType" SG_ 340 FrntSideRdrLeDetn112RdrDetnRngV 0;
BA_ "GenSigStartValue" SG_ 340 FrntSideRdrLeDetn112RdrDetnRngV 4000;
BA_ "GenSigSendType" SG_ 340 FrntSideRdrLeDetn112RdrDetnSts 0;
BA_ "GenSigStartValue" SG_ 340 FrntSideRdrLeDetn112RdrDetnSts 3;
BA_ "GenSigSendType" SG_ 340 FrntSideRdrLeDetn113RdrDetnAzi 0;
BA_ "GenSigStartValue" SG_ 340 FrntSideRdrLeDetn113RdrDetnAzi 900;
BA_ "GenSigDataID" SG_ 340 FrntSideRdrLeDetn113RdrDetnChks "0x8A4";
BA_ "GenSigFuncType" SG_ 340 FrntSideRdrLeDetn113RdrDetnChks 15;
BA_ "GenSigSendType" SG_ 340 FrntSideRdrLeDetn113RdrDetnChks 0;
BA_ "GenSigFuncType" SG_ 340 FrntSideRdrLeDetn113RdrDetnCntr 16;
BA_ "GenSigSendType" SG_ 340 FrntSideRdrLeDetn113RdrDetnCntr 0;
BA_ "GenSigSendType" SG_ 340 FrntSideRdrLeDetn113RdrDetnConf 0;
BA_ "GenSigSendType" SG_ 340 FrntSideRdrLeDetn113RdrDetnElevn 0;
BA_ "GenSigStartValue" SG_ 340 FrntSideRdrLeDetn113RdrDetnElevn 15;
BA_ "GenSigSendType" SG_ 340 FrntSideRdrLeDetn113RdrDetnPwr 0;
BA_ "GenSigSendType" SG_ 340 FrntSideRdrLeDetn113RdrDetnRng 0;
BA_ "GenSigStartValue" SG_ 340 FrntSideRdrLeDetn113RdrDetnRng 10050;
BA_ "GenSigSendType" SG_ 340 FrntSideRdrLeDetn113RdrDetnRngV 0;
BA_ "GenSigStartValue" SG_ 340 FrntSideRdrLeDetn113RdrDetnRngV 4000;
BA_ "GenSigSendType" SG_ 340 FrntSideRdrLeDetn113RdrDetnSts 0;
BA_ "GenSigStartValue" SG_ 340 FrntSideRdrLeDetn113RdrDetnSts 3;
BA_ "GenSigSendType" SG_ 340 FrntSideRdrLeDetn114RdrDetnAzi 0;
BA_ "GenSigStartValue" SG_ 340 FrntSideRdrLeDetn114RdrDetnAzi 900;
BA_ "GenSigDataID" SG_ 340 FrntSideRdrLeDetn114RdrDetnChks "0x8A5";
BA_ "GenSigFuncType" SG_ 340 FrntSideRdrLeDetn114RdrDetnChks 15;
BA_ "GenSigSendType" SG_ 340 FrntSideRdrLeDetn114RdrDetnChks 0;
BA_ "GenSigFuncType" SG_ 340 FrntSideRdrLeDetn114RdrDetnCntr 16;
BA_ "GenSigSendType" SG_ 340 FrntSideRdrLeDetn114RdrDetnCntr 0;
BA_ "GenSigSendType" SG_ 340 FrntSideRdrLeDetn114RdrDetnConf 0;
BA_ "GenSigSendType" SG_ 340 FrntSideRdrLeDetn114RdrDetnElevn 0;
BA_ "GenSigStartValue" SG_ 340 FrntSideRdrLeDetn114RdrDetnElevn 15;
BA_ "GenSigSendType" SG_ 340 FrntSideRdrLeDetn114RdrDetnPwr 0;
BA_ "GenSigSendType" SG_ 340 FrntSideRdrLeDetn114RdrDetnRng 0;
BA_ "GenSigStartValue" SG_ 340 FrntSideRdrLeDetn114RdrDetnRng 10050;
BA_ "GenSigSendType" SG_ 340 FrntSideRdrLeDetn114RdrDetnRngV 0;
BA_ "GenSigStartValue" SG_ 340 FrntSideRdrLeDetn114RdrDetnRngV 4000;
BA_ "GenSigSendType" SG_ 340 FrntSideRdrLeDetn114RdrDetnSts 0;
BA_ "GenSigStartValue" SG_ 340 FrntSideRdrLeDetn114RdrDetnSts 3;
BA_ "GenSigSendType" SG_ 342 FrntSideRdrLeDetn115RdrDetnAzi 0;
BA_ "GenSigStartValue" SG_ 342 FrntSideRdrLeDetn115RdrDetnAzi 900;
BA_ "GenSigDataID" SG_ 342 FrntSideRdrLeDetn115RdrDetnChks "0x8A6";
BA_ "GenSigFuncType" SG_ 342 FrntSideRdrLeDetn115RdrDetnChks 15;
BA_ "GenSigSendType" SG_ 342 FrntSideRdrLeDetn115RdrDetnChks 0;
BA_ "GenSigFuncType" SG_ 342 FrntSideRdrLeDetn115RdrDetnCntr 16;
BA_ "GenSigSendType" SG_ 342 FrntSideRdrLeDetn115RdrDetnCntr 0;
BA_ "GenSigSendType" SG_ 342 FrntSideRdrLeDetn115RdrDetnConf 0;
BA_ "GenSigSendType" SG_ 342 FrntSideRdrLeDetn115RdrDetnElevn 0;
BA_ "GenSigStartValue" SG_ 342 FrntSideRdrLeDetn115RdrDetnElevn 15;
BA_ "GenSigSendType" SG_ 342 FrntSideRdrLeDetn115RdrDetnPwr 0;
BA_ "GenSigSendType" SG_ 342 FrntSideRdrLeDetn115RdrDetnRng 0;
BA_ "GenSigStartValue" SG_ 342 FrntSideRdrLeDetn115RdrDetnRng 10050;
BA_ "GenSigSendType" SG_ 342 FrntSideRdrLeDetn115RdrDetnRngV 0;
BA_ "GenSigStartValue" SG_ 342 FrntSideRdrLeDetn115RdrDetnRngV 4000;
BA_ "GenSigSendType" SG_ 342 FrntSideRdrLeDetn115RdrDetnSts 0;
BA_ "GenSigStartValue" SG_ 342 FrntSideRdrLeDetn115RdrDetnSts 3;
BA_ "GenSigSendType" SG_ 342 FrntSideRdrLeDetn116RdrDetnAzi 0;
BA_ "GenSigStartValue" SG_ 342 FrntSideRdrLeDetn116RdrDetnAzi 900;
BA_ "GenSigDataID" SG_ 342 FrntSideRdrLeDetn116RdrDetnChks "0x8A7";
BA_ "GenSigFuncType" SG_ 342 FrntSideRdrLeDetn116RdrDetnChks 15;
BA_ "GenSigSendType" SG_ 342 FrntSideRdrLeDetn116RdrDetnChks 0;
BA_ "GenSigFuncType" SG_ 342 FrntSideRdrLeDetn116RdrDetnCntr 16;
BA_ "GenSigSendType" SG_ 342 FrntSideRdrLeDetn116RdrDetnCntr 0;
BA_ "GenSigSendType" SG_ 342 FrntSideRdrLeDetn116RdrDetnConf 0;
BA_ "GenSigSendType" SG_ 342 FrntSideRdrLeDetn116RdrDetnElevn 0;
BA_ "GenSigStartValue" SG_ 342 FrntSideRdrLeDetn116RdrDetnElevn 15;
BA_ "GenSigSendType" SG_ 342 FrntSideRdrLeDetn116RdrDetnPwr 0;
BA_ "GenSigSendType" SG_ 342 FrntSideRdrLeDetn116RdrDetnRng 0;
BA_ "GenSigStartValue" SG_ 342 FrntSideRdrLeDetn116RdrDetnRng 10050;
BA_ "GenSigSendType" SG_ 342 FrntSideRdrLeDetn116RdrDetnRngV 0;
BA_ "GenSigStartValue" SG_ 342 FrntSideRdrLeDetn116RdrDetnRngV 4000;
BA_ "GenSigSendType" SG_ 342 FrntSideRdrLeDetn116RdrDetnSts 0;
BA_ "GenSigStartValue" SG_ 342 FrntSideRdrLeDetn116RdrDetnSts 3;
BA_ "GenSigSendType" SG_ 342 FrntSideRdrLeDetn117RdrDetnAzi 0;
BA_ "GenSigStartValue" SG_ 342 FrntSideRdrLeDetn117RdrDetnAzi 900;
BA_ "GenSigDataID" SG_ 342 FrntSideRdrLeDetn117RdrDetnChks "0x8A8";
BA_ "GenSigFuncType" SG_ 342 FrntSideRdrLeDetn117RdrDetnChks 15;
BA_ "GenSigSendType" SG_ 342 FrntSideRdrLeDetn117RdrDetnChks 0;
BA_ "GenSigFuncType" SG_ 342 FrntSideRdrLeDetn117RdrDetnCntr 16;
BA_ "GenSigSendType" SG_ 342 FrntSideRdrLeDetn117RdrDetnCntr 0;
BA_ "GenSigSendType" SG_ 342 FrntSideRdrLeDetn117RdrDetnConf 0;
BA_ "GenSigSendType" SG_ 342 FrntSideRdrLeDetn117RdrDetnElevn 0;
BA_ "GenSigStartValue" SG_ 342 FrntSideRdrLeDetn117RdrDetnElevn 15;
BA_ "GenSigSendType" SG_ 342 FrntSideRdrLeDetn117RdrDetnPwr 0;
BA_ "GenSigSendType" SG_ 342 FrntSideRdrLeDetn117RdrDetnRng 0;
BA_ "GenSigStartValue" SG_ 342 FrntSideRdrLeDetn117RdrDetnRng 10050;
BA_ "GenSigSendType" SG_ 342 FrntSideRdrLeDetn117RdrDetnRngV 0;
BA_ "GenSigStartValue" SG_ 342 FrntSideRdrLeDetn117RdrDetnRngV 4000;
BA_ "GenSigSendType" SG_ 342 FrntSideRdrLeDetn117RdrDetnSts 0;
BA_ "GenSigStartValue" SG_ 342 FrntSideRdrLeDetn117RdrDetnSts 3;
BA_ "GenSigSendType" SG_ 342 FrntSideRdrLeDetn118RdrDetnAzi 0;
BA_ "GenSigStartValue" SG_ 342 FrntSideRdrLeDetn118RdrDetnAzi 900;
BA_ "GenSigDataID" SG_ 342 FrntSideRdrLeDetn118RdrDetnChks "0x8A9";
BA_ "GenSigFuncType" SG_ 342 FrntSideRdrLeDetn118RdrDetnChks 15;
BA_ "GenSigSendType" SG_ 342 FrntSideRdrLeDetn118RdrDetnChks 0;
BA_ "GenSigFuncType" SG_ 342 FrntSideRdrLeDetn118RdrDetnCntr 16;
BA_ "GenSigSendType" SG_ 342 FrntSideRdrLeDetn118RdrDetnCntr 0;
BA_ "GenSigSendType" SG_ 342 FrntSideRdrLeDetn118RdrDetnConf 0;
BA_ "GenSigSendType" SG_ 342 FrntSideRdrLeDetn118RdrDetnElevn 0;
BA_ "GenSigStartValue" SG_ 342 FrntSideRdrLeDetn118RdrDetnElevn 15;
BA_ "GenSigSendType" SG_ 342 FrntSideRdrLeDetn118RdrDetnPwr 0;
BA_ "GenSigSendType" SG_ 342 FrntSideRdrLeDetn118RdrDetnRng 0;
BA_ "GenSigStartValue" SG_ 342 FrntSideRdrLeDetn118RdrDetnRng 10050;
BA_ "GenSigSendType" SG_ 342 FrntSideRdrLeDetn118RdrDetnRngV 0;
BA_ "GenSigStartValue" SG_ 342 FrntSideRdrLeDetn118RdrDetnRngV 4000;
BA_ "GenSigSendType" SG_ 342 FrntSideRdrLeDetn118RdrDetnSts 0;
BA_ "GenSigStartValue" SG_ 342 FrntSideRdrLeDetn118RdrDetnSts 3;
BA_ "GenSigSendType" SG_ 342 FrntSideRdrLeDetn119RdrDetnAzi 0;
BA_ "GenSigStartValue" SG_ 342 FrntSideRdrLeDetn119RdrDetnAzi 900;
BA_ "GenSigDataID" SG_ 342 FrntSideRdrLeDetn119RdrDetnChks "0x8AA";
BA_ "GenSigFuncType" SG_ 342 FrntSideRdrLeDetn119RdrDetnChks 15;
BA_ "GenSigSendType" SG_ 342 FrntSideRdrLeDetn119RdrDetnChks 0;
BA_ "GenSigFuncType" SG_ 342 FrntSideRdrLeDetn119RdrDetnCntr 16;
BA_ "GenSigSendType" SG_ 342 FrntSideRdrLeDetn119RdrDetnCntr 0;
BA_ "GenSigSendType" SG_ 342 FrntSideRdrLeDetn119RdrDetnConf 0;
BA_ "GenSigSendType" SG_ 342 FrntSideRdrLeDetn119RdrDetnElevn 0;
BA_ "GenSigStartValue" SG_ 342 FrntSideRdrLeDetn119RdrDetnElevn 15;
BA_ "GenSigSendType" SG_ 342 FrntSideRdrLeDetn119RdrDetnPwr 0;
BA_ "GenSigSendType" SG_ 342 FrntSideRdrLeDetn119RdrDetnRng 0;
BA_ "GenSigStartValue" SG_ 342 FrntSideRdrLeDetn119RdrDetnRng 10050;
BA_ "GenSigSendType" SG_ 342 FrntSideRdrLeDetn119RdrDetnRngV 0;
BA_ "GenSigStartValue" SG_ 342 FrntSideRdrLeDetn119RdrDetnRngV 4000;
BA_ "GenSigSendType" SG_ 342 FrntSideRdrLeDetn119RdrDetnSts 0;
BA_ "GenSigStartValue" SG_ 342 FrntSideRdrLeDetn119RdrDetnSts 3;
BA_ "GenSigSendType" SG_ 342 FrntSideRdrLeDetn120RdrDetnAzi 0;
BA_ "GenSigStartValue" SG_ 342 FrntSideRdrLeDetn120RdrDetnAzi 900;
BA_ "GenSigDataID" SG_ 342 FrntSideRdrLeDetn120RdrDetnChks "0x8AB";
BA_ "GenSigFuncType" SG_ 342 FrntSideRdrLeDetn120RdrDetnChks 15;
BA_ "GenSigSendType" SG_ 342 FrntSideRdrLeDetn120RdrDetnChks 0;
BA_ "GenSigFuncType" SG_ 342 FrntSideRdrLeDetn120RdrDetnCntr 16;
BA_ "GenSigSendType" SG_ 342 FrntSideRdrLeDetn120RdrDetnCntr 0;
BA_ "GenSigSendType" SG_ 342 FrntSideRdrLeDetn120RdrDetnConf 0;
BA_ "GenSigSendType" SG_ 342 FrntSideRdrLeDetn120RdrDetnElevn 0;
BA_ "GenSigStartValue" SG_ 342 FrntSideRdrLeDetn120RdrDetnElevn 15;
BA_ "GenSigSendType" SG_ 342 FrntSideRdrLeDetn120RdrDetnPwr 0;
BA_ "GenSigSendType" SG_ 342 FrntSideRdrLeDetn120RdrDetnRng 0;
BA_ "GenSigStartValue" SG_ 342 FrntSideRdrLeDetn120RdrDetnRng 10050;
BA_ "GenSigSendType" SG_ 342 FrntSideRdrLeDetn120RdrDetnRngV 0;
BA_ "GenSigStartValue" SG_ 342 FrntSideRdrLeDetn120RdrDetnRngV 4000;
BA_ "GenSigSendType" SG_ 342 FrntSideRdrLeDetn120RdrDetnSts 0;
BA_ "GenSigStartValue" SG_ 342 FrntSideRdrLeDetn120RdrDetnSts 3;
BA_ "GenSigSendType" SG_ 344 FrntSideRdrLeDetn121RdrDetnAzi 0;
BA_ "GenSigStartValue" SG_ 344 FrntSideRdrLeDetn121RdrDetnAzi 900;
BA_ "GenSigDataID" SG_ 344 FrntSideRdrLeDetn121RdrDetnChks "0x8AC";
BA_ "GenSigFuncType" SG_ 344 FrntSideRdrLeDetn121RdrDetnChks 15;
BA_ "GenSigSendType" SG_ 344 FrntSideRdrLeDetn121RdrDetnChks 0;
BA_ "GenSigFuncType" SG_ 344 FrntSideRdrLeDetn121RdrDetnCntr 16;
BA_ "GenSigSendType" SG_ 344 FrntSideRdrLeDetn121RdrDetnCntr 0;
BA_ "GenSigSendType" SG_ 344 FrntSideRdrLeDetn121RdrDetnConf 0;
BA_ "GenSigSendType" SG_ 344 FrntSideRdrLeDetn121RdrDetnElevn 0;
BA_ "GenSigStartValue" SG_ 344 FrntSideRdrLeDetn121RdrDetnElevn 15;
BA_ "GenSigSendType" SG_ 344 FrntSideRdrLeDetn121RdrDetnPwr 0;
BA_ "GenSigSendType" SG_ 344 FrntSideRdrLeDetn121RdrDetnRng 0;
BA_ "GenSigStartValue" SG_ 344 FrntSideRdrLeDetn121RdrDetnRng 10050;
BA_ "GenSigSendType" SG_ 344 FrntSideRdrLeDetn121RdrDetnRngV 0;
BA_ "GenSigStartValue" SG_ 344 FrntSideRdrLeDetn121RdrDetnRngV 4000;
BA_ "GenSigSendType" SG_ 344 FrntSideRdrLeDetn121RdrDetnSts 0;
BA_ "GenSigStartValue" SG_ 344 FrntSideRdrLeDetn121RdrDetnSts 3;
BA_ "GenSigSendType" SG_ 344 FrntSideRdrLeDetn122RdrDetnAzi 0;
BA_ "GenSigStartValue" SG_ 344 FrntSideRdrLeDetn122RdrDetnAzi 900;
BA_ "GenSigDataID" SG_ 344 FrntSideRdrLeDetn122RdrDetnChks "0x8AD";
BA_ "GenSigFuncType" SG_ 344 FrntSideRdrLeDetn122RdrDetnChks 15;
BA_ "GenSigSendType" SG_ 344 FrntSideRdrLeDetn122RdrDetnChks 0;
BA_ "GenSigFuncType" SG_ 344 FrntSideRdrLeDetn122RdrDetnCntr 16;
BA_ "GenSigSendType" SG_ 344 FrntSideRdrLeDetn122RdrDetnCntr 0;
BA_ "GenSigSendType" SG_ 344 FrntSideRdrLeDetn122RdrDetnConf 0;
BA_ "GenSigSendType" SG_ 344 FrntSideRdrLeDetn122RdrDetnElevn 0;
BA_ "GenSigStartValue" SG_ 344 FrntSideRdrLeDetn122RdrDetnElevn 15;
BA_ "GenSigSendType" SG_ 344 FrntSideRdrLeDetn122RdrDetnPwr 0;
BA_ "GenSigSendType" SG_ 344 FrntSideRdrLeDetn122RdrDetnRng 0;
BA_ "GenSigStartValue" SG_ 344 FrntSideRdrLeDetn122RdrDetnRng 10050;
BA_ "GenSigSendType" SG_ 344 FrntSideRdrLeDetn122RdrDetnRngV 0;
BA_ "GenSigStartValue" SG_ 344 FrntSideRdrLeDetn122RdrDetnRngV 4000;
BA_ "GenSigSendType" SG_ 344 FrntSideRdrLeDetn122RdrDetnSts 0;
BA_ "GenSigStartValue" SG_ 344 FrntSideRdrLeDetn122RdrDetnSts 3;
BA_ "GenSigSendType" SG_ 344 FrntSideRdrLeDetn123RdrDetnAzi 0;
BA_ "GenSigStartValue" SG_ 344 FrntSideRdrLeDetn123RdrDetnAzi 900;
BA_ "GenSigDataID" SG_ 344 FrntSideRdrLeDetn123RdrDetnChks "0x8AE";
BA_ "GenSigFuncType" SG_ 344 FrntSideRdrLeDetn123RdrDetnChks 15;
BA_ "GenSigSendType" SG_ 344 FrntSideRdrLeDetn123RdrDetnChks 0;
BA_ "GenSigFuncType" SG_ 344 FrntSideRdrLeDetn123RdrDetnCntr 16;
BA_ "GenSigSendType" SG_ 344 FrntSideRdrLeDetn123RdrDetnCntr 0;
BA_ "GenSigSendType" SG_ 344 FrntSideRdrLeDetn123RdrDetnConf 0;
BA_ "GenSigSendType" SG_ 344 FrntSideRdrLeDetn123RdrDetnElevn 0;
BA_ "GenSigStartValue" SG_ 344 FrntSideRdrLeDetn123RdrDetnElevn 15;
BA_ "GenSigSendType" SG_ 344 FrntSideRdrLeDetn123RdrDetnPwr 0;
BA_ "GenSigSendType" SG_ 344 FrntSideRdrLeDetn123RdrDetnRng 0;
BA_ "GenSigStartValue" SG_ 344 FrntSideRdrLeDetn123RdrDetnRng 10050;
BA_ "GenSigSendType" SG_ 344 FrntSideRdrLeDetn123RdrDetnRngV 0;
BA_ "GenSigStartValue" SG_ 344 FrntSideRdrLeDetn123RdrDetnRngV 4000;
BA_ "GenSigSendType" SG_ 344 FrntSideRdrLeDetn123RdrDetnSts 0;
BA_ "GenSigStartValue" SG_ 344 FrntSideRdrLeDetn123RdrDetnSts 3;
BA_ "GenSigSendType" SG_ 344 FrntSideRdrLeDetn124RdrDetnAzi 0;
BA_ "GenSigStartValue" SG_ 344 FrntSideRdrLeDetn124RdrDetnAzi 900;
BA_ "GenSigDataID" SG_ 344 FrntSideRdrLeDetn124RdrDetnChks "0x8AF";
BA_ "GenSigFuncType" SG_ 344 FrntSideRdrLeDetn124RdrDetnChks 15;
BA_ "GenSigSendType" SG_ 344 FrntSideRdrLeDetn124RdrDetnChks 0;
BA_ "GenSigFuncType" SG_ 344 FrntSideRdrLeDetn124RdrDetnCntr 16;
BA_ "GenSigSendType" SG_ 344 FrntSideRdrLeDetn124RdrDetnCntr 0;
BA_ "GenSigSendType" SG_ 344 FrntSideRdrLeDetn124RdrDetnConf 0;
BA_ "GenSigSendType" SG_ 344 FrntSideRdrLeDetn124RdrDetnElevn 0;
BA_ "GenSigStartValue" SG_ 344 FrntSideRdrLeDetn124RdrDetnElevn 15;
BA_ "GenSigSendType" SG_ 344 FrntSideRdrLeDetn124RdrDetnPwr 0;
BA_ "GenSigSendType" SG_ 344 FrntSideRdrLeDetn124RdrDetnRng 0;
BA_ "GenSigStartValue" SG_ 344 FrntSideRdrLeDetn124RdrDetnRng 10050;
BA_ "GenSigSendType" SG_ 344 FrntSideRdrLeDetn124RdrDetnRngV 0;
BA_ "GenSigStartValue" SG_ 344 FrntSideRdrLeDetn124RdrDetnRngV 4000;
BA_ "GenSigSendType" SG_ 344 FrntSideRdrLeDetn124RdrDetnSts 0;
BA_ "GenSigStartValue" SG_ 344 FrntSideRdrLeDetn124RdrDetnSts 3;
BA_ "GenSigSendType" SG_ 344 FrntSideRdrLeDetn125RdrDetnAzi 0;
BA_ "GenSigStartValue" SG_ 344 FrntSideRdrLeDetn125RdrDetnAzi 900;
BA_ "GenSigDataID" SG_ 344 FrntSideRdrLeDetn125RdrDetnChks "0x8B0";
BA_ "GenSigFuncType" SG_ 344 FrntSideRdrLeDetn125RdrDetnChks 15;
BA_ "GenSigSendType" SG_ 344 FrntSideRdrLeDetn125RdrDetnChks 0;
BA_ "GenSigFuncType" SG_ 344 FrntSideRdrLeDetn125RdrDetnCntr 16;
BA_ "GenSigSendType" SG_ 344 FrntSideRdrLeDetn125RdrDetnCntr 0;
BA_ "GenSigSendType" SG_ 344 FrntSideRdrLeDetn125RdrDetnConf 0;
BA_ "GenSigSendType" SG_ 344 FrntSideRdrLeDetn125RdrDetnElevn 0;
BA_ "GenSigStartValue" SG_ 344 FrntSideRdrLeDetn125RdrDetnElevn 15;
BA_ "GenSigSendType" SG_ 344 FrntSideRdrLeDetn125RdrDetnPwr 0;
BA_ "GenSigSendType" SG_ 344 FrntSideRdrLeDetn125RdrDetnRng 0;
BA_ "GenSigStartValue" SG_ 344 FrntSideRdrLeDetn125RdrDetnRng 10050;
BA_ "GenSigSendType" SG_ 344 FrntSideRdrLeDetn125RdrDetnRngV 0;
BA_ "GenSigStartValue" SG_ 344 FrntSideRdrLeDetn125RdrDetnRngV 4000;
BA_ "GenSigSendType" SG_ 344 FrntSideRdrLeDetn125RdrDetnSts 0;
BA_ "GenSigStartValue" SG_ 344 FrntSideRdrLeDetn125RdrDetnSts 3;
BA_ "GenSigSendType" SG_ 344 FrntSideRdrLeDetn126RdrDetnAzi 0;
BA_ "GenSigStartValue" SG_ 344 FrntSideRdrLeDetn126RdrDetnAzi 900;
BA_ "GenSigDataID" SG_ 344 FrntSideRdrLeDetn126RdrDetnChks "0x8B1";
BA_ "GenSigFuncType" SG_ 344 FrntSideRdrLeDetn126RdrDetnChks 15;
BA_ "GenSigSendType" SG_ 344 FrntSideRdrLeDetn126RdrDetnChks 0;
BA_ "GenSigFuncType" SG_ 344 FrntSideRdrLeDetn126RdrDetnCntr 16;
BA_ "GenSigSendType" SG_ 344 FrntSideRdrLeDetn126RdrDetnCntr 0;
BA_ "GenSigSendType" SG_ 344 FrntSideRdrLeDetn126RdrDetnConf 0;
BA_ "GenSigSendType" SG_ 344 FrntSideRdrLeDetn126RdrDetnElevn 0;
BA_ "GenSigStartValue" SG_ 344 FrntSideRdrLeDetn126RdrDetnElevn 15;
BA_ "GenSigSendType" SG_ 344 FrntSideRdrLeDetn126RdrDetnPwr 0;
BA_ "GenSigSendType" SG_ 344 FrntSideRdrLeDetn126RdrDetnRng 0;
BA_ "GenSigStartValue" SG_ 344 FrntSideRdrLeDetn126RdrDetnRng 10050;
BA_ "GenSigSendType" SG_ 344 FrntSideRdrLeDetn126RdrDetnRngV 0;
BA_ "GenSigStartValue" SG_ 344 FrntSideRdrLeDetn126RdrDetnRngV 4000;
BA_ "GenSigSendType" SG_ 344 FrntSideRdrLeDetn126RdrDetnSts 0;
BA_ "GenSigStartValue" SG_ 344 FrntSideRdrLeDetn126RdrDetnSts 3;
BA_ "GenSigSendType" SG_ 346 FrntSideRdrLeDetn127RdrDetnAzi 0;
BA_ "GenSigStartValue" SG_ 346 FrntSideRdrLeDetn127RdrDetnAzi 900;
BA_ "GenSigDataID" SG_ 346 FrntSideRdrLeDetn127RdrDetnChks "0x8B2";
BA_ "GenSigFuncType" SG_ 346 FrntSideRdrLeDetn127RdrDetnChks 15;
BA_ "GenSigSendType" SG_ 346 FrntSideRdrLeDetn127RdrDetnChks 0;
BA_ "GenSigFuncType" SG_ 346 FrntSideRdrLeDetn127RdrDetnCntr 16;
BA_ "GenSigSendType" SG_ 346 FrntSideRdrLeDetn127RdrDetnCntr 0;
BA_ "GenSigSendType" SG_ 346 FrntSideRdrLeDetn127RdrDetnConf 0;
BA_ "GenSigSendType" SG_ 346 FrntSideRdrLeDetn127RdrDetnElevn 0;
BA_ "GenSigStartValue" SG_ 346 FrntSideRdrLeDetn127RdrDetnElevn 15;
BA_ "GenSigSendType" SG_ 346 FrntSideRdrLeDetn127RdrDetnPwr 0;
BA_ "GenSigSendType" SG_ 346 FrntSideRdrLeDetn127RdrDetnRng 0;
BA_ "GenSigStartValue" SG_ 346 FrntSideRdrLeDetn127RdrDetnRng 10050;
BA_ "GenSigSendType" SG_ 346 FrntSideRdrLeDetn127RdrDetnRngV 0;
BA_ "GenSigStartValue" SG_ 346 FrntSideRdrLeDetn127RdrDetnRngV 4000;
BA_ "GenSigSendType" SG_ 346 FrntSideRdrLeDetn127RdrDetnSts 0;
BA_ "GenSigStartValue" SG_ 346 FrntSideRdrLeDetn127RdrDetnSts 3;
BA_ "GenSigSendType" SG_ 346 FrntSideRdrLeDetn128RdrDetnAzi 0;
BA_ "GenSigStartValue" SG_ 346 FrntSideRdrLeDetn128RdrDetnAzi 900;
BA_ "GenSigDataID" SG_ 346 FrntSideRdrLeDetn128RdrDetnChks "0x8B3";
BA_ "GenSigFuncType" SG_ 346 FrntSideRdrLeDetn128RdrDetnChks 15;
BA_ "GenSigSendType" SG_ 346 FrntSideRdrLeDetn128RdrDetnChks 0;
BA_ "GenSigFuncType" SG_ 346 FrntSideRdrLeDetn128RdrDetnCntr 16;
BA_ "GenSigSendType" SG_ 346 FrntSideRdrLeDetn128RdrDetnCntr 0;
BA_ "GenSigSendType" SG_ 346 FrntSideRdrLeDetn128RdrDetnConf 0;
BA_ "GenSigSendType" SG_ 346 FrntSideRdrLeDetn128RdrDetnElevn 0;
BA_ "GenSigStartValue" SG_ 346 FrntSideRdrLeDetn128RdrDetnElevn 15;
BA_ "GenSigSendType" SG_ 346 FrntSideRdrLeDetn128RdrDetnPwr 0;
BA_ "GenSigSendType" SG_ 346 FrntSideRdrLeDetn128RdrDetnRng 0;
BA_ "GenSigStartValue" SG_ 346 FrntSideRdrLeDetn128RdrDetnRng 10050;
BA_ "GenSigSendType" SG_ 346 FrntSideRdrLeDetn128RdrDetnRngV 0;
BA_ "GenSigStartValue" SG_ 346 FrntSideRdrLeDetn128RdrDetnRngV 4000;
BA_ "GenSigSendType" SG_ 346 FrntSideRdrLeDetn128RdrDetnSts 0;
BA_ "GenSigStartValue" SG_ 346 FrntSideRdrLeDetn128RdrDetnSts 3;
BA_ "GenSigSendType" SG_ 332 FrntSideRdrLeDetn85RdrDetnAzi 0;
BA_ "GenSigStartValue" SG_ 332 FrntSideRdrLeDetn85RdrDetnAzi 900;
BA_ "GenSigDataID" SG_ 332 FrntSideRdrLeDetn85RdrDetnChks "0x888";
BA_ "GenSigFuncType" SG_ 332 FrntSideRdrLeDetn85RdrDetnChks 15;
BA_ "GenSigSendType" SG_ 332 FrntSideRdrLeDetn85RdrDetnChks 0;
BA_ "GenSigFuncType" SG_ 332 FrntSideRdrLeDetn85RdrDetnCntr 16;
BA_ "GenSigSendType" SG_ 332 FrntSideRdrLeDetn85RdrDetnCntr 0;
BA_ "GenSigSendType" SG_ 332 FrntSideRdrLeDetn85RdrDetnConf 0;
BA_ "GenSigSendType" SG_ 332 FrntSideRdrLeDetn85RdrDetnElevn 0;
BA_ "GenSigStartValue" SG_ 332 FrntSideRdrLeDetn85RdrDetnElevn 15;
BA_ "GenSigSendType" SG_ 332 FrntSideRdrLeDetn85RdrDetnPwr 0;
BA_ "GenSigSendType" SG_ 332 FrntSideRdrLeDetn85RdrDetnRng 0;
BA_ "GenSigStartValue" SG_ 332 FrntSideRdrLeDetn85RdrDetnRng 10050;
BA_ "GenSigSendType" SG_ 332 FrntSideRdrLeDetn85RdrDetnRngV 0;
BA_ "GenSigStartValue" SG_ 332 FrntSideRdrLeDetn85RdrDetnRngV 4000;
BA_ "GenSigSendType" SG_ 332 FrntSideRdrLeDetn85RdrDetnSts 0;
BA_ "GenSigStartValue" SG_ 332 FrntSideRdrLeDetn85RdrDetnSts 3;
BA_ "GenSigSendType" SG_ 332 FrntSideRdrLeDetn86RdrDetnAzi 0;
BA_ "GenSigStartValue" SG_ 332 FrntSideRdrLeDetn86RdrDetnAzi 900;
BA_ "GenSigDataID" SG_ 332 FrntSideRdrLeDetn86RdrDetnChks "0x889";
BA_ "GenSigFuncType" SG_ 332 FrntSideRdrLeDetn86RdrDetnChks 15;
BA_ "GenSigSendType" SG_ 332 FrntSideRdrLeDetn86RdrDetnChks 0;
BA_ "GenSigFuncType" SG_ 332 FrntSideRdrLeDetn86RdrDetnCntr 16;
BA_ "GenSigSendType" SG_ 332 FrntSideRdrLeDetn86RdrDetnCntr 0;
BA_ "GenSigSendType" SG_ 332 FrntSideRdrLeDetn86RdrDetnConf 0;
BA_ "GenSigSendType" SG_ 332 FrntSideRdrLeDetn86RdrDetnElevn 0;
BA_ "GenSigStartValue" SG_ 332 FrntSideRdrLeDetn86RdrDetnElevn 15;
BA_ "GenSigSendType" SG_ 332 FrntSideRdrLeDetn86RdrDetnPwr 0;
BA_ "GenSigSendType" SG_ 332 FrntSideRdrLeDetn86RdrDetnRng 0;
BA_ "GenSigStartValue" SG_ 332 FrntSideRdrLeDetn86RdrDetnRng 10050;
BA_ "GenSigSendType" SG_ 332 FrntSideRdrLeDetn86RdrDetnRngV 0;
BA_ "GenSigStartValue" SG_ 332 FrntSideRdrLeDetn86RdrDetnRngV 4000;
BA_ "GenSigSendType" SG_ 332 FrntSideRdrLeDetn86RdrDetnSts 0;
BA_ "GenSigStartValue" SG_ 332 FrntSideRdrLeDetn86RdrDetnSts 3;
BA_ "GenSigSendType" SG_ 332 FrntSideRdrLeDetn87RdrDetnAzi 0;
BA_ "GenSigStartValue" SG_ 332 FrntSideRdrLeDetn87RdrDetnAzi 900;
BA_ "GenSigDataID" SG_ 332 FrntSideRdrLeDetn87RdrDetnChks "0x88A";
BA_ "GenSigFuncType" SG_ 332 FrntSideRdrLeDetn87RdrDetnChks 15;
BA_ "GenSigSendType" SG_ 332 FrntSideRdrLeDetn87RdrDetnChks 0;
BA_ "GenSigFuncType" SG_ 332 FrntSideRdrLeDetn87RdrDetnCntr 16;
BA_ "GenSigSendType" SG_ 332 FrntSideRdrLeDetn87RdrDetnCntr 0;
BA_ "GenSigSendType" SG_ 332 FrntSideRdrLeDetn87RdrDetnConf 0;
BA_ "GenSigSendType" SG_ 332 FrntSideRdrLeDetn87RdrDetnElevn 0;
BA_ "GenSigStartValue" SG_ 332 FrntSideRdrLeDetn87RdrDetnElevn 15;
BA_ "GenSigSendType" SG_ 332 FrntSideRdrLeDetn87RdrDetnPwr 0;
BA_ "GenSigSendType" SG_ 332 FrntSideRdrLeDetn87RdrDetnRng 0;
BA_ "GenSigStartValue" SG_ 332 FrntSideRdrLeDetn87RdrDetnRng 10050;
BA_ "GenSigSendType" SG_ 332 FrntSideRdrLeDetn87RdrDetnRngV 0;
BA_ "GenSigStartValue" SG_ 332 FrntSideRdrLeDetn87RdrDetnRngV 4000;
BA_ "GenSigSendType" SG_ 332 FrntSideRdrLeDetn87RdrDetnSts 0;
BA_ "GenSigStartValue" SG_ 332 FrntSideRdrLeDetn87RdrDetnSts 3;
BA_ "GenSigSendType" SG_ 332 FrntSideRdrLeDetn88RdrDetnAzi 0;
BA_ "GenSigStartValue" SG_ 332 FrntSideRdrLeDetn88RdrDetnAzi 900;
BA_ "GenSigDataID" SG_ 332 FrntSideRdrLeDetn88RdrDetnChks "0x88B";
BA_ "GenSigFuncType" SG_ 332 FrntSideRdrLeDetn88RdrDetnChks 15;
BA_ "GenSigSendType" SG_ 332 FrntSideRdrLeDetn88RdrDetnChks 0;
BA_ "GenSigFuncType" SG_ 332 FrntSideRdrLeDetn88RdrDetnCntr 16;
BA_ "GenSigSendType" SG_ 332 FrntSideRdrLeDetn88RdrDetnCntr 0;
BA_ "GenSigSendType" SG_ 332 FrntSideRdrLeDetn88RdrDetnConf 0;
BA_ "GenSigSendType" SG_ 332 FrntSideRdrLeDetn88RdrDetnElevn 0;
BA_ "GenSigStartValue" SG_ 332 FrntSideRdrLeDetn88RdrDetnElevn 15;
BA_ "GenSigSendType" SG_ 332 FrntSideRdrLeDetn88RdrDetnPwr 0;
BA_ "GenSigSendType" SG_ 332 FrntSideRdrLeDetn88RdrDetnRng 0;
BA_ "GenSigStartValue" SG_ 332 FrntSideRdrLeDetn88RdrDetnRng 10050;
BA_ "GenSigSendType" SG_ 332 FrntSideRdrLeDetn88RdrDetnRngV 0;
BA_ "GenSigStartValue" SG_ 332 FrntSideRdrLeDetn88RdrDetnRngV 4000;
BA_ "GenSigSendType" SG_ 332 FrntSideRdrLeDetn88RdrDetnSts 0;
BA_ "GenSigStartValue" SG_ 332 FrntSideRdrLeDetn88RdrDetnSts 3;
BA_ "GenSigSendType" SG_ 332 FrntSideRdrLeDetn89RdrDetnAzi 0;
BA_ "GenSigStartValue" SG_ 332 FrntSideRdrLeDetn89RdrDetnAzi 900;
BA_ "GenSigDataID" SG_ 332 FrntSideRdrLeDetn89RdrDetnChks "0x88C";
BA_ "GenSigFuncType" SG_ 332 FrntSideRdrLeDetn89RdrDetnChks 15;
BA_ "GenSigSendType" SG_ 332 FrntSideRdrLeDetn89RdrDetnChks 0;
BA_ "GenSigFuncType" SG_ 332 FrntSideRdrLeDetn89RdrDetnCntr 16;
BA_ "GenSigSendType" SG_ 332 FrntSideRdrLeDetn89RdrDetnCntr 0;
BA_ "GenSigSendType" SG_ 332 FrntSideRdrLeDetn89RdrDetnConf 0;
BA_ "GenSigSendType" SG_ 332 FrntSideRdrLeDetn89RdrDetnElevn 0;
BA_ "GenSigStartValue" SG_ 332 FrntSideRdrLeDetn89RdrDetnElevn 15;
BA_ "GenSigSendType" SG_ 332 FrntSideRdrLeDetn89RdrDetnPwr 0;
BA_ "GenSigSendType" SG_ 332 FrntSideRdrLeDetn89RdrDetnRng 0;
BA_ "GenSigStartValue" SG_ 332 FrntSideRdrLeDetn89RdrDetnRng 10050;
BA_ "GenSigSendType" SG_ 332 FrntSideRdrLeDetn89RdrDetnRngV 0;
BA_ "GenSigStartValue" SG_ 332 FrntSideRdrLeDetn89RdrDetnRngV 4000;
BA_ "GenSigSendType" SG_ 332 FrntSideRdrLeDetn89RdrDetnSts 0;
BA_ "GenSigStartValue" SG_ 332 FrntSideRdrLeDetn89RdrDetnSts 3;
BA_ "GenSigSendType" SG_ 332 FrntSideRdrLeDetn90RdrDetnAzi 0;
BA_ "GenSigStartValue" SG_ 332 FrntSideRdrLeDetn90RdrDetnAzi 900;
BA_ "GenSigDataID" SG_ 332 FrntSideRdrLeDetn90RdrDetnChks "0x88D";
BA_ "GenSigFuncType" SG_ 332 FrntSideRdrLeDetn90RdrDetnChks 15;
BA_ "GenSigSendType" SG_ 332 FrntSideRdrLeDetn90RdrDetnChks 0;
BA_ "GenSigFuncType" SG_ 332 FrntSideRdrLeDetn90RdrDetnCntr 16;
BA_ "GenSigSendType" SG_ 332 FrntSideRdrLeDetn90RdrDetnCntr 0;
BA_ "GenSigSendType" SG_ 332 FrntSideRdrLeDetn90RdrDetnConf 0;
BA_ "GenSigSendType" SG_ 332 FrntSideRdrLeDetn90RdrDetnElevn 0;
BA_ "GenSigStartValue" SG_ 332 FrntSideRdrLeDetn90RdrDetnElevn 15;
BA_ "GenSigSendType" SG_ 332 FrntSideRdrLeDetn90RdrDetnPwr 0;
BA_ "GenSigSendType" SG_ 332 FrntSideRdrLeDetn90RdrDetnRng 0;
BA_ "GenSigStartValue" SG_ 332 FrntSideRdrLeDetn90RdrDetnRng 10050;
BA_ "GenSigSendType" SG_ 332 FrntSideRdrLeDetn90RdrDetnRngV 0;
BA_ "GenSigStartValue" SG_ 332 FrntSideRdrLeDetn90RdrDetnRngV 4000;
BA_ "GenSigSendType" SG_ 332 FrntSideRdrLeDetn90RdrDetnSts 0;
BA_ "GenSigStartValue" SG_ 332 FrntSideRdrLeDetn90RdrDetnSts 3;
BA_ "GenSigSendType" SG_ 334 FrntSideRdrLeDetn91RdrDetnAzi 0;
BA_ "GenSigStartValue" SG_ 334 FrntSideRdrLeDetn91RdrDetnAzi 900;
BA_ "GenSigDataID" SG_ 334 FrntSideRdrLeDetn91RdrDetnChks "0x88E";
BA_ "GenSigFuncType" SG_ 334 FrntSideRdrLeDetn91RdrDetnChks 15;
BA_ "GenSigSendType" SG_ 334 FrntSideRdrLeDetn91RdrDetnChks 0;
BA_ "GenSigFuncType" SG_ 334 FrntSideRdrLeDetn91RdrDetnCntr 16;
BA_ "GenSigSendType" SG_ 334 FrntSideRdrLeDetn91RdrDetnCntr 0;
BA_ "GenSigSendType" SG_ 334 FrntSideRdrLeDetn91RdrDetnConf 0;
BA_ "GenSigSendType" SG_ 334 FrntSideRdrLeDetn91RdrDetnElevn 0;
BA_ "GenSigStartValue" SG_ 334 FrntSideRdrLeDetn91RdrDetnElevn 15;
BA_ "GenSigSendType" SG_ 334 FrntSideRdrLeDetn91RdrDetnPwr 0;
BA_ "GenSigSendType" SG_ 334 FrntSideRdrLeDetn91RdrDetnRng 0;
BA_ "GenSigStartValue" SG_ 334 FrntSideRdrLeDetn91RdrDetnRng 10050;
BA_ "GenSigSendType" SG_ 334 FrntSideRdrLeDetn91RdrDetnRngV 0;
BA_ "GenSigStartValue" SG_ 334 FrntSideRdrLeDetn91RdrDetnRngV 4000;
BA_ "GenSigSendType" SG_ 334 FrntSideRdrLeDetn91RdrDetnSts 0;
BA_ "GenSigStartValue" SG_ 334 FrntSideRdrLeDetn91RdrDetnSts 3;
BA_ "GenSigSendType" SG_ 334 FrntSideRdrLeDetn92RdrDetnAzi 0;
BA_ "GenSigStartValue" SG_ 334 FrntSideRdrLeDetn92RdrDetnAzi 900;
BA_ "GenSigDataID" SG_ 334 FrntSideRdrLeDetn92RdrDetnChks "0x88F";
BA_ "GenSigFuncType" SG_ 334 FrntSideRdrLeDetn92RdrDetnChks 15;
BA_ "GenSigSendType" SG_ 334 FrntSideRdrLeDetn92RdrDetnChks 0;
BA_ "GenSigFuncType" SG_ 334 FrntSideRdrLeDetn92RdrDetnCntr 16;
BA_ "GenSigSendType" SG_ 334 FrntSideRdrLeDetn92RdrDetnCntr 0;
BA_ "GenSigSendType" SG_ 334 FrntSideRdrLeDetn92RdrDetnConf 0;
BA_ "GenSigSendType" SG_ 334 FrntSideRdrLeDetn92RdrDetnElevn 0;
BA_ "GenSigStartValue" SG_ 334 FrntSideRdrLeDetn92RdrDetnElevn 15;
BA_ "GenSigSendType" SG_ 334 FrntSideRdrLeDetn92RdrDetnPwr 0;
BA_ "GenSigSendType" SG_ 334 FrntSideRdrLeDetn92RdrDetnRng 0;
BA_ "GenSigStartValue" SG_ 334 FrntSideRdrLeDetn92RdrDetnRng 10050;
BA_ "GenSigSendType" SG_ 334 FrntSideRdrLeDetn92RdrDetnRngV 0;
BA_ "GenSigStartValue" SG_ 334 FrntSideRdrLeDetn92RdrDetnRngV 4000;
BA_ "GenSigSendType" SG_ 334 FrntSideRdrLeDetn92RdrDetnSts 0;
BA_ "GenSigStartValue" SG_ 334 FrntSideRdrLeDetn92RdrDetnSts 3;
BA_ "GenSigSendType" SG_ 334 FrntSideRdrLeDetn93RdrDetnAzi 0;
BA_ "GenSigStartValue" SG_ 334 FrntSideRdrLeDetn93RdrDetnAzi 900;
BA_ "GenSigDataID" SG_ 334 FrntSideRdrLeDetn93RdrDetnChks "0x890";
BA_ "GenSigFuncType" SG_ 334 FrntSideRdrLeDetn93RdrDetnChks 15;
BA_ "GenSigSendType" SG_ 334 FrntSideRdrLeDetn93RdrDetnChks 0;
BA_ "GenSigFuncType" SG_ 334 FrntSideRdrLeDetn93RdrDetnCntr 16;
BA_ "GenSigSendType" SG_ 334 FrntSideRdrLeDetn93RdrDetnCntr 0;
BA_ "GenSigSendType" SG_ 334 FrntSideRdrLeDetn93RdrDetnConf 0;
BA_ "GenSigSendType" SG_ 334 FrntSideRdrLeDetn93RdrDetnElevn 0;
BA_ "GenSigStartValue" SG_ 334 FrntSideRdrLeDetn93RdrDetnElevn 15;
BA_ "GenSigSendType" SG_ 334 FrntSideRdrLeDetn93RdrDetnPwr 0;
BA_ "GenSigSendType" SG_ 334 FrntSideRdrLeDetn93RdrDetnRng 0;
BA_ "GenSigStartValue" SG_ 334 FrntSideRdrLeDetn93RdrDetnRng 10050;
BA_ "GenSigSendType" SG_ 334 FrntSideRdrLeDetn93RdrDetnRngV 0;
BA_ "GenSigStartValue" SG_ 334 FrntSideRdrLeDetn93RdrDetnRngV 4000;
BA_ "GenSigSendType" SG_ 334 FrntSideRdrLeDetn93RdrDetnSts 0;
BA_ "GenSigStartValue" SG_ 334 FrntSideRdrLeDetn93RdrDetnSts 3;
BA_ "GenSigSendType" SG_ 334 FrntSideRdrLeDetn94RdrDetnAzi 0;
BA_ "GenSigStartValue" SG_ 334 FrntSideRdrLeDetn94RdrDetnAzi 900;
BA_ "GenSigDataID" SG_ 334 FrntSideRdrLeDetn94RdrDetnChks "0x891";
BA_ "GenSigFuncType" SG_ 334 FrntSideRdrLeDetn94RdrDetnChks 15;
BA_ "GenSigSendType" SG_ 334 FrntSideRdrLeDetn94RdrDetnChks 0;
BA_ "GenSigFuncType" SG_ 334 FrntSideRdrLeDetn94RdrDetnCntr 16;
BA_ "GenSigSendType" SG_ 334 FrntSideRdrLeDetn94RdrDetnCntr 0;
BA_ "GenSigSendType" SG_ 334 FrntSideRdrLeDetn94RdrDetnConf 0;
BA_ "GenSigSendType" SG_ 334 FrntSideRdrLeDetn94RdrDetnElevn 0;
BA_ "GenSigStartValue" SG_ 334 FrntSideRdrLeDetn94RdrDetnElevn 15;
BA_ "GenSigSendType" SG_ 334 FrntSideRdrLeDetn94RdrDetnPwr 0;
BA_ "GenSigSendType" SG_ 334 FrntSideRdrLeDetn94RdrDetnRng 0;
BA_ "GenSigStartValue" SG_ 334 FrntSideRdrLeDetn94RdrDetnRng 10050;
BA_ "GenSigSendType" SG_ 334 FrntSideRdrLeDetn94RdrDetnRngV 0;
BA_ "GenSigStartValue" SG_ 334 FrntSideRdrLeDetn94RdrDetnRngV 4000;
BA_ "GenSigSendType" SG_ 334 FrntSideRdrLeDetn94RdrDetnSts 0;
BA_ "GenSigStartValue" SG_ 334 FrntSideRdrLeDetn94RdrDetnSts 3;
BA_ "GenSigSendType" SG_ 334 FrntSideRdrLeDetn95RdrDetnAzi 0;
BA_ "GenSigStartValue" SG_ 334 FrntSideRdrLeDetn95RdrDetnAzi 900;
BA_ "GenSigDataID" SG_ 334 FrntSideRdrLeDetn95RdrDetnChks "0x892";
BA_ "GenSigFuncType" SG_ 334 FrntSideRdrLeDetn95RdrDetnChks 15;
BA_ "GenSigSendType" SG_ 334 FrntSideRdrLeDetn95RdrDetnChks 0;
BA_ "GenSigFuncType" SG_ 334 FrntSideRdrLeDetn95RdrDetnCntr 16;
BA_ "GenSigSendType" SG_ 334 FrntSideRdrLeDetn95RdrDetnCntr 0;
BA_ "GenSigSendType" SG_ 334 FrntSideRdrLeDetn95RdrDetnConf 0;
BA_ "GenSigSendType" SG_ 334 FrntSideRdrLeDetn95RdrDetnElevn 0;
BA_ "GenSigStartValue" SG_ 334 FrntSideRdrLeDetn95RdrDetnElevn 15;
BA_ "GenSigSendType" SG_ 334 FrntSideRdrLeDetn95RdrDetnPwr 0;
BA_ "GenSigSendType" SG_ 334 FrntSideRdrLeDetn95RdrDetnRng 0;
BA_ "GenSigStartValue" SG_ 334 FrntSideRdrLeDetn95RdrDetnRng 10050;
BA_ "GenSigSendType" SG_ 334 FrntSideRdrLeDetn95RdrDetnRngV 0;
BA_ "GenSigStartValue" SG_ 334 FrntSideRdrLeDetn95RdrDetnRngV 4000;
BA_ "GenSigSendType" SG_ 334 FrntSideRdrLeDetn95RdrDetnSts 0;
BA_ "GenSigStartValue" SG_ 334 FrntSideRdrLeDetn95RdrDetnSts 3;
BA_ "GenSigSendType" SG_ 334 FrntSideRdrLeDetn96RdrDetnAzi 0;
BA_ "GenSigStartValue" SG_ 334 FrntSideRdrLeDetn96RdrDetnAzi 900;
BA_ "GenSigDataID" SG_ 334 FrntSideRdrLeDetn96RdrDetnChks "0x893";
BA_ "GenSigFuncType" SG_ 334 FrntSideRdrLeDetn96RdrDetnChks 15;
BA_ "GenSigSendType" SG_ 334 FrntSideRdrLeDetn96RdrDetnChks 0;
BA_ "GenSigFuncType" SG_ 334 FrntSideRdrLeDetn96RdrDetnCntr 16;
BA_ "GenSigSendType" SG_ 334 FrntSideRdrLeDetn96RdrDetnCntr 0;
BA_ "GenSigSendType" SG_ 334 FrntSideRdrLeDetn96RdrDetnConf 0;
BA_ "GenSigSendType" SG_ 334 FrntSideRdrLeDetn96RdrDetnElevn 0;
BA_ "GenSigStartValue" SG_ 334 FrntSideRdrLeDetn96RdrDetnElevn 15;
BA_ "GenSigSendType" SG_ 334 FrntSideRdrLeDetn96RdrDetnPwr 0;
BA_ "GenSigSendType" SG_ 334 FrntSideRdrLeDetn96RdrDetnRng 0;
BA_ "GenSigStartValue" SG_ 334 FrntSideRdrLeDetn96RdrDetnRng 10050;
BA_ "GenSigSendType" SG_ 334 FrntSideRdrLeDetn96RdrDetnRngV 0;
BA_ "GenSigStartValue" SG_ 334 FrntSideRdrLeDetn96RdrDetnRngV 4000;
BA_ "GenSigSendType" SG_ 334 FrntSideRdrLeDetn96RdrDetnSts 0;
BA_ "GenSigStartValue" SG_ 334 FrntSideRdrLeDetn96RdrDetnSts 3;
BA_ "GenSigSendType" SG_ 336 FrntSideRdrLeDetn97RdrDetnAzi 0;
BA_ "GenSigStartValue" SG_ 336 FrntSideRdrLeDetn97RdrDetnAzi 900;
BA_ "GenSigDataID" SG_ 336 FrntSideRdrLeDetn97RdrDetnChks "0x894";
BA_ "GenSigFuncType" SG_ 336 FrntSideRdrLeDetn97RdrDetnChks 15;
BA_ "GenSigSendType" SG_ 336 FrntSideRdrLeDetn97RdrDetnChks 0;
BA_ "GenSigFuncType" SG_ 336 FrntSideRdrLeDetn97RdrDetnCntr 16;
BA_ "GenSigSendType" SG_ 336 FrntSideRdrLeDetn97RdrDetnCntr 0;
BA_ "GenSigSendType" SG_ 336 FrntSideRdrLeDetn97RdrDetnConf 0;
BA_ "GenSigSendType" SG_ 336 FrntSideRdrLeDetn97RdrDetnElevn 0;
BA_ "GenSigStartValue" SG_ 336 FrntSideRdrLeDetn97RdrDetnElevn 15;
BA_ "GenSigSendType" SG_ 336 FrntSideRdrLeDetn97RdrDetnPwr 0;
BA_ "GenSigSendType" SG_ 336 FrntSideRdrLeDetn97RdrDetnRng 0;
BA_ "GenSigStartValue" SG_ 336 FrntSideRdrLeDetn97RdrDetnRng 10050;
BA_ "GenSigSendType" SG_ 336 FrntSideRdrLeDetn97RdrDetnRngV 0;
BA_ "GenSigStartValue" SG_ 336 FrntSideRdrLeDetn97RdrDetnRngV 4000;
BA_ "GenSigSendType" SG_ 336 FrntSideRdrLeDetn97RdrDetnSts 0;
BA_ "GenSigStartValue" SG_ 336 FrntSideRdrLeDetn97RdrDetnSts 3;
BA_ "GenSigSendType" SG_ 336 FrntSideRdrLeDetn98RdrDetnAzi 0;
BA_ "GenSigStartValue" SG_ 336 FrntSideRdrLeDetn98RdrDetnAzi 900;
BA_ "GenSigDataID" SG_ 336 FrntSideRdrLeDetn98RdrDetnChks "0x895";
BA_ "GenSigFuncType" SG_ 336 FrntSideRdrLeDetn98RdrDetnChks 15;
BA_ "GenSigSendType" SG_ 336 FrntSideRdrLeDetn98RdrDetnChks 0;
BA_ "GenSigFuncType" SG_ 336 FrntSideRdrLeDetn98RdrDetnCntr 16;
BA_ "GenSigSendType" SG_ 336 FrntSideRdrLeDetn98RdrDetnCntr 0;
BA_ "GenSigSendType" SG_ 336 FrntSideRdrLeDetn98RdrDetnConf 0;
BA_ "GenSigSendType" SG_ 336 FrntSideRdrLeDetn98RdrDetnElevn 0;
BA_ "GenSigStartValue" SG_ 336 FrntSideRdrLeDetn98RdrDetnElevn 15;
BA_ "GenSigSendType" SG_ 336 FrntSideRdrLeDetn98RdrDetnPwr 0;
BA_ "GenSigSendType" SG_ 336 FrntSideRdrLeDetn98RdrDetnRng 0;
BA_ "GenSigStartValue" SG_ 336 FrntSideRdrLeDetn98RdrDetnRng 10050;
BA_ "GenSigSendType" SG_ 336 FrntSideRdrLeDetn98RdrDetnRngV 0;
BA_ "GenSigStartValue" SG_ 336 FrntSideRdrLeDetn98RdrDetnRngV 4000;
BA_ "GenSigSendType" SG_ 336 FrntSideRdrLeDetn98RdrDetnSts 0;
BA_ "GenSigStartValue" SG_ 336 FrntSideRdrLeDetn98RdrDetnSts 3;
BA_ "GenSigSendType" SG_ 336 FrntSideRdrLeDetn99RdrDetnAzi 0;
BA_ "GenSigStartValue" SG_ 336 FrntSideRdrLeDetn99RdrDetnAzi 900;
BA_ "GenSigDataID" SG_ 336 FrntSideRdrLeDetn99RdrDetnChks "0x896";
BA_ "GenSigFuncType" SG_ 336 FrntSideRdrLeDetn99RdrDetnChks 15;
BA_ "GenSigSendType" SG_ 336 FrntSideRdrLeDetn99RdrDetnChks 0;
BA_ "GenSigFuncType" SG_ 336 FrntSideRdrLeDetn99RdrDetnCntr 16;
BA_ "GenSigSendType" SG_ 336 FrntSideRdrLeDetn99RdrDetnCntr 0;
BA_ "GenSigSendType" SG_ 336 FrntSideRdrLeDetn99RdrDetnConf 0;
BA_ "GenSigSendType" SG_ 336 FrntSideRdrLeDetn99RdrDetnElevn 0;
BA_ "GenSigStartValue" SG_ 336 FrntSideRdrLeDetn99RdrDetnElevn 15;
BA_ "GenSigSendType" SG_ 336 FrntSideRdrLeDetn99RdrDetnPwr 0;
BA_ "GenSigSendType" SG_ 336 FrntSideRdrLeDetn99RdrDetnRng 0;
BA_ "GenSigStartValue" SG_ 336 FrntSideRdrLeDetn99RdrDetnRng 10050;
BA_ "GenSigSendType" SG_ 336 FrntSideRdrLeDetn99RdrDetnRngV 0;
BA_ "GenSigStartValue" SG_ 336 FrntSideRdrLeDetn99RdrDetnRngV 4000;
BA_ "GenSigSendType" SG_ 336 FrntSideRdrLeDetn99RdrDetnSts 0;
BA_ "GenSigStartValue" SG_ 336 FrntSideRdrLeDetn99RdrDetnSts 3;
BA_ "GenSigSendType" SG_ 348 FrntSideRdrLeObj1Heading 0;
BA_ "GenSigStartValue" SG_ 348 FrntSideRdrLeObj1Heading 1800;
BA_ "GenSigSendType" SG_ 348 FrntSideRdrLeObj1ObjBoxCenterLat 0;
BA_ "GenSigStartValue" SG_ 348 FrntSideRdrLeObj1ObjBoxCenterLat 250;
BA_ "GenSigSendType" SG_ 348 FrntSideRdrLeObj1ObjBoxCenterLgt 0;
BA_ "GenSigStartValue" SG_ 348 FrntSideRdrLeObj1ObjBoxCenterLgt 250;
BA_ "GenSigSendType" SG_ 348 FrntSideRdrLeObj1ObservationHist 0;
BA_ "GenSigSendType" SG_ 348 FrntSideRdrLeObj1QualityBits 0;
BA_ "GenSigSendType" SG_ 348 FrntSideRdrLeObj1RdrObjAx 0;
BA_ "GenSigSendType" SG_ 348 FrntSideRdrLeObj1RdrObjAy 0;
BA_ "GenSigSendType" SG_ 348 FrntSideRdrLeObj1RdrObjBoxLength 0;
BA_ "GenSigSendType" SG_ 348 FrntSideRdrLeObj1RdrObjBoxWidth 0;
BA_ "GenSigDataID" SG_ 348 FrntSideRdrLeObj1RdrObjChks "0x8B4";
BA_ "GenSigFuncType" SG_ 348 FrntSideRdrLeObj1RdrObjChks 15;
BA_ "GenSigSendType" SG_ 348 FrntSideRdrLeObj1RdrObjChks 0;
BA_ "GenSigFuncType" SG_ 348 FrntSideRdrLeObj1RdrObjCntr 16;
BA_ "GenSigSendType" SG_ 348 FrntSideRdrLeObj1RdrObjCntr 0;
BA_ "GenSigSendType" SG_ 348 FrntSideRdrLeObj1RdrObjCoastCnt 0;
BA_ "GenSigStartValue" SG_ 348 FrntSideRdrLeObj1RdrObjCoastCnt 31;
BA_ "GenSigSendType" SG_ 348 FrntSideRdrLeObj1RdrObjConf 0;
BA_ "GenSigSendType" SG_ 348 FrntSideRdrLeObj1RdrObjDx 0;
BA_ "GenSigSendType" SG_ 348 FrntSideRdrLeObj1RdrObjDxStdDe 0;
BA_ "GenSigSendType" SG_ 348 FrntSideRdrLeObj1RdrObjDy 0;
BA_ "GenSigStartValue" SG_ 348 FrntSideRdrLeObj1RdrObjDy 4000;
BA_ "GenSigSendType" SG_ 348 FrntSideRdrLeObj1RdrObjDyStdDe 0;
BA_ "GenSigSendType" SG_ 348 FrntSideRdrLeObj1RdrObjElevnConf 0;
BA_ "GenSigSendType" SG_ 348 FrntSideRdrLeObj1RdrObjElevnSts 0;
BA_ "GenSigSendType" SG_ 348 FrntSideRdrLeObj1RdrObjID 0;
BA_ "GenSigSendType" SG_ 348 FrntSideRdrLeObj1RdrObjIsInFreeSpace 0;
BA_ "GenSigStartValue" SG_ 348 FrntSideRdrLeObj1RdrObjIsInFreeSpace 1;
BA_ "GenSigSendType" SG_ 348 FrntSideRdrLeObj1RdrObjMirrProblty 0;
BA_ "GenSigSendType" SG_ 348 FrntSideRdrLeObj1RdrObjMtnPat 0;
BA_ "GenSigStartValue" SG_ 348 FrntSideRdrLeObj1RdrObjMtnPat 3;
BA_ "GenSigSendType" SG_ 348 FrntSideRdrLeObj1RdrObjNotRealProblty 0;
BA_ "GenSigSendType" SG_ 348 FrntSideRdrLeObj1RdrObjStatyCnt 0;
BA_ "GenSigSendType" SG_ 348 FrntSideRdrLeObj1RdrObjTiAlv 0;
BA_ "GenSigSendType" SG_ 348 FrntSideRdrLeObj1RdrObjTrackSts 0;
BA_ "GenSigSendType" SG_ 348 FrntSideRdrLeObj1RdrObjTyp 0;
BA_ "GenSigSendType" SG_ 348 FrntSideRdrLeObj1RdrObjTypConfBike 0;
BA_ "GenSigSendType" SG_ 348 FrntSideRdrLeObj1RdrObjTypConfPed 0;
BA_ "GenSigSendType" SG_ 348 FrntSideRdrLeObj1RdrObjTypConfVeh 0;
BA_ "GenSigSendType" SG_ 348 FrntSideRdrLeObj1RdrObjUsedTracker 0;
BA_ "GenSigStartValue" SG_ 348 FrntSideRdrLeObj1RdrObjUsedTracker 3;
BA_ "GenSigSendType" SG_ 348 FrntSideRdrLeObj1RdrObjVx 0;
BA_ "GenSigStartValue" SG_ 348 FrntSideRdrLeObj1RdrObjVx 6400;
BA_ "GenSigSendType" SG_ 348 FrntSideRdrLeObj1RdrObjVxStdDe 0;
BA_ "GenSigSendType" SG_ 348 FrntSideRdrLeObj1RdrObjVy 0;
BA_ "GenSigStartValue" SG_ 348 FrntSideRdrLeObj1RdrObjVy 6400;
BA_ "GenSigSendType" SG_ 348 FrntSideRdrLeObj1RdrObjVyStdDe 0;
BA_ "GenSigSendType" SG_ 348 FrntSideRdrLeObj1RelVx 0;
BA_ "GenSigStartValue" SG_ 348 FrntSideRdrLeObj1RelVx 1780;
BA_ "GenSigSendType" SG_ 348 FrntSideRdrLeObj1RelVy 0;
BA_ "GenSigStartValue" SG_ 348 FrntSideRdrLeObj1RelVy 1780;
BA_ "GenSigSendType" SG_ 350 FrntSideRdrLeObj2Heading 0;
BA_ "GenSigStartValue" SG_ 350 FrntSideRdrLeObj2Heading 1800;
BA_ "GenSigSendType" SG_ 350 FrntSideRdrLeObj2ObjBoxCenterLat 0;
BA_ "GenSigStartValue" SG_ 350 FrntSideRdrLeObj2ObjBoxCenterLat 250;
BA_ "GenSigSendType" SG_ 350 FrntSideRdrLeObj2ObjBoxCenterLgt 0;
BA_ "GenSigStartValue" SG_ 350 FrntSideRdrLeObj2ObjBoxCenterLgt 250;
BA_ "GenSigSendType" SG_ 350 FrntSideRdrLeObj2ObservationHist 0;
BA_ "GenSigSendType" SG_ 350 FrntSideRdrLeObj2QualityBits 0;
BA_ "GenSigSendType" SG_ 350 FrntSideRdrLeObj2RdrObjAx 0;
BA_ "GenSigSendType" SG_ 350 FrntSideRdrLeObj2RdrObjAy 0;
BA_ "GenSigSendType" SG_ 350 FrntSideRdrLeObj2RdrObjBoxLength 0;
BA_ "GenSigSendType" SG_ 350 FrntSideRdrLeObj2RdrObjBoxWidth 0;
BA_ "GenSigDataID" SG_ 350 FrntSideRdrLeObj2RdrObjChks "0x8B5";
BA_ "GenSigFuncType" SG_ 350 FrntSideRdrLeObj2RdrObjChks 15;
BA_ "GenSigSendType" SG_ 350 FrntSideRdrLeObj2RdrObjChks 0;
BA_ "GenSigFuncType" SG_ 350 FrntSideRdrLeObj2RdrObjCntr 16;
BA_ "GenSigSendType" SG_ 350 FrntSideRdrLeObj2RdrObjCntr 0;
BA_ "GenSigSendType" SG_ 350 FrntSideRdrLeObj2RdrObjCoastCnt 0;
BA_ "GenSigStartValue" SG_ 350 FrntSideRdrLeObj2RdrObjCoastCnt 31;
BA_ "GenSigSendType" SG_ 350 FrntSideRdrLeObj2RdrObjConf 0;
BA_ "GenSigSendType" SG_ 350 FrntSideRdrLeObj2RdrObjDx 0;
BA_ "GenSigSendType" SG_ 350 FrntSideRdrLeObj2RdrObjDxStdDe 0;
BA_ "GenSigSendType" SG_ 350 FrntSideRdrLeObj2RdrObjDy 0;
BA_ "GenSigStartValue" SG_ 350 FrntSideRdrLeObj2RdrObjDy 4000;
BA_ "GenSigSendType" SG_ 350 FrntSideRdrLeObj2RdrObjDyStdDe 0;
BA_ "GenSigSendType" SG_ 350 FrntSideRdrLeObj2RdrObjElevnConf 0;
BA_ "GenSigSendType" SG_ 350 FrntSideRdrLeObj2RdrObjElevnSts 0;
BA_ "GenSigSendType" SG_ 350 FrntSideRdrLeObj2RdrObjID 0;
BA_ "GenSigSendType" SG_ 350 FrntSideRdrLeObj2RdrObjIsInFreeSpace 0;
BA_ "GenSigStartValue" SG_ 350 FrntSideRdrLeObj2RdrObjIsInFreeSpace 1;
BA_ "GenSigSendType" SG_ 350 FrntSideRdrLeObj2RdrObjMirrProblty 0;
BA_ "GenSigSendType" SG_ 350 FrntSideRdrLeObj2RdrObjMtnPat 0;
BA_ "GenSigStartValue" SG_ 350 FrntSideRdrLeObj2RdrObjMtnPat 3;
BA_ "GenSigSendType" SG_ 350 FrntSideRdrLeObj2RdrObjNotRealProblty 0;
BA_ "GenSigSendType" SG_ 350 FrntSideRdrLeObj2RdrObjStatyCnt 0;
BA_ "GenSigSendType" SG_ 350 FrntSideRdrLeObj2RdrObjTiAlv 0;
BA_ "GenSigSendType" SG_ 350 FrntSideRdrLeObj2RdrObjTrackSts 0;
BA_ "GenSigSendType" SG_ 350 FrntSideRdrLeObj2RdrObjTyp 0;
BA_ "GenSigSendType" SG_ 350 FrntSideRdrLeObj2RdrObjTypConfBike 0;
BA_ "GenSigSendType" SG_ 350 FrntSideRdrLeObj2RdrObjTypConfPed 0;
BA_ "GenSigSendType" SG_ 350 FrntSideRdrLeObj2RdrObjTypConfVeh 0;
BA_ "GenSigSendType" SG_ 350 FrntSideRdrLeObj2RdrObjUsedTracker 0;
BA_ "GenSigStartValue" SG_ 350 FrntSideRdrLeObj2RdrObjUsedTracker 3;
BA_ "GenSigSendType" SG_ 350 FrntSideRdrLeObj2RdrObjVx 0;
BA_ "GenSigStartValue" SG_ 350 FrntSideRdrLeObj2RdrObjVx 6400;
BA_ "GenSigSendType" SG_ 350 FrntSideRdrLeObj2RdrObjVxStdDe 0;
BA_ "GenSigSendType" SG_ 350 FrntSideRdrLeObj2RdrObjVy 0;
BA_ "GenSigStartValue" SG_ 350 FrntSideRdrLeObj2RdrObjVy 6400;
BA_ "GenSigSendType" SG_ 350 FrntSideRdrLeObj2RdrObjVyStdDe 0;
BA_ "GenSigSendType" SG_ 350 FrntSideRdrLeObj2RelVx 0;
BA_ "GenSigStartValue" SG_ 350 FrntSideRdrLeObj2RelVx 1780;
BA_ "GenSigSendType" SG_ 350 FrntSideRdrLeObj2RelVy 0;
BA_ "GenSigStartValue" SG_ 350 FrntSideRdrLeObj2RelVy 1780;
VAL_ 332 FrntSideRdrLeDetn85RdrDetnSts 0 "RdrDetnSts_Ukwn" 1 "RdrDetnSts_Movg" 2 "RdrDetnSts_Staty" 3 "RdrDetnSts_Invalid";
VAL_ 332 FrntSideRdrLeDetn86RdrDetnSts 0 "RdrDetnSts_Ukwn" 1 "RdrDetnSts_Movg" 2 "RdrDetnSts_Staty" 3 "RdrDetnSts_Invalid";
VAL_ 332 FrntSideRdrLeDetn87RdrDetnSts 0 "RdrDetnSts_Ukwn" 1 "RdrDetnSts_Movg" 2 "RdrDetnSts_Staty" 3 "RdrDetnSts_Invalid";
VAL_ 332 FrntSideRdrLeDetn88RdrDetnSts 0 "RdrDetnSts_Ukwn" 1 "RdrDetnSts_Movg" 2 "RdrDetnSts_Staty" 3 "RdrDetnSts_Invalid";
VAL_ 332 FrntSideRdrLeDetn89RdrDetnSts 0 "RdrDetnSts_Ukwn" 1 "RdrDetnSts_Movg" 2 "RdrDetnSts_Staty" 3 "RdrDetnSts_Invalid";
VAL_ 332 FrntSideRdrLeDetn90RdrDetnSts 0 "RdrDetnSts_Ukwn" 1 "RdrDetnSts_Movg" 2 "RdrDetnSts_Staty" 3 "RdrDetnSts_Invalid";
VAL_ 334 FrntSideRdrLeDetn91RdrDetnSts 0 "RdrDetnSts_Ukwn" 1 "RdrDetnSts_Movg" 2 "RdrDetnSts_Staty" 3 "RdrDetnSts_Invalid";
VAL_ 334 FrntSideRdrLeDetn92RdrDetnSts 0 "RdrDetnSts_Ukwn" 1 "RdrDetnSts_Movg" 2 "RdrDetnSts_Staty" 3 "RdrDetnSts_Invalid";
VAL_ 334 FrntSideRdrLeDetn93RdrDetnSts 0 "RdrDetnSts_Ukwn" 1 "RdrDetnSts_Movg" 2 "RdrDetnSts_Staty" 3 "RdrDetnSts_Invalid";
VAL_ 334 FrntSideRdrLeDetn94RdrDetnSts 0 "RdrDetnSts_Ukwn" 1 "RdrDetnSts_Movg" 2 "RdrDetnSts_Staty" 3 "RdrDetnSts_Invalid";
VAL_ 334 FrntSideRdrLeDetn95RdrDetnSts 0 "RdrDetnSts_Ukwn" 1 "RdrDetnSts_Movg" 2 "RdrDetnSts_Staty" 3 "RdrDetnSts_Invalid";
VAL_ 334 FrntSideRdrLeDetn96RdrDetnSts 0 "RdrDetnSts_Ukwn" 1 "RdrDetnSts_Movg" 2 "RdrDetnSts_Staty" 3 "RdrDetnSts_Invalid";
VAL_ 336 FrntSideRdrLeDetn100RdrDetnSts 0 "RdrDetnSts_Ukwn" 1 "RdrDetnSts_Movg" 2 "RdrDetnSts_Staty" 3 "RdrDetnSts_Invalid";
VAL_ 336 FrntSideRdrLeDetn101RdrDetnSts 0 "RdrDetnSts_Ukwn" 1 "RdrDetnSts_Movg" 2 "RdrDetnSts_Staty" 3 "RdrDetnSts_Invalid";
VAL_ 336 FrntSideRdrLeDetn102RdrDetnSts 0 "RdrDetnSts_Ukwn" 1 "RdrDetnSts_Movg" 2 "RdrDetnSts_Staty" 3 "RdrDetnSts_Invalid";
VAL_ 336 FrntSideRdrLeDetn97RdrDetnSts 0 "RdrDetnSts_Ukwn" 1 "RdrDetnSts_Movg" 2 "RdrDetnSts_Staty" 3 "RdrDetnSts_Invalid";
VAL_ 336 FrntSideRdrLeDetn98RdrDetnSts 0 "RdrDetnSts_Ukwn" 1 "RdrDetnSts_Movg" 2 "RdrDetnSts_Staty" 3 "RdrDetnSts_Invalid";
VAL_ 336 FrntSideRdrLeDetn99RdrDetnSts 0 "RdrDetnSts_Ukwn" 1 "RdrDetnSts_Movg" 2 "RdrDetnSts_Staty" 3 "RdrDetnSts_Invalid";
VAL_ 338 FrntSideRdrLeDetn103RdrDetnSts 0 "RdrDetnSts_Ukwn" 1 "RdrDetnSts_Movg" 2 "RdrDetnSts_Staty" 3 "RdrDetnSts_Invalid";
VAL_ 338 FrntSideRdrLeDetn104RdrDetnSts 0 "RdrDetnSts_Ukwn" 1 "RdrDetnSts_Movg" 2 "RdrDetnSts_Staty" 3 "RdrDetnSts_Invalid";
VAL_ 338 FrntSideRdrLeDetn105RdrDetnSts 0 "RdrDetnSts_Ukwn" 1 "RdrDetnSts_Movg" 2 "RdrDetnSts_Staty" 3 "RdrDetnSts_Invalid";
VAL_ 338 FrntSideRdrLeDetn106RdrDetnSts 0 "RdrDetnSts_Ukwn" 1 "RdrDetnSts_Movg" 2 "RdrDetnSts_Staty" 3 "RdrDetnSts_Invalid";
VAL_ 338 FrntSideRdrLeDetn107RdrDetnSts 0 "RdrDetnSts_Ukwn" 1 "RdrDetnSts_Movg" 2 "RdrDetnSts_Staty" 3 "RdrDetnSts_Invalid";
VAL_ 338 FrntSideRdrLeDetn108RdrDetnSts 0 "RdrDetnSts_Ukwn" 1 "RdrDetnSts_Movg" 2 "RdrDetnSts_Staty" 3 "RdrDetnSts_Invalid";
VAL_ 340 FrntSideRdrLeDetn109RdrDetnSts 0 "RdrDetnSts_Ukwn" 1 "RdrDetnSts_Movg" 2 "RdrDetnSts_Staty" 3 "RdrDetnSts_Invalid";
VAL_ 340 FrntSideRdrLeDetn110RdrDetnSts 0 "RdrDetnSts_Ukwn" 1 "RdrDetnSts_Movg" 2 "RdrDetnSts_Staty" 3 "RdrDetnSts_Invalid";
VAL_ 340 FrntSideRdrLeDetn111RdrDetnSts 0 "RdrDetnSts_Ukwn" 1 "RdrDetnSts_Movg" 2 "RdrDetnSts_Staty" 3 "RdrDetnSts_Invalid";
VAL_ 340 FrntSideRdrLeDetn112RdrDetnSts 0 "RdrDetnSts_Ukwn" 1 "RdrDetnSts_Movg" 2 "RdrDetnSts_Staty" 3 "RdrDetnSts_Invalid";
VAL_ 340 FrntSideRdrLeDetn113RdrDetnSts 0 "RdrDetnSts_Ukwn" 1 "RdrDetnSts_Movg" 2 "RdrDetnSts_Staty" 3 "RdrDetnSts_Invalid";
VAL_ 340 FrntSideRdrLeDetn114RdrDetnSts 0 "RdrDetnSts_Ukwn" 1 "RdrDetnSts_Movg" 2 "RdrDetnSts_Staty" 3 "RdrDetnSts_Invalid";
VAL_ 342 FrntSideRdrLeDetn115RdrDetnSts 0 "RdrDetnSts_Ukwn" 1 "RdrDetnSts_Movg" 2 "RdrDetnSts_Staty" 3 "RdrDetnSts_Invalid";
VAL_ 342 FrntSideRdrLeDetn116RdrDetnSts 0 "RdrDetnSts_Ukwn" 1 "RdrDetnSts_Movg" 2 "RdrDetnSts_Staty" 3 "RdrDetnSts_Invalid";
VAL_ 342 FrntSideRdrLeDetn117RdrDetnSts 0 "RdrDetnSts_Ukwn" 1 "RdrDetnSts_Movg" 2 "RdrDetnSts_Staty" 3 "RdrDetnSts_Invalid";
VAL_ 342 FrntSideRdrLeDetn118RdrDetnSts 0 "RdrDetnSts_Ukwn" 1 "RdrDetnSts_Movg" 2 "RdrDetnSts_Staty" 3 "RdrDetnSts_Invalid";
VAL_ 342 FrntSideRdrLeDetn119RdrDetnSts 0 "RdrDetnSts_Ukwn" 1 "RdrDetnSts_Movg" 2 "RdrDetnSts_Staty" 3 "RdrDetnSts_Invalid";
VAL_ 342 FrntSideRdrLeDetn120RdrDetnSts 0 "RdrDetnSts_Ukwn" 1 "RdrDetnSts_Movg" 2 "RdrDetnSts_Staty" 3 "RdrDetnSts_Invalid";
VAL_ 344 FrntSideRdrLeDetn121RdrDetnSts 0 "RdrDetnSts_Ukwn" 1 "RdrDetnSts_Movg" 2 "RdrDetnSts_Staty" 3 "RdrDetnSts_Invalid";
VAL_ 344 FrntSideRdrLeDetn122RdrDetnSts 0 "RdrDetnSts_Ukwn" 1 "RdrDetnSts_Movg" 2 "RdrDetnSts_Staty" 3 "RdrDetnSts_Invalid";
VAL_ 344 FrntSideRdrLeDetn123RdrDetnSts 0 "RdrDetnSts_Ukwn" 1 "RdrDetnSts_Movg" 2 "RdrDetnSts_Staty" 3 "RdrDetnSts_Invalid";
VAL_ 344 FrntSideRdrLeDetn124RdrDetnSts 0 "RdrDetnSts_Ukwn" 1 "RdrDetnSts_Movg" 2 "RdrDetnSts_Staty" 3 "RdrDetnSts_Invalid";
VAL_ 344 FrntSideRdrLeDetn125RdrDetnSts 0 "RdrDetnSts_Ukwn" 1 "RdrDetnSts_Movg" 2 "RdrDetnSts_Staty" 3 "RdrDetnSts_Invalid";
VAL_ 344 FrntSideRdrLeDetn126RdrDetnSts 0 "RdrDetnSts_Ukwn" 1 "RdrDetnSts_Movg" 2 "RdrDetnSts_Staty" 3 "RdrDetnSts_Invalid";
VAL_ 346 FrntSideRdrLeDetn127RdrDetnSts 0 "RdrDetnSts_Ukwn" 1 "RdrDetnSts_Movg" 2 "RdrDetnSts_Staty" 3 "RdrDetnSts_Invalid";
VAL_ 346 FrntSideRdrLeDetn128RdrDetnSts 0 "RdrDetnSts_Ukwn" 1 "RdrDetnSts_Movg" 2 "RdrDetnSts_Staty" 3 "RdrDetnSts_Invalid";
VAL_ 348 FrntSideRdrLeObj1RdrObjElevnSts 0 "RdrObjElevnSts_Unknown" 1 "RdrObjElevnSts_OverRidable" 2 "RdrObjElevnSts_Rlv" 3 "RdrObjElevnSts_UnderRidable";
VAL_ 348 FrntSideRdrLeObj1RdrObjIsInFreeSpace 0 "YesNo2_No" 1 "YesNo2_Yes";
VAL_ 348 FrntSideRdrLeObj1RdrObjMtnPat 0 "RdrObjMtnPat_Ukwn" 1 "RdrObjMtnPat_Staty" 2 "RdrObjMtnPat_StatyFromMovg" 3 "RdrObjMtnPat_Movg" 4 "RdrObjMtnPat_Receding" 5 "RdrObjMtnPat_Oncoming" 6 "RdrObjMtnPat_CrossingFromLe" 7 "RdrObjMtnPat_CrossingFromRi";
VAL_ 348 FrntSideRdrLeObj1RdrObjTrackSts 0 "RdrObjTrackSts_Invld" 1 "RdrObjTrackSts_Updated" 2 "RdrObjTrackSts_New" 3 "RdrObjTrackSts_Coasted";
VAL_ 348 FrntSideRdrLeObj1RdrObjTyp 0 "RdrObjTyp_Ukwn" 1 "RdrObjTyp_Car" 2 "RdrObjTyp_MotorCycle" 3 "RdrObjTyp_Truck" 4 "RdrObjTyp_Ped" 5 "RdrObjTyp_ObstdVert1" 6 "RdrObjTyp_ObstdVert2" 7 "RdrObjTyp_Anim" 8 "RdrObjTyp_ObjGen" 9 "RdrObjTyp_Bicycle" 10 "RdrObjTyp_VehofUkwnClass" 11 "RdrObjTyp_Reserved";
VAL_ 348 FrntSideRdrLeObj1RdrObjUsedTracker 0 "RdrObjUsedTracker_Stationary" 1 "RdrObjUsedTracker_MovingCVModel" 2 "RdrObjUsedTracker_MovingCTModel" 3 "RdrObjUsedTracker_Undefined";
VAL_ 350 FrntSideRdrLeObj2RdrObjElevnSts 0 "RdrObjElevnSts_Unknown" 1 "RdrObjElevnSts_OverRidable" 2 "RdrObjElevnSts_Rlv" 3 "RdrObjElevnSts_UnderRidable";
VAL_ 350 FrntSideRdrLeObj2RdrObjIsInFreeSpace 0 "YesNo2_No" 1 "YesNo2_Yes";
VAL_ 350 FrntSideRdrLeObj2RdrObjMtnPat 0 "RdrObjMtnPat_Ukwn" 1 "RdrObjMtnPat_Staty" 2 "RdrObjMtnPat_StatyFromMovg" 3 "RdrObjMtnPat_Movg" 4 "RdrObjMtnPat_Receding" 5 "RdrObjMtnPat_Oncoming" 6 "RdrObjMtnPat_CrossingFromLe" 7 "RdrObjMtnPat_CrossingFromRi";
VAL_ 350 FrntSideRdrLeObj2RdrObjTrackSts 0 "RdrObjTrackSts_Invld" 1 "RdrObjTrackSts_Updated" 2 "RdrObjTrackSts_New" 3 "RdrObjTrackSts_Coasted";
VAL_ 350 FrntSideRdrLeObj2RdrObjTyp 0 "RdrObjTyp_Ukwn" 1 "RdrObjTyp_Car" 2 "RdrObjTyp_MotorCycle" 3 "RdrObjTyp_Truck" 4 "RdrObjTyp_Ped" 5 "RdrObjTyp_ObstdVert1" 6 "RdrObjTyp_ObstdVert2" 7 "RdrObjTyp_Anim" 8 "RdrObjTyp_ObjGen" 9 "RdrObjTyp_Bicycle" 10 "RdrObjTyp_VehofUkwnClass" 11 "RdrObjTyp_Reserved";
VAL_ 350 FrntSideRdrLeObj2RdrObjUsedTracker 0 "RdrObjUsedTracker_Stationary" 1 "RdrObjUsedTracker_MovingCVModel" 2 "RdrObjUsedTracker_MovingCTModel" 3 "RdrObjUsedTracker_Undefined";
SIG_GROUP_ 336 FrntSideRdrLeDetn100 1 : FrntSideRdrLeDetn100RdrDetnAzi FrntSideRdrLeDetn100RdrDetnChks FrntSideRdrLeDetn100RdrDetnCntr FrntSideRdrLeDetn100RdrDetnConf FrntSideRdrLeDetn100RdrDetnElevn FrntSideRdrLeDetn100RdrDetnPwr FrntSideRdrLeDetn100RdrDetnRng FrntSideRdrLeDetn100RdrDetnRngV FrntSideRdrLeDetn100RdrDetnSts;
SIG_GROUP_ 336 FrntSideRdrLeDetn101 1 : FrntSideRdrLeDetn101RdrDetnAzi FrntSideRdrLeDetn101RdrDetnChks FrntSideRdrLeDetn101RdrDetnCntr FrntSideRdrLeDetn101RdrDetnConf FrntSideRdrLeDetn101RdrDetnElevn FrntSideRdrLeDetn101RdrDetnPwr FrntSideRdrLeDetn101RdrDetnRng FrntSideRdrLeDetn101RdrDetnRngV FrntSideRdrLeDetn101RdrDetnSts;
SIG_GROUP_ 336 FrntSideRdrLeDetn102 1 : FrntSideRdrLeDetn102RdrDetnAzi FrntSideRdrLeDetn102RdrDetnChks FrntSideRdrLeDetn102RdrDetnCntr FrntSideRdrLeDetn102RdrDetnConf FrntSideRdrLeDetn102RdrDetnElevn FrntSideRdrLeDetn102RdrDetnPwr FrntSideRdrLeDetn102RdrDetnRng FrntSideRdrLeDetn102RdrDetnRngV FrntSideRdrLeDetn102RdrDetnSts;
SIG_GROUP_ 338 FrntSideRdrLeDetn103 1 : FrntSideRdrLeDetn103RdrDetnAzi FrntSideRdrLeDetn103RdrDetnChks FrntSideRdrLeDetn103RdrDetnCntr FrntSideRdrLeDetn103RdrDetnConf FrntSideRdrLeDetn103RdrDetnElevn FrntSideRdrLeDetn103RdrDetnPwr FrntSideRdrLeDetn103RdrDetnRng FrntSideRdrLeDetn103RdrDetnRngV FrntSideRdrLeDetn103RdrDetnSts;
SIG_GROUP_ 338 FrntSideRdrLeDetn104 1 : FrntSideRdrLeDetn104RdrDetnAzi FrntSideRdrLeDetn104RdrDetnChks FrntSideRdrLeDetn104RdrDetnCntr FrntSideRdrLeDetn104RdrDetnConf FrntSideRdrLeDetn104RdrDetnElevn FrntSideRdrLeDetn104RdrDetnPwr FrntSideRdrLeDetn104RdrDetnRng FrntSideRdrLeDetn104RdrDetnRngV FrntSideRdrLeDetn104RdrDetnSts;
SIG_GROUP_ 338 FrntSideRdrLeDetn105 1 : FrntSideRdrLeDetn105RdrDetnAzi FrntSideRdrLeDetn105RdrDetnChks FrntSideRdrLeDetn105RdrDetnCntr FrntSideRdrLeDetn105RdrDetnConf FrntSideRdrLeDetn105RdrDetnElevn FrntSideRdrLeDetn105RdrDetnPwr FrntSideRdrLeDetn105RdrDetnRng FrntSideRdrLeDetn105RdrDetnRngV FrntSideRdrLeDetn105RdrDetnSts;
SIG_GROUP_ 338 FrntSideRdrLeDetn106 1 : FrntSideRdrLeDetn106RdrDetnAzi FrntSideRdrLeDetn106RdrDetnChks FrntSideRdrLeDetn106RdrDetnCntr FrntSideRdrLeDetn106RdrDetnConf FrntSideRdrLeDetn106RdrDetnElevn FrntSideRdrLeDetn106RdrDetnPwr FrntSideRdrLeDetn106RdrDetnRng FrntSideRdrLeDetn106RdrDetnRngV FrntSideRdrLeDetn106RdrDetnSts;
SIG_GROUP_ 338 FrntSideRdrLeDetn107 1 : FrntSideRdrLeDetn107RdrDetnAzi FrntSideRdrLeDetn107RdrDetnChks FrntSideRdrLeDetn107RdrDetnCntr FrntSideRdrLeDetn107RdrDetnConf FrntSideRdrLeDetn107RdrDetnElevn FrntSideRdrLeDetn107RdrDetnPwr FrntSideRdrLeDetn107RdrDetnRng FrntSideRdrLeDetn107RdrDetnRngV FrntSideRdrLeDetn107RdrDetnSts;
SIG_GROUP_ 338 FrntSideRdrLeDetn108 1 : FrntSideRdrLeDetn108RdrDetnAzi FrntSideRdrLeDetn108RdrDetnChks FrntSideRdrLeDetn108RdrDetnCntr FrntSideRdrLeDetn108RdrDetnConf FrntSideRdrLeDetn108RdrDetnElevn FrntSideRdrLeDetn108RdrDetnPwr FrntSideRdrLeDetn108RdrDetnRng FrntSideRdrLeDetn108RdrDetnRngV FrntSideRdrLeDetn108RdrDetnSts;
SIG_GROUP_ 340 FrntSideRdrLeDetn109 1 : FrntSideRdrLeDetn109RdrDetnAzi FrntSideRdrLeDetn109RdrDetnChks FrntSideRdrLeDetn109RdrDetnCntr FrntSideRdrLeDetn109RdrDetnConf FrntSideRdrLeDetn109RdrDetnElevn FrntSideRdrLeDetn109RdrDetnPwr FrntSideRdrLeDetn109RdrDetnRng FrntSideRdrLeDetn109RdrDetnRngV FrntSideRdrLeDetn109RdrDetnSts;
SIG_GROUP_ 340 FrntSideRdrLeDetn110 1 : FrntSideRdrLeDetn110RdrDetnAzi FrntSideRdrLeDetn110RdrDetnChks FrntSideRdrLeDetn110RdrDetnCntr FrntSideRdrLeDetn110RdrDetnConf FrntSideRdrLeDetn110RdrDetnElevn FrntSideRdrLeDetn110RdrDetnPwr FrntSideRdrLeDetn110RdrDetnRng FrntSideRdrLeDetn110RdrDetnRngV FrntSideRdrLeDetn110RdrDetnSts;
SIG_GROUP_ 340 FrntSideRdrLeDetn111 1 : FrntSideRdrLeDetn111RdrDetnAzi FrntSideRdrLeDetn111RdrDetnChks FrntSideRdrLeDetn111RdrDetnCntr FrntSideRdrLeDetn111RdrDetnConf FrntSideRdrLeDetn111RdrDetnElevn FrntSideRdrLeDetn111RdrDetnPwr FrntSideRdrLeDetn111RdrDetnRng FrntSideRdrLeDetn111RdrDetnRngV FrntSideRdrLeDetn111RdrDetnSts;
SIG_GROUP_ 340 FrntSideRdrLeDetn112 1 : FrntSideRdrLeDetn112RdrDetnAzi FrntSideRdrLeDetn112RdrDetnChks FrntSideRdrLeDetn112RdrDetnCntr FrntSideRdrLeDetn112RdrDetnConf FrntSideRdrLeDetn112RdrDetnElevn FrntSideRdrLeDetn112RdrDetnPwr FrntSideRdrLeDetn112RdrDetnRng FrntSideRdrLeDetn112RdrDetnRngV FrntSideRdrLeDetn112RdrDetnSts;
SIG_GROUP_ 340 FrntSideRdrLeDetn113 1 : FrntSideRdrLeDetn113RdrDetnAzi FrntSideRdrLeDetn113RdrDetnChks FrntSideRdrLeDetn113RdrDetnCntr FrntSideRdrLeDetn113RdrDetnConf FrntSideRdrLeDetn113RdrDetnElevn FrntSideRdrLeDetn113RdrDetnPwr FrntSideRdrLeDetn113RdrDetnRng FrntSideRdrLeDetn113RdrDetnRngV FrntSideRdrLeDetn113RdrDetnSts;
SIG_GROUP_ 340 FrntSideRdrLeDetn114 1 : FrntSideRdrLeDetn114RdrDetnAzi FrntSideRdrLeDetn114RdrDetnChks FrntSideRdrLeDetn114RdrDetnCntr FrntSideRdrLeDetn114RdrDetnConf FrntSideRdrLeDetn114RdrDetnElevn FrntSideRdrLeDetn114RdrDetnPwr FrntSideRdrLeDetn114RdrDetnRng FrntSideRdrLeDetn114RdrDetnRngV FrntSideRdrLeDetn114RdrDetnSts;
SIG_GROUP_ 342 FrntSideRdrLeDetn115 1 : FrntSideRdrLeDetn115RdrDetnAzi FrntSideRdrLeDetn115RdrDetnChks FrntSideRdrLeDetn115RdrDetnCntr FrntSideRdrLeDetn115RdrDetnConf FrntSideRdrLeDetn115RdrDetnElevn FrntSideRdrLeDetn115RdrDetnPwr FrntSideRdrLeDetn115RdrDetnRng FrntSideRdrLeDetn115RdrDetnRngV FrntSideRdrLeDetn115RdrDetnSts;
SIG_GROUP_ 342 FrntSideRdrLeDetn116 1 : FrntSideRdrLeDetn116RdrDetnAzi FrntSideRdrLeDetn116RdrDetnChks FrntSideRdrLeDetn116RdrDetnCntr FrntSideRdrLeDetn116RdrDetnConf FrntSideRdrLeDetn116RdrDetnElevn FrntSideRdrLeDetn116RdrDetnPwr FrntSideRdrLeDetn116RdrDetnRng FrntSideRdrLeDetn116RdrDetnRngV FrntSideRdrLeDetn116RdrDetnSts;
SIG_GROUP_ 342 FrntSideRdrLeDetn117 1 : FrntSideRdrLeDetn117RdrDetnAzi FrntSideRdrLeDetn117RdrDetnChks FrntSideRdrLeDetn117RdrDetnCntr FrntSideRdrLeDetn117RdrDetnConf FrntSideRdrLeDetn117RdrDetnElevn FrntSideRdrLeDetn117RdrDetnPwr FrntSideRdrLeDetn117RdrDetnRng FrntSideRdrLeDetn117RdrDetnRngV FrntSideRdrLeDetn117RdrDetnSts;
SIG_GROUP_ 342 FrntSideRdrLeDetn118 1 : FrntSideRdrLeDetn118RdrDetnAzi FrntSideRdrLeDetn118RdrDetnChks FrntSideRdrLeDetn118RdrDetnCntr FrntSideRdrLeDetn118RdrDetnConf FrntSideRdrLeDetn118RdrDetnElevn FrntSideRdrLeDetn118RdrDetnPwr FrntSideRdrLeDetn118RdrDetnRng FrntSideRdrLeDetn118RdrDetnRngV FrntSideRdrLeDetn118RdrDetnSts;
SIG_GROUP_ 342 FrntSideRdrLeDetn119 1 : FrntSideRdrLeDetn119RdrDetnAzi FrntSideRdrLeDetn119RdrDetnChks FrntSideRdrLeDetn119RdrDetnCntr FrntSideRdrLeDetn119RdrDetnConf FrntSideRdrLeDetn119RdrDetnElevn FrntSideRdrLeDetn119RdrDetnPwr FrntSideRdrLeDetn119RdrDetnRng FrntSideRdrLeDetn119RdrDetnRngV FrntSideRdrLeDetn119RdrDetnSts;
SIG_GROUP_ 342 FrntSideRdrLeDetn120 1 : FrntSideRdrLeDetn120RdrDetnAzi FrntSideRdrLeDetn120RdrDetnChks FrntSideRdrLeDetn120RdrDetnCntr FrntSideRdrLeDetn120RdrDetnConf FrntSideRdrLeDetn120RdrDetnElevn FrntSideRdrLeDetn120RdrDetnPwr FrntSideRdrLeDetn120RdrDetnRng FrntSideRdrLeDetn120RdrDetnRngV FrntSideRdrLeDetn120RdrDetnSts;
SIG_GROUP_ 344 FrntSideRdrLeDetn121 1 : FrntSideRdrLeDetn121RdrDetnAzi FrntSideRdrLeDetn121RdrDetnChks FrntSideRdrLeDetn121RdrDetnCntr FrntSideRdrLeDetn121RdrDetnConf FrntSideRdrLeDetn121RdrDetnElevn FrntSideRdrLeDetn121RdrDetnPwr FrntSideRdrLeDetn121RdrDetnRng FrntSideRdrLeDetn121RdrDetnRngV FrntSideRdrLeDetn121RdrDetnSts;
SIG_GROUP_ 344 FrntSideRdrLeDetn122 1 : FrntSideRdrLeDetn122RdrDetnAzi FrntSideRdrLeDetn122RdrDetnChks FrntSideRdrLeDetn122RdrDetnCntr FrntSideRdrLeDetn122RdrDetnConf FrntSideRdrLeDetn122RdrDetnElevn FrntSideRdrLeDetn122RdrDetnPwr FrntSideRdrLeDetn122RdrDetnRng FrntSideRdrLeDetn122RdrDetnRngV FrntSideRdrLeDetn122RdrDetnSts;
SIG_GROUP_ 344 FrntSideRdrLeDetn123 1 : FrntSideRdrLeDetn123RdrDetnAzi FrntSideRdrLeDetn123RdrDetnChks FrntSideRdrLeDetn123RdrDetnCntr FrntSideRdrLeDetn123RdrDetnConf FrntSideRdrLeDetn123RdrDetnElevn FrntSideRdrLeDetn123RdrDetnPwr FrntSideRdrLeDetn123RdrDetnRng FrntSideRdrLeDetn123RdrDetnRngV FrntSideRdrLeDetn123RdrDetnSts;
SIG_GROUP_ 344 FrntSideRdrLeDetn124 1 : FrntSideRdrLeDetn124RdrDetnAzi FrntSideRdrLeDetn124RdrDetnChks FrntSideRdrLeDetn124RdrDetnCntr FrntSideRdrLeDetn124RdrDetnConf FrntSideRdrLeDetn124RdrDetnElevn FrntSideRdrLeDetn124RdrDetnPwr FrntSideRdrLeDetn124RdrDetnRng FrntSideRdrLeDetn124RdrDetnRngV FrntSideRdrLeDetn124RdrDetnSts;
SIG_GROUP_ 344 FrntSideRdrLeDetn125 1 : FrntSideRdrLeDetn125RdrDetnAzi FrntSideRdrLeDetn125RdrDetnChks FrntSideRdrLeDetn125RdrDetnCntr FrntSideRdrLeDetn125RdrDetnConf FrntSideRdrLeDetn125RdrDetnElevn FrntSideRdrLeDetn125RdrDetnPwr FrntSideRdrLeDetn125RdrDetnRng FrntSideRdrLeDetn125RdrDetnRngV FrntSideRdrLeDetn125RdrDetnSts;
SIG_GROUP_ 344 FrntSideRdrLeDetn126 1 : FrntSideRdrLeDetn126RdrDetnAzi FrntSideRdrLeDetn126RdrDetnChks FrntSideRdrLeDetn126RdrDetnCntr FrntSideRdrLeDetn126RdrDetnConf FrntSideRdrLeDetn126RdrDetnElevn FrntSideRdrLeDetn126RdrDetnPwr FrntSideRdrLeDetn126RdrDetnRng FrntSideRdrLeDetn126RdrDetnRngV FrntSideRdrLeDetn126RdrDetnSts;
SIG_GROUP_ 346 FrntSideRdrLeDetn127 1 : FrntSideRdrLeDetn127RdrDetnAzi FrntSideRdrLeDetn127RdrDetnChks FrntSideRdrLeDetn127RdrDetnCntr FrntSideRdrLeDetn127RdrDetnConf FrntSideRdrLeDetn127RdrDetnElevn FrntSideRdrLeDetn127RdrDetnPwr FrntSideRdrLeDetn127RdrDetnRng FrntSideRdrLeDetn127RdrDetnRngV FrntSideRdrLeDetn127RdrDetnSts;
SIG_GROUP_ 346 FrntSideRdrLeDetn128 1 : FrntSideRdrLeDetn128RdrDetnAzi FrntSideRdrLeDetn128RdrDetnChks FrntSideRdrLeDetn128RdrDetnCntr FrntSideRdrLeDetn128RdrDetnConf FrntSideRdrLeDetn128RdrDetnElevn FrntSideRdrLeDetn128RdrDetnPwr FrntSideRdrLeDetn128RdrDetnRng FrntSideRdrLeDetn128RdrDetnRngV FrntSideRdrLeDetn128RdrDetnSts;
SIG_GROUP_ 332 FrntSideRdrLeDetn85 1 : FrntSideRdrLeDetn85RdrDetnAzi FrntSideRdrLeDetn85RdrDetnChks FrntSideRdrLeDetn85RdrDetnCntr FrntSideRdrLeDetn85RdrDetnConf FrntSideRdrLeDetn85RdrDetnElevn FrntSideRdrLeDetn85RdrDetnPwr FrntSideRdrLeDetn85RdrDetnRng FrntSideRdrLeDetn85RdrDetnRngV FrntSideRdrLeDetn85RdrDetnSts;
SIG_GROUP_ 332 FrntSideRdrLeDetn86 1 : FrntSideRdrLeDetn86RdrDetnAzi FrntSideRdrLeDetn86RdrDetnChks FrntSideRdrLeDetn86RdrDetnCntr FrntSideRdrLeDetn86RdrDetnConf FrntSideRdrLeDetn86RdrDetnElevn FrntSideRdrLeDetn86RdrDetnPwr FrntSideRdrLeDetn86RdrDetnRng FrntSideRdrLeDetn86RdrDetnRngV FrntSideRdrLeDetn86RdrDetnSts;
SIG_GROUP_ 332 FrntSideRdrLeDetn87 1 : FrntSideRdrLeDetn87RdrDetnAzi FrntSideRdrLeDetn87RdrDetnChks FrntSideRdrLeDetn87RdrDetnCntr FrntSideRdrLeDetn87RdrDetnConf FrntSideRdrLeDetn87RdrDetnElevn FrntSideRdrLeDetn87RdrDetnPwr FrntSideRdrLeDetn87RdrDetnRng FrntSideRdrLeDetn87RdrDetnRngV FrntSideRdrLeDetn87RdrDetnSts;
SIG_GROUP_ 332 FrntSideRdrLeDetn88 1 : FrntSideRdrLeDetn88RdrDetnAzi FrntSideRdrLeDetn88RdrDetnChks FrntSideRdrLeDetn88RdrDetnCntr FrntSideRdrLeDetn88RdrDetnConf FrntSideRdrLeDetn88RdrDetnElevn FrntSideRdrLeDetn88RdrDetnPwr FrntSideRdrLeDetn88RdrDetnRng FrntSideRdrLeDetn88RdrDetnRngV FrntSideRdrLeDetn88RdrDetnSts;
SIG_GROUP_ 332 FrntSideRdrLeDetn89 1 : FrntSideRdrLeDetn89RdrDetnAzi FrntSideRdrLeDetn89RdrDetnChks FrntSideRdrLeDetn89RdrDetnCntr FrntSideRdrLeDetn89RdrDetnConf FrntSideRdrLeDetn89RdrDetnElevn FrntSideRdrLeDetn89RdrDetnPwr FrntSideRdrLeDetn89RdrDetnRng FrntSideRdrLeDetn89RdrDetnRngV FrntSideRdrLeDetn89RdrDetnSts;
SIG_GROUP_ 332 FrntSideRdrLeDetn90 1 : FrntSideRdrLeDetn90RdrDetnAzi FrntSideRdrLeDetn90RdrDetnChks FrntSideRdrLeDetn90RdrDetnCntr FrntSideRdrLeDetn90RdrDetnConf FrntSideRdrLeDetn90RdrDetnElevn FrntSideRdrLeDetn90RdrDetnPwr FrntSideRdrLeDetn90RdrDetnRng FrntSideRdrLeDetn90RdrDetnRngV FrntSideRdrLeDetn90RdrDetnSts;
SIG_GROUP_ 334 FrntSideRdrLeDetn91 1 : FrntSideRdrLeDetn91RdrDetnAzi FrntSideRdrLeDetn91RdrDetnChks FrntSideRdrLeDetn91RdrDetnCntr FrntSideRdrLeDetn91RdrDetnConf FrntSideRdrLeDetn91RdrDetnElevn FrntSideRdrLeDetn91RdrDetnPwr FrntSideRdrLeDetn91RdrDetnRng FrntSideRdrLeDetn91RdrDetnRngV FrntSideRdrLeDetn91RdrDetnSts;
SIG_GROUP_ 334 FrntSideRdrLeDetn92 1 : FrntSideRdrLeDetn92RdrDetnAzi FrntSideRdrLeDetn92RdrDetnChks FrntSideRdrLeDetn92RdrDetnCntr FrntSideRdrLeDetn92RdrDetnConf FrntSideRdrLeDetn92RdrDetnElevn FrntSideRdrLeDetn92RdrDetnPwr FrntSideRdrLeDetn92RdrDetnRng FrntSideRdrLeDetn92RdrDetnRngV FrntSideRdrLeDetn92RdrDetnSts;
SIG_GROUP_ 334 FrntSideRdrLeDetn93 1 : FrntSideRdrLeDetn93RdrDetnAzi FrntSideRdrLeDetn93RdrDetnChks FrntSideRdrLeDetn93RdrDetnCntr FrntSideRdrLeDetn93RdrDetnConf FrntSideRdrLeDetn93RdrDetnElevn FrntSideRdrLeDetn93RdrDetnPwr FrntSideRdrLeDetn93RdrDetnRng FrntSideRdrLeDetn93RdrDetnRngV FrntSideRdrLeDetn93RdrDetnSts;
SIG_GROUP_ 334 FrntSideRdrLeDetn94 1 : FrntSideRdrLeDetn94RdrDetnAzi FrntSideRdrLeDetn94RdrDetnChks FrntSideRdrLeDetn94RdrDetnCntr FrntSideRdrLeDetn94RdrDetnConf FrntSideRdrLeDetn94RdrDetnElevn FrntSideRdrLeDetn94RdrDetnPwr FrntSideRdrLeDetn94RdrDetnRng FrntSideRdrLeDetn94RdrDetnRngV FrntSideRdrLeDetn94RdrDetnSts;
SIG_GROUP_ 334 FrntSideRdrLeDetn95 1 : FrntSideRdrLeDetn95RdrDetnAzi FrntSideRdrLeDetn95RdrDetnChks FrntSideRdrLeDetn95RdrDetnCntr FrntSideRdrLeDetn95RdrDetnConf FrntSideRdrLeDetn95RdrDetnElevn FrntSideRdrLeDetn95RdrDetnPwr FrntSideRdrLeDetn95RdrDetnRng FrntSideRdrLeDetn95RdrDetnRngV FrntSideRdrLeDetn95RdrDetnSts;
SIG_GROUP_ 334 FrntSideRdrLeDetn96 1 : FrntSideRdrLeDetn96RdrDetnAzi FrntSideRdrLeDetn96RdrDetnChks FrntSideRdrLeDetn96RdrDetnCntr FrntSideRdrLeDetn96RdrDetnConf FrntSideRdrLeDetn96RdrDetnElevn FrntSideRdrLeDetn96RdrDetnPwr FrntSideRdrLeDetn96RdrDetnRng FrntSideRdrLeDetn96RdrDetnRngV FrntSideRdrLeDetn96RdrDetnSts;
SIG_GROUP_ 336 FrntSideRdrLeDetn97 1 : FrntSideRdrLeDetn97RdrDetnAzi FrntSideRdrLeDetn97RdrDetnChks FrntSideRdrLeDetn97RdrDetnCntr FrntSideRdrLeDetn97RdrDetnConf FrntSideRdrLeDetn97RdrDetnElevn FrntSideRdrLeDetn97RdrDetnPwr FrntSideRdrLeDetn97RdrDetnRng FrntSideRdrLeDetn97RdrDetnRngV FrntSideRdrLeDetn97RdrDetnSts;
SIG_GROUP_ 336 FrntSideRdrLeDetn98 1 : FrntSideRdrLeDetn98RdrDetnAzi FrntSideRdrLeDetn98RdrDetnChks FrntSideRdrLeDetn98RdrDetnCntr FrntSideRdrLeDetn98RdrDetnConf FrntSideRdrLeDetn98RdrDetnElevn FrntSideRdrLeDetn98RdrDetnPwr FrntSideRdrLeDetn98RdrDetnRng FrntSideRdrLeDetn98RdrDetnRngV FrntSideRdrLeDetn98RdrDetnSts;
SIG_GROUP_ 336 FrntSideRdrLeDetn99 1 : FrntSideRdrLeDetn99RdrDetnAzi FrntSideRdrLeDetn99RdrDetnChks FrntSideRdrLeDetn99RdrDetnCntr FrntSideRdrLeDetn99RdrDetnConf FrntSideRdrLeDetn99RdrDetnElevn FrntSideRdrLeDetn99RdrDetnPwr FrntSideRdrLeDetn99RdrDetnRng FrntSideRdrLeDetn99RdrDetnRngV FrntSideRdrLeDetn99RdrDetnSts;
SIG_GROUP_ 348 FrntSideRdrLeObj1 1 : FrntSideRdrLeObj1Heading FrntSideRdrLeObj1ObjBoxCenterLat FrntSideRdrLeObj1ObjBoxCenterLgt FrntSideRdrLeObj1ObservationHist FrntSideRdrLeObj1QualityBits FrntSideRdrLeObj1RdrObjAx FrntSideRdrLeObj1RdrObjAy FrntSideRdrLeObj1RdrObjBoxLength FrntSideRdrLeObj1RdrObjBoxWidth FrntSideRdrLeObj1RdrObjChks FrntSideRdrLeObj1RdrObjCntr FrntSideRdrLeObj1RdrObjCoastCnt FrntSideRdrLeObj1RdrObjConf FrntSideRdrLeObj1RdrObjDx FrntSideRdrLeObj1RdrObjDxStdDe FrntSideRdrLeObj1RdrObjDy FrntSideRdrLeObj1RdrObjDyStdDe FrntSideRdrLeObj1RdrObjElevnConf FrntSideRdrLeObj1RdrObjElevnSts FrntSideRdrLeObj1RdrObjID FrntSideRdrLeObj1RdrObjIsInFreeSpace FrntSideRdrLeObj1RdrObjMirrProblty FrntSideRdrLeObj1RdrObjMtnPat FrntSideRdrLeObj1RdrObjNotRealProblty FrntSideRdrLeObj1RdrObjStatyCnt FrntSideRdrLeObj1RdrObjTiAlv FrntSideRdrLeObj1RdrObjTrackSts FrntSideRdrLeObj1RdrObjTyp FrntSideRdrLeObj1RdrObjTypConfBike FrntSideRdrLeObj1RdrObjTypConfPed FrntSideRdrLeObj1RdrObjTypConfVeh FrntSideRdrLeObj1RdrObjUsedTracker FrntSideRdrLeObj1RdrObjVx FrntSideRdrLeObj1RdrObjVxStdDe FrntSideRdrLeObj1RdrObjVy FrntSideRdrLeObj1RdrObjVyStdDe FrntSideRdrLeObj1RelVx FrntSideRdrLeObj1RelVy;
SIG_GROUP_ 350 FrntSideRdrLeObj2 1 : FrntSideRdrLeObj2Heading FrntSideRdrLeObj2ObjBoxCenterLat FrntSideRdrLeObj2ObjBoxCenterLgt FrntSideRdrLeObj2ObservationHist FrntSideRdrLeObj2QualityBits FrntSideRdrLeObj2RdrObjAx FrntSideRdrLeObj2RdrObjAy FrntSideRdrLeObj2RdrObjBoxLength FrntSideRdrLeObj2RdrObjBoxWidth FrntSideRdrLeObj2RdrObjChks FrntSideRdrLeObj2RdrObjCntr FrntSideRdrLeObj2RdrObjCoastCnt FrntSideRdrLeObj2RdrObjConf FrntSideRdrLeObj2RdrObjDx FrntSideRdrLeObj2RdrObjDxStdDe FrntSideRdrLeObj2RdrObjDy FrntSideRdrLeObj2RdrObjDyStdDe FrntSideRdrLeObj2RdrObjElevnConf FrntSideRdrLeObj2RdrObjElevnSts FrntSideRdrLeObj2RdrObjID FrntSideRdrLeObj2RdrObjIsInFreeSpace FrntSideRdrLeObj2RdrObjMirrProblty FrntSideRdrLeObj2RdrObjMtnPat FrntSideRdrLeObj2RdrObjNotRealProblty FrntSideRdrLeObj2RdrObjStatyCnt FrntSideRdrLeObj2RdrObjTiAlv FrntSideRdrLeObj2RdrObjTrackSts FrntSideRdrLeObj2RdrObjTyp FrntSideRdrLeObj2RdrObjTypConfBike FrntSideRdrLeObj2RdrObjTypConfPed FrntSideRdrLeObj2RdrObjTypConfVeh FrntSideRdrLeObj2RdrObjUsedTracker FrntSideRdrLeObj2RdrObjVx FrntSideRdrLeObj2RdrObjVxStdDe FrntSideRdrLeObj2RdrObjVy FrntSideRdrLeObj2RdrObjVyStdDe FrntSideRdrLeObj2RelVx FrntSideRdrLeObj2RelVy;

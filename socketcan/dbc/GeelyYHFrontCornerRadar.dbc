// *************************************************************************** *
// *                                                                           *
// * Description:         CANDB File                                           *
// * Generated at:        2023-03-04 22:47                                     *
// * System:              SDB23100                                             *
// * Variant:             DX11_VDDM_CDD3_ADCU3                                 *
// * Network:             SafetyCANFD1                                         *
// *                                                                           *
// *************************************************************************** *
VERSION "SafetyCANFD1"

NS_ :

BS_ :

BU_ :  ASDM ETC FSRL FSRR

BO_ 1585 FsrlToAsdmSafetyCanFD1DiagResFrame : 64 FSRL
 SG_ FsrlToAsdmSafetyCanFD1DiagResNpdu : 7|512@0+ (1,0) [0|0] "" ASDM

BO_ 1415 FsrltoEtcXcpFr01 : 8 FSRL

BO_ 1427 FsrltoEtcXcpFr02 : 8 FSRL

BO_ 302 FSRRSafetyCANFD1Frame00 : 64 FSRR
 SG_ FrntSideRdrRiSts_UB : 243|1@0+ (1,0) [0|1] "" ASDM
 SG_ FrntSideRdrRiStsForDim : 127|3@0+ (1,0) [0|7] "" ASDM
 SG_ FrntSideRdrRiStsForDim_UB : 116|1@0+ (1,0) [0|1] "" ASDM
 SG_ FrntSideRdrRiStsRdrNrDetn : 207|8@0+ (1.0,0.0) [0.0|255.0] "Unitless" ASDM
 SG_ FrntSideRdrRiStsRdrNrObj : 215|8@0+ (1.0,0.0) [0.0|255.0] "Unitless" ASDM
 SG_ FrntSideRdrRiStsRdrStsBlkd0bin : 216|1@0+ (1,0) [0|1] "" ASDM
 SG_ FrntSideRdrRiStsRdrStsBlkdConf : 223|7@0+ (1.0,0.0) [0.0|100.0] "%" ASDM
 SG_ FrntSideRdrRiStsRdrStsChks : 135|8@0+ (1.0,0.0) [0.0|255.0] "Unitless" ASDM
 SG_ FrntSideRdrRiStsRdrStsCntr : 143|4@0+ (1.0,0.0) [0.0|15.0] "Unitless" ASDM
 SG_ FrntSideRdrRiStsRdrStsDstbc : 239|7@0+ (1.0,0.0) [0.0|100.0] "%" ASDM
 SG_ FrntSideRdrRiStsRdrStsEna : 232|1@0+ (1,0) [0|1] "" ASDM
 SG_ FrntSideRdrRiStsRdrStsFaulty : 247|1@0+ (1,0) [0|1] "" ASDM
 SG_ FrntSideRdrRiStsRdrStsIfVersMajor : 139|4@0+ (1.0,0.0) [0.0|15.0] "Unitless" ASDM
 SG_ FrntSideRdrRiStsRdrStsIfVersMinor : 151|4@0+ (1.0,0.0) [0.0|15.0] "Unitless" ASDM
 SG_ FrntSideRdrRiStsRdrStsLatency : 191|16@0+ (1.0,0.0) [0.0|65535.0] "Unitless" ASDM
 SG_ FrntSideRdrRiStsRdrStsMisAlign : 147|3@0+ (1,0) [0|7] "" ASDM
 SG_ FrntSideRdrRiStsRdrStsMissCom : 144|1@0+ (1,0) [0|1] "" ASDM
 SG_ FrntSideRdrRiStsRdrStsSftyFlt : 246|2@0+ (1,0) [0|3] "" ASDM
 SG_ FrntSideRdrRiStsRdrStsTiStamp : 159|32@0+ (0.0001,0.0) [0.0|429496.7295] "s" ASDM
 SG_ FrntSideRdrRiStsRdrStsTiStampStsGlbTiBas : 244|1@0+ (1,0) [0|1] "" ASDM
 SG_ FrntSideRdrRiStsRdrStsTiStampStsSyncToGatewy : 224|1@0+ (1,0) [0|1] "" ASDM
 SG_ FrntSideRdrRiStsRdrStsTiStampStsTiLeap : 225|1@0+ (1,0) [0|1] "" ASDM
 SG_ FrntSideRdrRiStsRdrStsTiStampStsTiOut : 226|1@0+ (1,0) [0|1] "" ASDM
 SG_ FrntSideRdrRiStsRdrStsWhlSpdCmpFac : 231|5@0+ (0.005,0.92) [0.92|1.075] "Unitless" ASDM

BO_ 305 FSRRSafetyCANFD1Frame01 : 64 FSRR
 SG_ FrntSideRdrRiDetn1_UB : 74|1@0+ (1,0) [0|1] "" ASDM
 SG_ FrntSideRdrRiDetn1RdrDetnAzi : 31|11@0+ (0.1,-90.0) [-90.0|90.0] "Deg" ASDM
 SG_ FrntSideRdrRiDetn1RdrDetnChks : 7|8@0+ (1.0,0.0) [0.0|255.0] "Unitless" ASDM
 SG_ FrntSideRdrRiDetn1RdrDetnCntr : 15|4@0+ (1.0,0.0) [0.0|15.0] "Unitless" ASDM
 SG_ FrntSideRdrRiDetn1RdrDetnConf : 71|7@0+ (1.0,0.0) [0.0|100.0] "%" ASDM
 SG_ FrntSideRdrRiDetn1RdrDetnElevn : 79|5@0+ (1.0,-15.0) [-15.0|15.0] "Deg" ASDM
 SG_ FrntSideRdrRiDetn1RdrDetnPwr : 8|9@0+ (0.1,0.0) [0.0|51.1] "dB" ASDM
 SG_ FrntSideRdrRiDetn1RdrDetnRng : 55|14@0+ (0.02,-1.0) [-1.0|200.0] "m" ASDM
 SG_ FrntSideRdrRiDetn1RdrDetnRngV : 36|13@0+ (0.02,-80.0) [-80.0|80.0] "m/s" ASDM
 SG_ FrntSideRdrRiDetn1RdrDetnSts : 11|2@0+ (1,0) [0|3] "" ASDM
 SG_ FrntSideRdrRiDetn2_UB : 154|1@0+ (1,0) [0|1] "" ASDM
 SG_ FrntSideRdrRiDetn2RdrDetnAzi : 119|11@0+ (0.1,-90.0) [-90.0|90.0] "Deg" ASDM
 SG_ FrntSideRdrRiDetn2RdrDetnChks : 87|8@0+ (1.0,0.0) [0.0|255.0] "Unitless" ASDM
 SG_ FrntSideRdrRiDetn2RdrDetnCntr : 95|4@0+ (1.0,0.0) [0.0|15.0] "Unitless" ASDM
 SG_ FrntSideRdrRiDetn2RdrDetnConf : 111|7@0+ (1.0,0.0) [0.0|100.0] "%" ASDM
 SG_ FrntSideRdrRiDetn2RdrDetnElevn : 159|5@0+ (1.0,-15.0) [-15.0|15.0] "Deg" ASDM
 SG_ FrntSideRdrRiDetn2RdrDetnPwr : 89|9@0+ (0.1,0.0) [0.0|51.1] "dB" ASDM
 SG_ FrntSideRdrRiDetn2RdrDetnRng : 143|14@0+ (0.02,-1.0) [-1.0|200.0] "m" ASDM
 SG_ FrntSideRdrRiDetn2RdrDetnRngV : 124|13@0+ (0.02,-80.0) [-80.0|80.0] "m/s" ASDM
 SG_ FrntSideRdrRiDetn2RdrDetnSts : 91|2@0+ (1,0) [0|3] "" ASDM
 SG_ FrntSideRdrRiDetn3_UB : 234|1@0+ (1,0) [0|1] "" ASDM
 SG_ FrntSideRdrRiDetn3RdrDetnAzi : 199|11@0+ (0.1,-90.0) [-90.0|90.0] "Deg" ASDM
 SG_ FrntSideRdrRiDetn3RdrDetnChks : 167|8@0+ (1.0,0.0) [0.0|255.0] "Unitless" ASDM
 SG_ FrntSideRdrRiDetn3RdrDetnCntr : 175|4@0+ (1.0,0.0) [0.0|15.0] "Unitless" ASDM
 SG_ FrntSideRdrRiDetn3RdrDetnConf : 191|7@0+ (1.0,0.0) [0.0|100.0] "%" ASDM
 SG_ FrntSideRdrRiDetn3RdrDetnElevn : 239|5@0+ (1.0,-15.0) [-15.0|15.0] "Deg" ASDM
 SG_ FrntSideRdrRiDetn3RdrDetnPwr : 169|9@0+ (0.1,0.0) [0.0|51.1] "dB" ASDM
 SG_ FrntSideRdrRiDetn3RdrDetnRng : 223|14@0+ (0.02,-1.0) [-1.0|200.0] "m" ASDM
 SG_ FrntSideRdrRiDetn3RdrDetnRngV : 204|13@0+ (0.02,-80.0) [-80.0|80.0] "m/s" ASDM
 SG_ FrntSideRdrRiDetn3RdrDetnSts : 171|2@0+ (1,0) [0|3] "" ASDM
 SG_ FrntSideRdrRiDetn4_UB : 314|1@0+ (1,0) [0|1] "" ASDM
 SG_ FrntSideRdrRiDetn4RdrDetnAzi : 287|11@0+ (0.1,-90.0) [-90.0|90.0] "Deg" ASDM
 SG_ FrntSideRdrRiDetn4RdrDetnChks : 247|8@0+ (1.0,0.0) [0.0|255.0] "Unitless" ASDM
 SG_ FrntSideRdrRiDetn4RdrDetnCntr : 255|4@0+ (1.0,0.0) [0.0|15.0] "Unitless" ASDM
 SG_ FrntSideRdrRiDetn4RdrDetnConf : 311|7@0+ (1.0,0.0) [0.0|100.0] "%" ASDM
 SG_ FrntSideRdrRiDetn4RdrDetnElevn : 319|5@0+ (1.0,-15.0) [-15.0|15.0] "Deg" ASDM
 SG_ FrntSideRdrRiDetn4RdrDetnPwr : 249|9@0+ (0.1,0.0) [0.0|51.1] "dB" ASDM
 SG_ FrntSideRdrRiDetn4RdrDetnRng : 271|14@0+ (0.02,-1.0) [-1.0|200.0] "m" ASDM
 SG_ FrntSideRdrRiDetn4RdrDetnRngV : 292|13@0+ (0.02,-80.0) [-80.0|80.0] "m/s" ASDM
 SG_ FrntSideRdrRiDetn4RdrDetnSts : 251|2@0+ (1,0) [0|3] "" ASDM
 SG_ FrntSideRdrRiDetn5_UB : 394|1@0+ (1,0) [0|1] "" ASDM
 SG_ FrntSideRdrRiDetn5RdrDetnAzi : 351|11@0+ (0.1,-90.0) [-90.0|90.0] "Deg" ASDM
 SG_ FrntSideRdrRiDetn5RdrDetnChks : 327|8@0+ (1.0,0.0) [0.0|255.0] "Unitless" ASDM
 SG_ FrntSideRdrRiDetn5RdrDetnCntr : 335|4@0+ (1.0,0.0) [0.0|15.0] "Unitless" ASDM
 SG_ FrntSideRdrRiDetn5RdrDetnConf : 391|7@0+ (1.0,0.0) [0.0|100.0] "%" ASDM
 SG_ FrntSideRdrRiDetn5RdrDetnElevn : 399|5@0+ (1.0,-15.0) [-15.0|15.0] "Deg" ASDM
 SG_ FrntSideRdrRiDetn5RdrDetnPwr : 329|9@0+ (0.1,0.0) [0.0|51.1] "dB" ASDM
 SG_ FrntSideRdrRiDetn5RdrDetnRng : 375|14@0+ (0.02,-1.0) [-1.0|200.0] "m" ASDM
 SG_ FrntSideRdrRiDetn5RdrDetnRngV : 356|13@0+ (0.02,-80.0) [-80.0|80.0] "m/s" ASDM
 SG_ FrntSideRdrRiDetn5RdrDetnSts : 331|2@0+ (1,0) [0|3] "" ASDM
 SG_ FrntSideRdrRiDetn6_UB : 474|1@0+ (1,0) [0|1] "" ASDM
 SG_ FrntSideRdrRiDetn6RdrDetnAzi : 447|11@0+ (0.1,-90.0) [-90.0|90.0] "Deg" ASDM
 SG_ FrntSideRdrRiDetn6RdrDetnChks : 407|8@0+ (1.0,0.0) [0.0|255.0] "Unitless" ASDM
 SG_ FrntSideRdrRiDetn6RdrDetnCntr : 415|4@0+ (1.0,0.0) [0.0|15.0] "Unitless" ASDM
 SG_ FrntSideRdrRiDetn6RdrDetnConf : 471|7@0+ (1.0,0.0) [0.0|100.0] "%" ASDM
 SG_ FrntSideRdrRiDetn6RdrDetnElevn : 479|5@0+ (1.0,-15.0) [-15.0|15.0] "Deg" ASDM
 SG_ FrntSideRdrRiDetn6RdrDetnPwr : 409|9@0+ (0.1,0.0) [0.0|51.1] "dB" ASDM
 SG_ FrntSideRdrRiDetn6RdrDetnRng : 431|14@0+ (0.02,-1.0) [-1.0|200.0] "m" ASDM
 SG_ FrntSideRdrRiDetn6RdrDetnRngV : 452|13@0+ (0.02,-80.0) [-80.0|80.0] "m/s" ASDM
 SG_ FrntSideRdrRiDetn6RdrDetnSts : 411|2@0+ (1,0) [0|3] "" ASDM

BO_ 307 FSRRSafetyCANFD1Frame02 : 64 FSRR
 SG_ FrntSideRdrRiDetn10_UB : 314|1@0+ (1,0) [0|1] "" ASDM
 SG_ FrntSideRdrRiDetn10RdrDetnAzi : 287|11@0+ (0.1,-90.0) [-90.0|90.0] "Deg" ASDM
 SG_ FrntSideRdrRiDetn10RdrDetnChks : 247|8@0+ (1.0,0.0) [0.0|255.0] "Unitless" ASDM
 SG_ FrntSideRdrRiDetn10RdrDetnCntr : 255|4@0+ (1.0,0.0) [0.0|15.0] "Unitless" ASDM
 SG_ FrntSideRdrRiDetn10RdrDetnConf : 311|7@0+ (1.0,0.0) [0.0|100.0] "%" ASDM
 SG_ FrntSideRdrRiDetn10RdrDetnElevn : 319|5@0+ (1.0,-15.0) [-15.0|15.0] "Deg" ASDM
 SG_ FrntSideRdrRiDetn10RdrDetnPwr : 249|9@0+ (0.1,0.0) [0.0|51.1] "dB" ASDM
 SG_ FrntSideRdrRiDetn10RdrDetnRng : 271|14@0+ (0.02,-1.0) [-1.0|200.0] "m" ASDM
 SG_ FrntSideRdrRiDetn10RdrDetnRngV : 292|13@0+ (0.02,-80.0) [-80.0|80.0] "m/s" ASDM
 SG_ FrntSideRdrRiDetn10RdrDetnSts : 251|2@0+ (1,0) [0|3] "" ASDM
 SG_ FrntSideRdrRiDetn11_UB : 394|1@0+ (1,0) [0|1] "" ASDM
 SG_ FrntSideRdrRiDetn11RdrDetnAzi : 367|11@0+ (0.1,-90.0) [-90.0|90.0] "Deg" ASDM
 SG_ FrntSideRdrRiDetn11RdrDetnChks : 327|8@0+ (1.0,0.0) [0.0|255.0] "Unitless" ASDM
 SG_ FrntSideRdrRiDetn11RdrDetnCntr : 335|4@0+ (1.0,0.0) [0.0|15.0] "Unitless" ASDM
 SG_ FrntSideRdrRiDetn11RdrDetnConf : 391|7@0+ (1.0,0.0) [0.0|100.0] "%" ASDM
 SG_ FrntSideRdrRiDetn11RdrDetnElevn : 399|5@0+ (1.0,-15.0) [-15.0|15.0] "Deg" ASDM
 SG_ FrntSideRdrRiDetn11RdrDetnPwr : 329|9@0+ (0.1,0.0) [0.0|51.1] "dB" ASDM
 SG_ FrntSideRdrRiDetn11RdrDetnRng : 351|14@0+ (0.02,-1.0) [-1.0|200.0] "m" ASDM
 SG_ FrntSideRdrRiDetn11RdrDetnRngV : 372|13@0+ (0.02,-80.0) [-80.0|80.0] "m/s" ASDM
 SG_ FrntSideRdrRiDetn11RdrDetnSts : 331|2@0+ (1,0) [0|3] "" ASDM
 SG_ FrntSideRdrRiDetn12_UB : 474|1@0+ (1,0) [0|1] "" ASDM
 SG_ FrntSideRdrRiDetn12RdrDetnAzi : 447|11@0+ (0.1,-90.0) [-90.0|90.0] "Deg" ASDM
 SG_ FrntSideRdrRiDetn12RdrDetnChks : 407|8@0+ (1.0,0.0) [0.0|255.0] "Unitless" ASDM
 SG_ FrntSideRdrRiDetn12RdrDetnCntr : 415|4@0+ (1.0,0.0) [0.0|15.0] "Unitless" ASDM
 SG_ FrntSideRdrRiDetn12RdrDetnConf : 471|7@0+ (1.0,0.0) [0.0|100.0] "%" ASDM
 SG_ FrntSideRdrRiDetn12RdrDetnElevn : 479|5@0+ (1.0,-15.0) [-15.0|15.0] "Deg" ASDM
 SG_ FrntSideRdrRiDetn12RdrDetnPwr : 409|9@0+ (0.1,0.0) [0.0|51.1] "dB" ASDM
 SG_ FrntSideRdrRiDetn12RdrDetnRng : 431|14@0+ (0.02,-1.0) [-1.0|200.0] "m" ASDM
 SG_ FrntSideRdrRiDetn12RdrDetnRngV : 452|13@0+ (0.02,-80.0) [-80.0|80.0] "m/s" ASDM
 SG_ FrntSideRdrRiDetn12RdrDetnSts : 411|2@0+ (1,0) [0|3] "" ASDM
 SG_ FrntSideRdrRiDetn7_UB : 74|1@0+ (1,0) [0|1] "" ASDM
 SG_ FrntSideRdrRiDetn7RdrDetnAzi : 31|11@0+ (0.1,-90.0) [-90.0|90.0] "Deg" ASDM
 SG_ FrntSideRdrRiDetn7RdrDetnChks : 7|8@0+ (1.0,0.0) [0.0|255.0] "Unitless" ASDM
 SG_ FrntSideRdrRiDetn7RdrDetnCntr : 15|4@0+ (1.0,0.0) [0.0|15.0] "Unitless" ASDM
 SG_ FrntSideRdrRiDetn7RdrDetnConf : 71|7@0+ (1.0,0.0) [0.0|100.0] "%" ASDM
 SG_ FrntSideRdrRiDetn7RdrDetnElevn : 79|5@0+ (1.0,-15.0) [-15.0|15.0] "Deg" ASDM
 SG_ FrntSideRdrRiDetn7RdrDetnPwr : 8|9@0+ (0.1,0.0) [0.0|51.1] "dB" ASDM
 SG_ FrntSideRdrRiDetn7RdrDetnRng : 55|14@0+ (0.02,-1.0) [-1.0|200.0] "m" ASDM
 SG_ FrntSideRdrRiDetn7RdrDetnRngV : 36|13@0+ (0.02,-80.0) [-80.0|80.0] "m/s" ASDM
 SG_ FrntSideRdrRiDetn7RdrDetnSts : 11|2@0+ (1,0) [0|3] "" ASDM
 SG_ FrntSideRdrRiDetn8_UB : 154|1@0+ (1,0) [0|1] "" ASDM
 SG_ FrntSideRdrRiDetn8RdrDetnAzi : 119|11@0+ (0.1,-90.0) [-90.0|90.0] "Deg" ASDM
 SG_ FrntSideRdrRiDetn8RdrDetnChks : 87|8@0+ (1.0,0.0) [0.0|255.0] "Unitless" ASDM
 SG_ FrntSideRdrRiDetn8RdrDetnCntr : 95|4@0+ (1.0,0.0) [0.0|15.0] "Unitless" ASDM
 SG_ FrntSideRdrRiDetn8RdrDetnConf : 111|7@0+ (1.0,0.0) [0.0|100.0] "%" ASDM
 SG_ FrntSideRdrRiDetn8RdrDetnElevn : 159|5@0+ (1.0,-15.0) [-15.0|15.0] "Deg" ASDM
 SG_ FrntSideRdrRiDetn8RdrDetnPwr : 89|9@0+ (0.1,0.0) [0.0|51.1] "dB" ASDM
 SG_ FrntSideRdrRiDetn8RdrDetnRng : 143|14@0+ (0.02,-1.0) [-1.0|200.0] "m" ASDM
 SG_ FrntSideRdrRiDetn8RdrDetnRngV : 124|13@0+ (0.02,-80.0) [-80.0|80.0] "m/s" ASDM
 SG_ FrntSideRdrRiDetn8RdrDetnSts : 91|2@0+ (1,0) [0|3] "" ASDM
 SG_ FrntSideRdrRiDetn9_UB : 234|1@0+ (1,0) [0|1] "" ASDM
 SG_ FrntSideRdrRiDetn9RdrDetnAzi : 199|11@0+ (0.1,-90.0) [-90.0|90.0] "Deg" ASDM
 SG_ FrntSideRdrRiDetn9RdrDetnChks : 167|8@0+ (1.0,0.0) [0.0|255.0] "Unitless" ASDM
 SG_ FrntSideRdrRiDetn9RdrDetnCntr : 175|4@0+ (1.0,0.0) [0.0|15.0] "Unitless" ASDM
 SG_ FrntSideRdrRiDetn9RdrDetnConf : 191|7@0+ (1.0,0.0) [0.0|100.0] "%" ASDM
 SG_ FrntSideRdrRiDetn9RdrDetnElevn : 239|5@0+ (1.0,-15.0) [-15.0|15.0] "Deg" ASDM
 SG_ FrntSideRdrRiDetn9RdrDetnPwr : 169|9@0+ (0.1,0.0) [0.0|51.1] "dB" ASDM
 SG_ FrntSideRdrRiDetn9RdrDetnRng : 223|14@0+ (0.02,-1.0) [-1.0|200.0] "m" ASDM
 SG_ FrntSideRdrRiDetn9RdrDetnRngV : 204|13@0+ (0.02,-80.0) [-80.0|80.0] "m/s" ASDM
 SG_ FrntSideRdrRiDetn9RdrDetnSts : 171|2@0+ (1,0) [0|3] "" ASDM

BO_ 309 FSRRSafetyCANFD1Frame03 : 64 FSRR
 SG_ FrntSideRdrRiDetn13_UB : 74|1@0+ (1,0) [0|1] "" ASDM
 SG_ FrntSideRdrRiDetn13RdrDetnAzi : 31|11@0+ (0.1,-90.0) [-90.0|90.0] "Deg" ASDM
 SG_ FrntSideRdrRiDetn13RdrDetnChks : 7|8@0+ (1.0,0.0) [0.0|255.0] "Unitless" ASDM
 SG_ FrntSideRdrRiDetn13RdrDetnCntr : 15|4@0+ (1.0,0.0) [0.0|15.0] "Unitless" ASDM
 SG_ FrntSideRdrRiDetn13RdrDetnConf : 71|7@0+ (1.0,0.0) [0.0|100.0] "%" ASDM
 SG_ FrntSideRdrRiDetn13RdrDetnElevn : 79|5@0+ (1.0,-15.0) [-15.0|15.0] "Deg" ASDM
 SG_ FrntSideRdrRiDetn13RdrDetnPwr : 8|9@0+ (0.1,0.0) [0.0|51.1] "dB" ASDM
 SG_ FrntSideRdrRiDetn13RdrDetnRng : 55|14@0+ (0.02,-1.0) [-1.0|200.0] "m" ASDM
 SG_ FrntSideRdrRiDetn13RdrDetnRngV : 36|13@0+ (0.02,-80.0) [-80.0|80.0] "m/s" ASDM
 SG_ FrntSideRdrRiDetn13RdrDetnSts : 11|2@0+ (1,0) [0|3] "" ASDM
 SG_ FrntSideRdrRiDetn14_UB : 154|1@0+ (1,0) [0|1] "" ASDM
 SG_ FrntSideRdrRiDetn14RdrDetnAzi : 119|11@0+ (0.1,-90.0) [-90.0|90.0] "Deg" ASDM
 SG_ FrntSideRdrRiDetn14RdrDetnChks : 87|8@0+ (1.0,0.0) [0.0|255.0] "Unitless" ASDM
 SG_ FrntSideRdrRiDetn14RdrDetnCntr : 95|4@0+ (1.0,0.0) [0.0|15.0] "Unitless" ASDM
 SG_ FrntSideRdrRiDetn14RdrDetnConf : 111|7@0+ (1.0,0.0) [0.0|100.0] "%" ASDM
 SG_ FrntSideRdrRiDetn14RdrDetnElevn : 159|5@0+ (1.0,-15.0) [-15.0|15.0] "Deg" ASDM
 SG_ FrntSideRdrRiDetn14RdrDetnPwr : 89|9@0+ (0.1,0.0) [0.0|51.1] "dB" ASDM
 SG_ FrntSideRdrRiDetn14RdrDetnRng : 143|14@0+ (0.02,-1.0) [-1.0|200.0] "m" ASDM
 SG_ FrntSideRdrRiDetn14RdrDetnRngV : 124|13@0+ (0.02,-80.0) [-80.0|80.0] "m/s" ASDM
 SG_ FrntSideRdrRiDetn14RdrDetnSts : 91|2@0+ (1,0) [0|3] "" ASDM
 SG_ FrntSideRdrRiDetn15_UB : 234|1@0+ (1,0) [0|1] "" ASDM
 SG_ FrntSideRdrRiDetn15RdrDetnAzi : 199|11@0+ (0.1,-90.0) [-90.0|90.0] "Deg" ASDM
 SG_ FrntSideRdrRiDetn15RdrDetnChks : 167|8@0+ (1.0,0.0) [0.0|255.0] "Unitless" ASDM
 SG_ FrntSideRdrRiDetn15RdrDetnCntr : 175|4@0+ (1.0,0.0) [0.0|15.0] "Unitless" ASDM
 SG_ FrntSideRdrRiDetn15RdrDetnConf : 191|7@0+ (1.0,0.0) [0.0|100.0] "%" ASDM
 SG_ FrntSideRdrRiDetn15RdrDetnElevn : 239|5@0+ (1.0,-15.0) [-15.0|15.0] "Deg" ASDM
 SG_ FrntSideRdrRiDetn15RdrDetnPwr : 169|9@0+ (0.1,0.0) [0.0|51.1] "dB" ASDM
 SG_ FrntSideRdrRiDetn15RdrDetnRng : 223|14@0+ (0.02,-1.0) [-1.0|200.0] "m" ASDM
 SG_ FrntSideRdrRiDetn15RdrDetnRngV : 204|13@0+ (0.02,-80.0) [-80.0|80.0] "m/s" ASDM
 SG_ FrntSideRdrRiDetn15RdrDetnSts : 171|2@0+ (1,0) [0|3] "" ASDM
 SG_ FrntSideRdrRiDetn16_UB : 314|1@0+ (1,0) [0|1] "" ASDM
 SG_ FrntSideRdrRiDetn16RdrDetnAzi : 287|11@0+ (0.1,-90.0) [-90.0|90.0] "Deg" ASDM
 SG_ FrntSideRdrRiDetn16RdrDetnChks : 247|8@0+ (1.0,0.0) [0.0|255.0] "Unitless" ASDM
 SG_ FrntSideRdrRiDetn16RdrDetnCntr : 255|4@0+ (1.0,0.0) [0.0|15.0] "Unitless" ASDM
 SG_ FrntSideRdrRiDetn16RdrDetnConf : 311|7@0+ (1.0,0.0) [0.0|100.0] "%" ASDM
 SG_ FrntSideRdrRiDetn16RdrDetnElevn : 319|5@0+ (1.0,-15.0) [-15.0|15.0] "Deg" ASDM
 SG_ FrntSideRdrRiDetn16RdrDetnPwr : 249|9@0+ (0.1,0.0) [0.0|51.1] "dB" ASDM
 SG_ FrntSideRdrRiDetn16RdrDetnRng : 271|14@0+ (0.02,-1.0) [-1.0|200.0] "m" ASDM
 SG_ FrntSideRdrRiDetn16RdrDetnRngV : 292|13@0+ (0.02,-80.0) [-80.0|80.0] "m/s" ASDM
 SG_ FrntSideRdrRiDetn16RdrDetnSts : 251|2@0+ (1,0) [0|3] "" ASDM
 SG_ FrntSideRdrRiDetn17_UB : 394|1@0+ (1,0) [0|1] "" ASDM
 SG_ FrntSideRdrRiDetn17RdrDetnAzi : 367|11@0+ (0.1,-90.0) [-90.0|90.0] "Deg" ASDM
 SG_ FrntSideRdrRiDetn17RdrDetnChks : 327|8@0+ (1.0,0.0) [0.0|255.0] "Unitless" ASDM
 SG_ FrntSideRdrRiDetn17RdrDetnCntr : 335|4@0+ (1.0,0.0) [0.0|15.0] "Unitless" ASDM
 SG_ FrntSideRdrRiDetn17RdrDetnConf : 391|7@0+ (1.0,0.0) [0.0|100.0] "%" ASDM
 SG_ FrntSideRdrRiDetn17RdrDetnElevn : 399|5@0+ (1.0,-15.0) [-15.0|15.0] "Deg" ASDM
 SG_ FrntSideRdrRiDetn17RdrDetnPwr : 329|9@0+ (0.1,0.0) [0.0|51.1] "dB" ASDM
 SG_ FrntSideRdrRiDetn17RdrDetnRng : 351|14@0+ (0.02,-1.0) [-1.0|200.0] "m" ASDM
 SG_ FrntSideRdrRiDetn17RdrDetnRngV : 372|13@0+ (0.02,-80.0) [-80.0|80.0] "m/s" ASDM
 SG_ FrntSideRdrRiDetn17RdrDetnSts : 331|2@0+ (1,0) [0|3] "" ASDM
 SG_ FrntSideRdrRiDetn18_UB : 474|1@0+ (1,0) [0|1] "" ASDM
 SG_ FrntSideRdrRiDetn18RdrDetnAzi : 447|11@0+ (0.1,-90.0) [-90.0|90.0] "Deg" ASDM
 SG_ FrntSideRdrRiDetn18RdrDetnChks : 407|8@0+ (1.0,0.0) [0.0|255.0] "Unitless" ASDM
 SG_ FrntSideRdrRiDetn18RdrDetnCntr : 415|4@0+ (1.0,0.0) [0.0|15.0] "Unitless" ASDM
 SG_ FrntSideRdrRiDetn18RdrDetnConf : 471|7@0+ (1.0,0.0) [0.0|100.0] "%" ASDM
 SG_ FrntSideRdrRiDetn18RdrDetnElevn : 479|5@0+ (1.0,-15.0) [-15.0|15.0] "Deg" ASDM
 SG_ FrntSideRdrRiDetn18RdrDetnPwr : 409|9@0+ (0.1,0.0) [0.0|51.1] "dB" ASDM
 SG_ FrntSideRdrRiDetn18RdrDetnRng : 431|14@0+ (0.02,-1.0) [-1.0|200.0] "m" ASDM
 SG_ FrntSideRdrRiDetn18RdrDetnRngV : 452|13@0+ (0.02,-80.0) [-80.0|80.0] "m/s" ASDM
 SG_ FrntSideRdrRiDetn18RdrDetnSts : 411|2@0+ (1,0) [0|3] "" ASDM

BO_ 311 FSRRSafetyCANFD1Frame04 : 64 FSRR
 SG_ FrntSideRdrRiDetn19_UB : 74|1@0+ (1,0) [0|1] "" ASDM
 SG_ FrntSideRdrRiDetn19RdrDetnAzi : 31|11@0+ (0.1,-90.0) [-90.0|90.0] "Deg" ASDM
 SG_ FrntSideRdrRiDetn19RdrDetnChks : 7|8@0+ (1.0,0.0) [0.0|255.0] "Unitless" ASDM
 SG_ FrntSideRdrRiDetn19RdrDetnCntr : 15|4@0+ (1.0,0.0) [0.0|15.0] "Unitless" ASDM
 SG_ FrntSideRdrRiDetn19RdrDetnConf : 71|7@0+ (1.0,0.0) [0.0|100.0] "%" ASDM
 SG_ FrntSideRdrRiDetn19RdrDetnElevn : 79|5@0+ (1.0,-15.0) [-15.0|15.0] "Deg" ASDM
 SG_ FrntSideRdrRiDetn19RdrDetnPwr : 8|9@0+ (0.1,0.0) [0.0|51.1] "dB" ASDM
 SG_ FrntSideRdrRiDetn19RdrDetnRng : 55|14@0+ (0.02,-1.0) [-1.0|200.0] "m" ASDM
 SG_ FrntSideRdrRiDetn19RdrDetnRngV : 36|13@0+ (0.02,-80.0) [-80.0|80.0] "m/s" ASDM
 SG_ FrntSideRdrRiDetn19RdrDetnSts : 11|2@0+ (1,0) [0|3] "" ASDM
 SG_ FrntSideRdrRiDetn20_UB : 154|1@0+ (1,0) [0|1] "" ASDM
 SG_ FrntSideRdrRiDetn20RdrDetnAzi : 119|11@0+ (0.1,-90.0) [-90.0|90.0] "Deg" ASDM
 SG_ FrntSideRdrRiDetn20RdrDetnChks : 87|8@0+ (1.0,0.0) [0.0|255.0] "Unitless" ASDM
 SG_ FrntSideRdrRiDetn20RdrDetnCntr : 95|4@0+ (1.0,0.0) [0.0|15.0] "Unitless" ASDM
 SG_ FrntSideRdrRiDetn20RdrDetnConf : 111|7@0+ (1.0,0.0) [0.0|100.0] "%" ASDM
 SG_ FrntSideRdrRiDetn20RdrDetnElevn : 159|5@0+ (1.0,-15.0) [-15.0|15.0] "Deg" ASDM
 SG_ FrntSideRdrRiDetn20RdrDetnPwr : 89|9@0+ (0.1,0.0) [0.0|51.1] "dB" ASDM
 SG_ FrntSideRdrRiDetn20RdrDetnRng : 143|14@0+ (0.02,-1.0) [-1.0|200.0] "m" ASDM
 SG_ FrntSideRdrRiDetn20RdrDetnRngV : 124|13@0+ (0.02,-80.0) [-80.0|80.0] "m/s" ASDM
 SG_ FrntSideRdrRiDetn20RdrDetnSts : 91|2@0+ (1,0) [0|3] "" ASDM
 SG_ FrntSideRdrRiDetn21_UB : 234|1@0+ (1,0) [0|1] "" ASDM
 SG_ FrntSideRdrRiDetn21RdrDetnAzi : 199|11@0+ (0.1,-90.0) [-90.0|90.0] "Deg" ASDM
 SG_ FrntSideRdrRiDetn21RdrDetnChks : 167|8@0+ (1.0,0.0) [0.0|255.0] "Unitless" ASDM
 SG_ FrntSideRdrRiDetn21RdrDetnCntr : 175|4@0+ (1.0,0.0) [0.0|15.0] "Unitless" ASDM
 SG_ FrntSideRdrRiDetn21RdrDetnConf : 191|7@0+ (1.0,0.0) [0.0|100.0] "%" ASDM
 SG_ FrntSideRdrRiDetn21RdrDetnElevn : 239|5@0+ (1.0,-15.0) [-15.0|15.0] "Deg" ASDM
 SG_ FrntSideRdrRiDetn21RdrDetnPwr : 169|9@0+ (0.1,0.0) [0.0|51.1] "dB" ASDM
 SG_ FrntSideRdrRiDetn21RdrDetnRng : 223|14@0+ (0.02,-1.0) [-1.0|200.0] "m" ASDM
 SG_ FrntSideRdrRiDetn21RdrDetnRngV : 204|13@0+ (0.02,-80.0) [-80.0|80.0] "m/s" ASDM
 SG_ FrntSideRdrRiDetn21RdrDetnSts : 171|2@0+ (1,0) [0|3] "" ASDM
 SG_ FrntSideRdrRiDetn22_UB : 314|1@0+ (1,0) [0|1] "" ASDM
 SG_ FrntSideRdrRiDetn22RdrDetnAzi : 287|11@0+ (0.1,-90.0) [-90.0|90.0] "Deg" ASDM
 SG_ FrntSideRdrRiDetn22RdrDetnChks : 247|8@0+ (1.0,0.0) [0.0|255.0] "Unitless" ASDM
 SG_ FrntSideRdrRiDetn22RdrDetnCntr : 255|4@0+ (1.0,0.0) [0.0|15.0] "Unitless" ASDM
 SG_ FrntSideRdrRiDetn22RdrDetnConf : 311|7@0+ (1.0,0.0) [0.0|100.0] "%" ASDM
 SG_ FrntSideRdrRiDetn22RdrDetnElevn : 319|5@0+ (1.0,-15.0) [-15.0|15.0] "Deg" ASDM
 SG_ FrntSideRdrRiDetn22RdrDetnPwr : 249|9@0+ (0.1,0.0) [0.0|51.1] "dB" ASDM
 SG_ FrntSideRdrRiDetn22RdrDetnRng : 271|14@0+ (0.02,-1.0) [-1.0|200.0] "m" ASDM
 SG_ FrntSideRdrRiDetn22RdrDetnRngV : 292|13@0+ (0.02,-80.0) [-80.0|80.0] "m/s" ASDM
 SG_ FrntSideRdrRiDetn22RdrDetnSts : 251|2@0+ (1,0) [0|3] "" ASDM
 SG_ FrntSideRdrRiDetn23_UB : 394|1@0+ (1,0) [0|1] "" ASDM
 SG_ FrntSideRdrRiDetn23RdrDetnAzi : 367|11@0+ (0.1,-90.0) [-90.0|90.0] "Deg" ASDM
 SG_ FrntSideRdrRiDetn23RdrDetnChks : 327|8@0+ (1.0,0.0) [0.0|255.0] "Unitless" ASDM
 SG_ FrntSideRdrRiDetn23RdrDetnCntr : 335|4@0+ (1.0,0.0) [0.0|15.0] "Unitless" ASDM
 SG_ FrntSideRdrRiDetn23RdrDetnConf : 391|7@0+ (1.0,0.0) [0.0|100.0] "%" ASDM
 SG_ FrntSideRdrRiDetn23RdrDetnElevn : 399|5@0+ (1.0,-15.0) [-15.0|15.0] "Deg" ASDM
 SG_ FrntSideRdrRiDetn23RdrDetnPwr : 329|9@0+ (0.1,0.0) [0.0|51.1] "dB" ASDM
 SG_ FrntSideRdrRiDetn23RdrDetnRng : 351|14@0+ (0.02,-1.0) [-1.0|200.0] "m" ASDM
 SG_ FrntSideRdrRiDetn23RdrDetnRngV : 372|13@0+ (0.02,-80.0) [-80.0|80.0] "m/s" ASDM
 SG_ FrntSideRdrRiDetn23RdrDetnSts : 331|2@0+ (1,0) [0|3] "" ASDM
 SG_ FrntSideRdrRiDetn24_UB : 474|1@0+ (1,0) [0|1] "" ASDM
 SG_ FrntSideRdrRiDetn24RdrDetnAzi : 447|11@0+ (0.1,-90.0) [-90.0|90.0] "Deg" ASDM
 SG_ FrntSideRdrRiDetn24RdrDetnChks : 407|8@0+ (1.0,0.0) [0.0|255.0] "Unitless" ASDM
 SG_ FrntSideRdrRiDetn24RdrDetnCntr : 415|4@0+ (1.0,0.0) [0.0|15.0] "Unitless" ASDM
 SG_ FrntSideRdrRiDetn24RdrDetnConf : 471|7@0+ (1.0,0.0) [0.0|100.0] "%" ASDM
 SG_ FrntSideRdrRiDetn24RdrDetnElevn : 479|5@0+ (1.0,-15.0) [-15.0|15.0] "Deg" ASDM
 SG_ FrntSideRdrRiDetn24RdrDetnPwr : 409|9@0+ (0.1,0.0) [0.0|51.1] "dB" ASDM
 SG_ FrntSideRdrRiDetn24RdrDetnRng : 431|14@0+ (0.02,-1.0) [-1.0|200.0] "m" ASDM
 SG_ FrntSideRdrRiDetn24RdrDetnRngV : 452|13@0+ (0.02,-80.0) [-80.0|80.0] "m/s" ASDM
 SG_ FrntSideRdrRiDetn24RdrDetnSts : 411|2@0+ (1,0) [0|3] "" ASDM

BO_ 313 FSRRSafetyCANFD1Frame05 : 64 FSRR
 SG_ FrntSideRdrRiDetn25_UB : 74|1@0+ (1,0) [0|1] "" ASDM
 SG_ FrntSideRdrRiDetn25RdrDetnAzi : 31|11@0+ (0.1,-90.0) [-90.0|90.0] "Deg" ASDM
 SG_ FrntSideRdrRiDetn25RdrDetnChks : 7|8@0+ (1.0,0.0) [0.0|255.0] "Unitless" ASDM
 SG_ FrntSideRdrRiDetn25RdrDetnCntr : 15|4@0+ (1.0,0.0) [0.0|15.0] "Unitless" ASDM
 SG_ FrntSideRdrRiDetn25RdrDetnConf : 71|7@0+ (1.0,0.0) [0.0|100.0] "%" ASDM
 SG_ FrntSideRdrRiDetn25RdrDetnElevn : 79|5@0+ (1.0,-15.0) [-15.0|15.0] "Deg" ASDM
 SG_ FrntSideRdrRiDetn25RdrDetnPwr : 8|9@0+ (0.1,0.0) [0.0|51.1] "dB" ASDM
 SG_ FrntSideRdrRiDetn25RdrDetnRng : 55|14@0+ (0.02,-1.0) [-1.0|200.0] "m" ASDM
 SG_ FrntSideRdrRiDetn25RdrDetnRngV : 36|13@0+ (0.02,-80.0) [-80.0|80.0] "m/s" ASDM
 SG_ FrntSideRdrRiDetn25RdrDetnSts : 11|2@0+ (1,0) [0|3] "" ASDM
 SG_ FrntSideRdrRiDetn26_UB : 154|1@0+ (1,0) [0|1] "" ASDM
 SG_ FrntSideRdrRiDetn26RdrDetnAzi : 119|11@0+ (0.1,-90.0) [-90.0|90.0] "Deg" ASDM
 SG_ FrntSideRdrRiDetn26RdrDetnChks : 87|8@0+ (1.0,0.0) [0.0|255.0] "Unitless" ASDM
 SG_ FrntSideRdrRiDetn26RdrDetnCntr : 95|4@0+ (1.0,0.0) [0.0|15.0] "Unitless" ASDM
 SG_ FrntSideRdrRiDetn26RdrDetnConf : 111|7@0+ (1.0,0.0) [0.0|100.0] "%" ASDM
 SG_ FrntSideRdrRiDetn26RdrDetnElevn : 159|5@0+ (1.0,-15.0) [-15.0|15.0] "Deg" ASDM
 SG_ FrntSideRdrRiDetn26RdrDetnPwr : 89|9@0+ (0.1,0.0) [0.0|51.1] "dB" ASDM
 SG_ FrntSideRdrRiDetn26RdrDetnRng : 143|14@0+ (0.02,-1.0) [-1.0|200.0] "m" ASDM
 SG_ FrntSideRdrRiDetn26RdrDetnRngV : 124|13@0+ (0.02,-80.0) [-80.0|80.0] "m/s" ASDM
 SG_ FrntSideRdrRiDetn26RdrDetnSts : 91|2@0+ (1,0) [0|3] "" ASDM
 SG_ FrntSideRdrRiDetn27_UB : 234|1@0+ (1,0) [0|1] "" ASDM
 SG_ FrntSideRdrRiDetn27RdrDetnAzi : 199|11@0+ (0.1,-90.0) [-90.0|90.0] "Deg" ASDM
 SG_ FrntSideRdrRiDetn27RdrDetnChks : 167|8@0+ (1.0,0.0) [0.0|255.0] "Unitless" ASDM
 SG_ FrntSideRdrRiDetn27RdrDetnCntr : 175|4@0+ (1.0,0.0) [0.0|15.0] "Unitless" ASDM
 SG_ FrntSideRdrRiDetn27RdrDetnConf : 191|7@0+ (1.0,0.0) [0.0|100.0] "%" ASDM
 SG_ FrntSideRdrRiDetn27RdrDetnElevn : 239|5@0+ (1.0,-15.0) [-15.0|15.0] "Deg" ASDM
 SG_ FrntSideRdrRiDetn27RdrDetnPwr : 169|9@0+ (0.1,0.0) [0.0|51.1] "dB" ASDM
 SG_ FrntSideRdrRiDetn27RdrDetnRng : 223|14@0+ (0.02,-1.0) [-1.0|200.0] "m" ASDM
 SG_ FrntSideRdrRiDetn27RdrDetnRngV : 204|13@0+ (0.02,-80.0) [-80.0|80.0] "m/s" ASDM
 SG_ FrntSideRdrRiDetn27RdrDetnSts : 171|2@0+ (1,0) [0|3] "" ASDM
 SG_ FrntSideRdrRiDetn28_UB : 314|1@0+ (1,0) [0|1] "" ASDM
 SG_ FrntSideRdrRiDetn28RdrDetnAzi : 287|11@0+ (0.1,-90.0) [-90.0|90.0] "Deg" ASDM
 SG_ FrntSideRdrRiDetn28RdrDetnChks : 247|8@0+ (1.0,0.0) [0.0|255.0] "Unitless" ASDM
 SG_ FrntSideRdrRiDetn28RdrDetnCntr : 255|4@0+ (1.0,0.0) [0.0|15.0] "Unitless" ASDM
 SG_ FrntSideRdrRiDetn28RdrDetnConf : 311|7@0+ (1.0,0.0) [0.0|100.0] "%" ASDM
 SG_ FrntSideRdrRiDetn28RdrDetnElevn : 319|5@0+ (1.0,-15.0) [-15.0|15.0] "Deg" ASDM
 SG_ FrntSideRdrRiDetn28RdrDetnPwr : 249|9@0+ (0.1,0.0) [0.0|51.1] "dB" ASDM
 SG_ FrntSideRdrRiDetn28RdrDetnRng : 271|14@0+ (0.02,-1.0) [-1.0|200.0] "m" ASDM
 SG_ FrntSideRdrRiDetn28RdrDetnRngV : 292|13@0+ (0.02,-80.0) [-80.0|80.0] "m/s" ASDM
 SG_ FrntSideRdrRiDetn28RdrDetnSts : 251|2@0+ (1,0) [0|3] "" ASDM
 SG_ FrntSideRdrRiDetn29_UB : 394|1@0+ (1,0) [0|1] "" ASDM
 SG_ FrntSideRdrRiDetn29RdrDetnAzi : 367|11@0+ (0.1,-90.0) [-90.0|90.0] "Deg" ASDM
 SG_ FrntSideRdrRiDetn29RdrDetnChks : 327|8@0+ (1.0,0.0) [0.0|255.0] "Unitless" ASDM
 SG_ FrntSideRdrRiDetn29RdrDetnCntr : 335|4@0+ (1.0,0.0) [0.0|15.0] "Unitless" ASDM
 SG_ FrntSideRdrRiDetn29RdrDetnConf : 391|7@0+ (1.0,0.0) [0.0|100.0] "%" ASDM
 SG_ FrntSideRdrRiDetn29RdrDetnElevn : 399|5@0+ (1.0,-15.0) [-15.0|15.0] "Deg" ASDM
 SG_ FrntSideRdrRiDetn29RdrDetnPwr : 329|9@0+ (0.1,0.0) [0.0|51.1] "dB" ASDM
 SG_ FrntSideRdrRiDetn29RdrDetnRng : 351|14@0+ (0.02,-1.0) [-1.0|200.0] "m" ASDM
 SG_ FrntSideRdrRiDetn29RdrDetnRngV : 372|13@0+ (0.02,-80.0) [-80.0|80.0] "m/s" ASDM
 SG_ FrntSideRdrRiDetn29RdrDetnSts : 331|2@0+ (1,0) [0|3] "" ASDM
 SG_ FrntSideRdrRiDetn30_UB : 474|1@0+ (1,0) [0|1] "" ASDM
 SG_ FrntSideRdrRiDetn30RdrDetnAzi : 447|11@0+ (0.1,-90.0) [-90.0|90.0] "Deg" ASDM
 SG_ FrntSideRdrRiDetn30RdrDetnChks : 407|8@0+ (1.0,0.0) [0.0|255.0] "Unitless" ASDM
 SG_ FrntSideRdrRiDetn30RdrDetnCntr : 415|4@0+ (1.0,0.0) [0.0|15.0] "Unitless" ASDM
 SG_ FrntSideRdrRiDetn30RdrDetnConf : 471|7@0+ (1.0,0.0) [0.0|100.0] "%" ASDM
 SG_ FrntSideRdrRiDetn30RdrDetnElevn : 479|5@0+ (1.0,-15.0) [-15.0|15.0] "Deg" ASDM
 SG_ FrntSideRdrRiDetn30RdrDetnPwr : 409|9@0+ (0.1,0.0) [0.0|51.1] "dB" ASDM
 SG_ FrntSideRdrRiDetn30RdrDetnRng : 431|14@0+ (0.02,-1.0) [-1.0|200.0] "m" ASDM
 SG_ FrntSideRdrRiDetn30RdrDetnRngV : 452|13@0+ (0.02,-80.0) [-80.0|80.0] "m/s" ASDM
 SG_ FrntSideRdrRiDetn30RdrDetnSts : 411|2@0+ (1,0) [0|3] "" ASDM

BO_ 315 FSRRSafetyCANFD1Frame06 : 64 FSRR
 SG_ FrntSideRdrRiDetn31_UB : 74|1@0+ (1,0) [0|1] "" ASDM
 SG_ FrntSideRdrRiDetn31RdrDetnAzi : 31|11@0+ (0.1,-90.0) [-90.0|90.0] "Deg" ASDM
 SG_ FrntSideRdrRiDetn31RdrDetnChks : 7|8@0+ (1.0,0.0) [0.0|255.0] "Unitless" ASDM
 SG_ FrntSideRdrRiDetn31RdrDetnCntr : 15|4@0+ (1.0,0.0) [0.0|15.0] "Unitless" ASDM
 SG_ FrntSideRdrRiDetn31RdrDetnConf : 71|7@0+ (1.0,0.0) [0.0|100.0] "%" ASDM
 SG_ FrntSideRdrRiDetn31RdrDetnElevn : 79|5@0+ (1.0,-15.0) [-15.0|15.0] "Deg" ASDM
 SG_ FrntSideRdrRiDetn31RdrDetnPwr : 8|9@0+ (0.1,0.0) [0.0|51.1] "dB" ASDM
 SG_ FrntSideRdrRiDetn31RdrDetnRng : 55|14@0+ (0.02,-1.0) [-1.0|200.0] "m" ASDM
 SG_ FrntSideRdrRiDetn31RdrDetnRngV : 36|13@0+ (0.02,-80.0) [-80.0|80.0] "m/s" ASDM
 SG_ FrntSideRdrRiDetn31RdrDetnSts : 11|2@0+ (1,0) [0|3] "" ASDM
 SG_ FrntSideRdrRiDetn32_UB : 154|1@0+ (1,0) [0|1] "" ASDM
 SG_ FrntSideRdrRiDetn32RdrDetnAzi : 119|11@0+ (0.1,-90.0) [-90.0|90.0] "Deg" ASDM
 SG_ FrntSideRdrRiDetn32RdrDetnChks : 87|8@0+ (1.0,0.0) [0.0|255.0] "Unitless" ASDM
 SG_ FrntSideRdrRiDetn32RdrDetnCntr : 95|4@0+ (1.0,0.0) [0.0|15.0] "Unitless" ASDM
 SG_ FrntSideRdrRiDetn32RdrDetnConf : 111|7@0+ (1.0,0.0) [0.0|100.0] "%" ASDM
 SG_ FrntSideRdrRiDetn32RdrDetnElevn : 159|5@0+ (1.0,-15.0) [-15.0|15.0] "Deg" ASDM
 SG_ FrntSideRdrRiDetn32RdrDetnPwr : 89|9@0+ (0.1,0.0) [0.0|51.1] "dB" ASDM
 SG_ FrntSideRdrRiDetn32RdrDetnRng : 143|14@0+ (0.02,-1.0) [-1.0|200.0] "m" ASDM
 SG_ FrntSideRdrRiDetn32RdrDetnRngV : 124|13@0+ (0.02,-80.0) [-80.0|80.0] "m/s" ASDM
 SG_ FrntSideRdrRiDetn32RdrDetnSts : 91|2@0+ (1,0) [0|3] "" ASDM
 SG_ FrntSideRdrRiDetn33_UB : 234|1@0+ (1,0) [0|1] "" ASDM
 SG_ FrntSideRdrRiDetn33RdrDetnAzi : 199|11@0+ (0.1,-90.0) [-90.0|90.0] "Deg" ASDM
 SG_ FrntSideRdrRiDetn33RdrDetnChks : 167|8@0+ (1.0,0.0) [0.0|255.0] "Unitless" ASDM
 SG_ FrntSideRdrRiDetn33RdrDetnCntr : 175|4@0+ (1.0,0.0) [0.0|15.0] "Unitless" ASDM
 SG_ FrntSideRdrRiDetn33RdrDetnConf : 191|7@0+ (1.0,0.0) [0.0|100.0] "%" ASDM
 SG_ FrntSideRdrRiDetn33RdrDetnElevn : 239|5@0+ (1.0,-15.0) [-15.0|15.0] "Deg" ASDM
 SG_ FrntSideRdrRiDetn33RdrDetnPwr : 169|9@0+ (0.1,0.0) [0.0|51.1] "dB" ASDM
 SG_ FrntSideRdrRiDetn33RdrDetnRng : 223|14@0+ (0.02,-1.0) [-1.0|200.0] "m" ASDM
 SG_ FrntSideRdrRiDetn33RdrDetnRngV : 204|13@0+ (0.02,-80.0) [-80.0|80.0] "m/s" ASDM
 SG_ FrntSideRdrRiDetn33RdrDetnSts : 171|2@0+ (1,0) [0|3] "" ASDM
 SG_ FrntSideRdrRiDetn34_UB : 314|1@0+ (1,0) [0|1] "" ASDM
 SG_ FrntSideRdrRiDetn34RdrDetnAzi : 287|11@0+ (0.1,-90.0) [-90.0|90.0] "Deg" ASDM
 SG_ FrntSideRdrRiDetn34RdrDetnChks : 247|8@0+ (1.0,0.0) [0.0|255.0] "Unitless" ASDM
 SG_ FrntSideRdrRiDetn34RdrDetnCntr : 255|4@0+ (1.0,0.0) [0.0|15.0] "Unitless" ASDM
 SG_ FrntSideRdrRiDetn34RdrDetnConf : 311|7@0+ (1.0,0.0) [0.0|100.0] "%" ASDM
 SG_ FrntSideRdrRiDetn34RdrDetnElevn : 319|5@0+ (1.0,-15.0) [-15.0|15.0] "Deg" ASDM
 SG_ FrntSideRdrRiDetn34RdrDetnPwr : 249|9@0+ (0.1,0.0) [0.0|51.1] "dB" ASDM
 SG_ FrntSideRdrRiDetn34RdrDetnRng : 271|14@0+ (0.02,-1.0) [-1.0|200.0] "m" ASDM
 SG_ FrntSideRdrRiDetn34RdrDetnRngV : 292|13@0+ (0.02,-80.0) [-80.0|80.0] "m/s" ASDM
 SG_ FrntSideRdrRiDetn34RdrDetnSts : 251|2@0+ (1,0) [0|3] "" ASDM
 SG_ FrntSideRdrRiDetn35_UB : 394|1@0+ (1,0) [0|1] "" ASDM
 SG_ FrntSideRdrRiDetn35RdrDetnAzi : 367|11@0+ (0.1,-90.0) [-90.0|90.0] "Deg" ASDM
 SG_ FrntSideRdrRiDetn35RdrDetnChks : 327|8@0+ (1.0,0.0) [0.0|255.0] "Unitless" ASDM
 SG_ FrntSideRdrRiDetn35RdrDetnCntr : 335|4@0+ (1.0,0.0) [0.0|15.0] "Unitless" ASDM
 SG_ FrntSideRdrRiDetn35RdrDetnConf : 391|7@0+ (1.0,0.0) [0.0|100.0] "%" ASDM
 SG_ FrntSideRdrRiDetn35RdrDetnElevn : 399|5@0+ (1.0,-15.0) [-15.0|15.0] "Deg" ASDM
 SG_ FrntSideRdrRiDetn35RdrDetnPwr : 329|9@0+ (0.1,0.0) [0.0|51.1] "dB" ASDM
 SG_ FrntSideRdrRiDetn35RdrDetnRng : 351|14@0+ (0.02,-1.0) [-1.0|200.0] "m" ASDM
 SG_ FrntSideRdrRiDetn35RdrDetnRngV : 372|13@0+ (0.02,-80.0) [-80.0|80.0] "m/s" ASDM
 SG_ FrntSideRdrRiDetn35RdrDetnSts : 331|2@0+ (1,0) [0|3] "" ASDM
 SG_ FrntSideRdrRiDetn36_UB : 474|1@0+ (1,0) [0|1] "" ASDM
 SG_ FrntSideRdrRiDetn36RdrDetnAzi : 447|11@0+ (0.1,-90.0) [-90.0|90.0] "Deg" ASDM
 SG_ FrntSideRdrRiDetn36RdrDetnChks : 407|8@0+ (1.0,0.0) [0.0|255.0] "Unitless" ASDM
 SG_ FrntSideRdrRiDetn36RdrDetnCntr : 415|4@0+ (1.0,0.0) [0.0|15.0] "Unitless" ASDM
 SG_ FrntSideRdrRiDetn36RdrDetnConf : 471|7@0+ (1.0,0.0) [0.0|100.0] "%" ASDM
 SG_ FrntSideRdrRiDetn36RdrDetnElevn : 479|5@0+ (1.0,-15.0) [-15.0|15.0] "Deg" ASDM
 SG_ FrntSideRdrRiDetn36RdrDetnPwr : 409|9@0+ (0.1,0.0) [0.0|51.1] "dB" ASDM
 SG_ FrntSideRdrRiDetn36RdrDetnRng : 431|14@0+ (0.02,-1.0) [-1.0|200.0] "m" ASDM
 SG_ FrntSideRdrRiDetn36RdrDetnRngV : 452|13@0+ (0.02,-80.0) [-80.0|80.0] "m/s" ASDM
 SG_ FrntSideRdrRiDetn36RdrDetnSts : 411|2@0+ (1,0) [0|3] "" ASDM

BO_ 317 FSRRSafetyCANFD1Frame07 : 64 FSRR
 SG_ FrntSideRdrRiDetn37_UB : 74|1@0+ (1,0) [0|1] "" ASDM
 SG_ FrntSideRdrRiDetn37RdrDetnAzi : 31|11@0+ (0.1,-90.0) [-90.0|90.0] "Deg" ASDM
 SG_ FrntSideRdrRiDetn37RdrDetnChks : 7|8@0+ (1.0,0.0) [0.0|255.0] "Unitless" ASDM
 SG_ FrntSideRdrRiDetn37RdrDetnCntr : 15|4@0+ (1.0,0.0) [0.0|15.0] "Unitless" ASDM
 SG_ FrntSideRdrRiDetn37RdrDetnConf : 71|7@0+ (1.0,0.0) [0.0|100.0] "%" ASDM
 SG_ FrntSideRdrRiDetn37RdrDetnElevn : 79|5@0+ (1.0,-15.0) [-15.0|15.0] "Deg" ASDM
 SG_ FrntSideRdrRiDetn37RdrDetnPwr : 8|9@0+ (0.1,0.0) [0.0|51.1] "dB" ASDM
 SG_ FrntSideRdrRiDetn37RdrDetnRng : 55|14@0+ (0.02,-1.0) [-1.0|200.0] "m" ASDM
 SG_ FrntSideRdrRiDetn37RdrDetnRngV : 36|13@0+ (0.02,-80.0) [-80.0|80.0] "m/s" ASDM
 SG_ FrntSideRdrRiDetn37RdrDetnSts : 11|2@0+ (1,0) [0|3] "" ASDM
 SG_ FrntSideRdrRiDetn38_UB : 154|1@0+ (1,0) [0|1] "" ASDM
 SG_ FrntSideRdrRiDetn38RdrDetnAzi : 119|11@0+ (0.1,-90.0) [-90.0|90.0] "Deg" ASDM
 SG_ FrntSideRdrRiDetn38RdrDetnChks : 87|8@0+ (1.0,0.0) [0.0|255.0] "Unitless" ASDM
 SG_ FrntSideRdrRiDetn38RdrDetnCntr : 95|4@0+ (1.0,0.0) [0.0|15.0] "Unitless" ASDM
 SG_ FrntSideRdrRiDetn38RdrDetnConf : 111|7@0+ (1.0,0.0) [0.0|100.0] "%" ASDM
 SG_ FrntSideRdrRiDetn38RdrDetnElevn : 159|5@0+ (1.0,-15.0) [-15.0|15.0] "Deg" ASDM
 SG_ FrntSideRdrRiDetn38RdrDetnPwr : 89|9@0+ (0.1,0.0) [0.0|51.1] "dB" ASDM
 SG_ FrntSideRdrRiDetn38RdrDetnRng : 143|14@0+ (0.02,-1.0) [-1.0|200.0] "m" ASDM
 SG_ FrntSideRdrRiDetn38RdrDetnRngV : 124|13@0+ (0.02,-80.0) [-80.0|80.0] "m/s" ASDM
 SG_ FrntSideRdrRiDetn38RdrDetnSts : 91|2@0+ (1,0) [0|3] "" ASDM
 SG_ FrntSideRdrRiDetn39_UB : 234|1@0+ (1,0) [0|1] "" ASDM
 SG_ FrntSideRdrRiDetn39RdrDetnAzi : 199|11@0+ (0.1,-90.0) [-90.0|90.0] "Deg" ASDM
 SG_ FrntSideRdrRiDetn39RdrDetnChks : 167|8@0+ (1.0,0.0) [0.0|255.0] "Unitless" ASDM
 SG_ FrntSideRdrRiDetn39RdrDetnCntr : 175|4@0+ (1.0,0.0) [0.0|15.0] "Unitless" ASDM
 SG_ FrntSideRdrRiDetn39RdrDetnConf : 191|7@0+ (1.0,0.0) [0.0|100.0] "%" ASDM
 SG_ FrntSideRdrRiDetn39RdrDetnElevn : 239|5@0+ (1.0,-15.0) [-15.0|15.0] "Deg" ASDM
 SG_ FrntSideRdrRiDetn39RdrDetnPwr : 169|9@0+ (0.1,0.0) [0.0|51.1] "dB" ASDM
 SG_ FrntSideRdrRiDetn39RdrDetnRng : 223|14@0+ (0.02,-1.0) [-1.0|200.0] "m" ASDM
 SG_ FrntSideRdrRiDetn39RdrDetnRngV : 204|13@0+ (0.02,-80.0) [-80.0|80.0] "m/s" ASDM
 SG_ FrntSideRdrRiDetn39RdrDetnSts : 171|2@0+ (1,0) [0|3] "" ASDM
 SG_ FrntSideRdrRiDetn40_UB : 314|1@0+ (1,0) [0|1] "" ASDM
 SG_ FrntSideRdrRiDetn40RdrDetnAzi : 287|11@0+ (0.1,-90.0) [-90.0|90.0] "Deg" ASDM
 SG_ FrntSideRdrRiDetn40RdrDetnChks : 247|8@0+ (1.0,0.0) [0.0|255.0] "Unitless" ASDM
 SG_ FrntSideRdrRiDetn40RdrDetnCntr : 255|4@0+ (1.0,0.0) [0.0|15.0] "Unitless" ASDM
 SG_ FrntSideRdrRiDetn40RdrDetnConf : 311|7@0+ (1.0,0.0) [0.0|100.0] "%" ASDM
 SG_ FrntSideRdrRiDetn40RdrDetnElevn : 319|5@0+ (1.0,-15.0) [-15.0|15.0] "Deg" ASDM
 SG_ FrntSideRdrRiDetn40RdrDetnPwr : 249|9@0+ (0.1,0.0) [0.0|51.1] "dB" ASDM
 SG_ FrntSideRdrRiDetn40RdrDetnRng : 271|14@0+ (0.02,-1.0) [-1.0|200.0] "m" ASDM
 SG_ FrntSideRdrRiDetn40RdrDetnRngV : 292|13@0+ (0.02,-80.0) [-80.0|80.0] "m/s" ASDM
 SG_ FrntSideRdrRiDetn40RdrDetnSts : 251|2@0+ (1,0) [0|3] "" ASDM
 SG_ FrntSideRdrRiDetn41_UB : 394|1@0+ (1,0) [0|1] "" ASDM
 SG_ FrntSideRdrRiDetn41RdrDetnAzi : 367|11@0+ (0.1,-90.0) [-90.0|90.0] "Deg" ASDM
 SG_ FrntSideRdrRiDetn41RdrDetnChks : 327|8@0+ (1.0,0.0) [0.0|255.0] "Unitless" ASDM
 SG_ FrntSideRdrRiDetn41RdrDetnCntr : 335|4@0+ (1.0,0.0) [0.0|15.0] "Unitless" ASDM
 SG_ FrntSideRdrRiDetn41RdrDetnConf : 391|7@0+ (1.0,0.0) [0.0|100.0] "%" ASDM
 SG_ FrntSideRdrRiDetn41RdrDetnElevn : 399|5@0+ (1.0,-15.0) [-15.0|15.0] "Deg" ASDM
 SG_ FrntSideRdrRiDetn41RdrDetnPwr : 329|9@0+ (0.1,0.0) [0.0|51.1] "dB" ASDM
 SG_ FrntSideRdrRiDetn41RdrDetnRng : 351|14@0+ (0.02,-1.0) [-1.0|200.0] "m" ASDM
 SG_ FrntSideRdrRiDetn41RdrDetnRngV : 372|13@0+ (0.02,-80.0) [-80.0|80.0] "m/s" ASDM
 SG_ FrntSideRdrRiDetn41RdrDetnSts : 331|2@0+ (1,0) [0|3] "" ASDM
 SG_ FrntSideRdrRiDetn42_UB : 474|1@0+ (1,0) [0|1] "" ASDM
 SG_ FrntSideRdrRiDetn42RdrDetnAzi : 447|11@0+ (0.1,-90.0) [-90.0|90.0] "Deg" ASDM
 SG_ FrntSideRdrRiDetn42RdrDetnChks : 407|8@0+ (1.0,0.0) [0.0|255.0] "Unitless" ASDM
 SG_ FrntSideRdrRiDetn42RdrDetnCntr : 415|4@0+ (1.0,0.0) [0.0|15.0] "Unitless" ASDM
 SG_ FrntSideRdrRiDetn42RdrDetnConf : 471|7@0+ (1.0,0.0) [0.0|100.0] "%" ASDM
 SG_ FrntSideRdrRiDetn42RdrDetnElevn : 479|5@0+ (1.0,-15.0) [-15.0|15.0] "Deg" ASDM
 SG_ FrntSideRdrRiDetn42RdrDetnPwr : 409|9@0+ (0.1,0.0) [0.0|51.1] "dB" ASDM
 SG_ FrntSideRdrRiDetn42RdrDetnRng : 431|14@0+ (0.02,-1.0) [-1.0|200.0] "m" ASDM
 SG_ FrntSideRdrRiDetn42RdrDetnRngV : 452|13@0+ (0.02,-80.0) [-80.0|80.0] "m/s" ASDM
 SG_ FrntSideRdrRiDetn42RdrDetnSts : 411|2@0+ (1,0) [0|3] "" ASDM

BO_ 319 FSRRSafetyCANFD1Frame08 : 64 FSRR
 SG_ FrntSideRdrRiDetn43_UB : 74|1@0+ (1,0) [0|1] "" ASDM
 SG_ FrntSideRdrRiDetn43RdrDetnAzi : 31|11@0+ (0.1,-90.0) [-90.0|90.0] "Deg" ASDM
 SG_ FrntSideRdrRiDetn43RdrDetnChks : 7|8@0+ (1.0,0.0) [0.0|255.0] "Unitless" ASDM
 SG_ FrntSideRdrRiDetn43RdrDetnCntr : 15|4@0+ (1.0,0.0) [0.0|15.0] "Unitless" ASDM
 SG_ FrntSideRdrRiDetn43RdrDetnConf : 71|7@0+ (1.0,0.0) [0.0|100.0] "%" ASDM
 SG_ FrntSideRdrRiDetn43RdrDetnElevn : 79|5@0+ (1.0,-15.0) [-15.0|15.0] "Deg" ASDM
 SG_ FrntSideRdrRiDetn43RdrDetnPwr : 8|9@0+ (0.1,0.0) [0.0|51.1] "dB" ASDM
 SG_ FrntSideRdrRiDetn43RdrDetnRng : 55|14@0+ (0.02,-1.0) [-1.0|200.0] "m" ASDM
 SG_ FrntSideRdrRiDetn43RdrDetnRngV : 36|13@0+ (0.02,-80.0) [-80.0|80.0] "m/s" ASDM
 SG_ FrntSideRdrRiDetn43RdrDetnSts : 11|2@0+ (1,0) [0|3] "" ASDM
 SG_ FrntSideRdrRiDetn44_UB : 154|1@0+ (1,0) [0|1] "" ASDM
 SG_ FrntSideRdrRiDetn44RdrDetnAzi : 119|11@0+ (0.1,-90.0) [-90.0|90.0] "Deg" ASDM
 SG_ FrntSideRdrRiDetn44RdrDetnChks : 87|8@0+ (1.0,0.0) [0.0|255.0] "Unitless" ASDM
 SG_ FrntSideRdrRiDetn44RdrDetnCntr : 95|4@0+ (1.0,0.0) [0.0|15.0] "Unitless" ASDM
 SG_ FrntSideRdrRiDetn44RdrDetnConf : 111|7@0+ (1.0,0.0) [0.0|100.0] "%" ASDM
 SG_ FrntSideRdrRiDetn44RdrDetnElevn : 159|5@0+ (1.0,-15.0) [-15.0|15.0] "Deg" ASDM
 SG_ FrntSideRdrRiDetn44RdrDetnPwr : 89|9@0+ (0.1,0.0) [0.0|51.1] "dB" ASDM
 SG_ FrntSideRdrRiDetn44RdrDetnRng : 143|14@0+ (0.02,-1.0) [-1.0|200.0] "m" ASDM
 SG_ FrntSideRdrRiDetn44RdrDetnRngV : 124|13@0+ (0.02,-80.0) [-80.0|80.0] "m/s" ASDM
 SG_ FrntSideRdrRiDetn44RdrDetnSts : 91|2@0+ (1,0) [0|3] "" ASDM
 SG_ FrntSideRdrRiDetn45_UB : 234|1@0+ (1,0) [0|1] "" ASDM
 SG_ FrntSideRdrRiDetn45RdrDetnAzi : 199|11@0+ (0.1,-90.0) [-90.0|90.0] "Deg" ASDM
 SG_ FrntSideRdrRiDetn45RdrDetnChks : 167|8@0+ (1.0,0.0) [0.0|255.0] "Unitless" ASDM
 SG_ FrntSideRdrRiDetn45RdrDetnCntr : 175|4@0+ (1.0,0.0) [0.0|15.0] "Unitless" ASDM
 SG_ FrntSideRdrRiDetn45RdrDetnConf : 191|7@0+ (1.0,0.0) [0.0|100.0] "%" ASDM
 SG_ FrntSideRdrRiDetn45RdrDetnElevn : 239|5@0+ (1.0,-15.0) [-15.0|15.0] "Deg" ASDM
 SG_ FrntSideRdrRiDetn45RdrDetnPwr : 169|9@0+ (0.1,0.0) [0.0|51.1] "dB" ASDM
 SG_ FrntSideRdrRiDetn45RdrDetnRng : 223|14@0+ (0.02,-1.0) [-1.0|200.0] "m" ASDM
 SG_ FrntSideRdrRiDetn45RdrDetnRngV : 204|13@0+ (0.02,-80.0) [-80.0|80.0] "m/s" ASDM
 SG_ FrntSideRdrRiDetn45RdrDetnSts : 171|2@0+ (1,0) [0|3] "" ASDM
 SG_ FrntSideRdrRiDetn46_UB : 314|1@0+ (1,0) [0|1] "" ASDM
 SG_ FrntSideRdrRiDetn46RdrDetnAzi : 287|11@0+ (0.1,-90.0) [-90.0|90.0] "Deg" ASDM
 SG_ FrntSideRdrRiDetn46RdrDetnChks : 247|8@0+ (1.0,0.0) [0.0|255.0] "Unitless" ASDM
 SG_ FrntSideRdrRiDetn46RdrDetnCntr : 255|4@0+ (1.0,0.0) [0.0|15.0] "Unitless" ASDM
 SG_ FrntSideRdrRiDetn46RdrDetnConf : 311|7@0+ (1.0,0.0) [0.0|100.0] "%" ASDM
 SG_ FrntSideRdrRiDetn46RdrDetnElevn : 319|5@0+ (1.0,-15.0) [-15.0|15.0] "Deg" ASDM
 SG_ FrntSideRdrRiDetn46RdrDetnPwr : 249|9@0+ (0.1,0.0) [0.0|51.1] "dB" ASDM
 SG_ FrntSideRdrRiDetn46RdrDetnRng : 271|14@0+ (0.02,-1.0) [-1.0|200.0] "m" ASDM
 SG_ FrntSideRdrRiDetn46RdrDetnRngV : 292|13@0+ (0.02,-80.0) [-80.0|80.0] "m/s" ASDM
 SG_ FrntSideRdrRiDetn46RdrDetnSts : 251|2@0+ (1,0) [0|3] "" ASDM
 SG_ FrntSideRdrRiDetn47_UB : 394|1@0+ (1,0) [0|1] "" ASDM
 SG_ FrntSideRdrRiDetn47RdrDetnAzi : 367|11@0+ (0.1,-90.0) [-90.0|90.0] "Deg" ASDM
 SG_ FrntSideRdrRiDetn47RdrDetnChks : 327|8@0+ (1.0,0.0) [0.0|255.0] "Unitless" ASDM
 SG_ FrntSideRdrRiDetn47RdrDetnCntr : 335|4@0+ (1.0,0.0) [0.0|15.0] "Unitless" ASDM
 SG_ FrntSideRdrRiDetn47RdrDetnConf : 391|7@0+ (1.0,0.0) [0.0|100.0] "%" ASDM
 SG_ FrntSideRdrRiDetn47RdrDetnElevn : 399|5@0+ (1.0,-15.0) [-15.0|15.0] "Deg" ASDM
 SG_ FrntSideRdrRiDetn47RdrDetnPwr : 329|9@0+ (0.1,0.0) [0.0|51.1] "dB" ASDM
 SG_ FrntSideRdrRiDetn47RdrDetnRng : 351|14@0+ (0.02,-1.0) [-1.0|200.0] "m" ASDM
 SG_ FrntSideRdrRiDetn47RdrDetnRngV : 372|13@0+ (0.02,-80.0) [-80.0|80.0] "m/s" ASDM
 SG_ FrntSideRdrRiDetn47RdrDetnSts : 331|2@0+ (1,0) [0|3] "" ASDM
 SG_ FrntSideRdrRiDetn48_UB : 474|1@0+ (1,0) [0|1] "" ASDM
 SG_ FrntSideRdrRiDetn48RdrDetnAzi : 447|11@0+ (0.1,-90.0) [-90.0|90.0] "Deg" ASDM
 SG_ FrntSideRdrRiDetn48RdrDetnChks : 407|8@0+ (1.0,0.0) [0.0|255.0] "Unitless" ASDM
 SG_ FrntSideRdrRiDetn48RdrDetnCntr : 415|4@0+ (1.0,0.0) [0.0|15.0] "Unitless" ASDM
 SG_ FrntSideRdrRiDetn48RdrDetnConf : 471|7@0+ (1.0,0.0) [0.0|100.0] "%" ASDM
 SG_ FrntSideRdrRiDetn48RdrDetnElevn : 479|5@0+ (1.0,-15.0) [-15.0|15.0] "Deg" ASDM
 SG_ FrntSideRdrRiDetn48RdrDetnPwr : 409|9@0+ (0.1,0.0) [0.0|51.1] "dB" ASDM
 SG_ FrntSideRdrRiDetn48RdrDetnRng : 431|14@0+ (0.02,-1.0) [-1.0|200.0] "m" ASDM
 SG_ FrntSideRdrRiDetn48RdrDetnRngV : 452|13@0+ (0.02,-80.0) [-80.0|80.0] "m/s" ASDM
 SG_ FrntSideRdrRiDetn48RdrDetnSts : 411|2@0+ (1,0) [0|3] "" ASDM

CM_ SG_ 302 FrntSideRdrRiStsForDim "Front side right radar state information which will be shown on DIM or IHU";
CM_ SG_ 302 FrntSideRdrRiStsRdrNrDetn "Number of detections";
CM_ SG_ 302 FrntSideRdrRiStsRdrNrObj "Number of objects";
CM_ SG_ 302 FrntSideRdrRiStsRdrStsBlkd0bin "Blockage flag for 0bin";
CM_ SG_ 302 FrntSideRdrRiStsRdrStsBlkdConf "Confidence of radar blockage";
CM_ SG_ 302 FrntSideRdrRiStsRdrStsChks "Checksum";
CM_ SG_ 302 FrntSideRdrRiStsRdrStsCntr "Counter";
CM_ SG_ 302 FrntSideRdrRiStsRdrStsDstbc "Indication of radar interference, 0 means no interference, 100 means the radar fully saturated from interference";
CM_ SG_ 302 FrntSideRdrRiStsRdrStsEna "Indication whether radar functionality is enabled";
CM_ SG_ 302 FrntSideRdrRiStsRdrStsFaulty "Indication whether radar is faulty";
CM_ SG_ 302 FrntSideRdrRiStsRdrStsIfVersMajor "Interface version major";
CM_ SG_ 302 FrntSideRdrRiStsRdrStsIfVersMinor "Interface version major";
CM_ SG_ 302 FrntSideRdrRiStsRdrStsLatency "The latency definition is the time instance starting from the end of the last measurement acquisition per cycle to the CAN-FD frames being outputted on the CAN-FD bus. The unit of latency is ms.";
CM_ SG_ 302 FrntSideRdrRiStsRdrStsMisAlign "0, calibration not start. 1, successfully calibrated in factory or after-sales. 2, successfully auto-calibrated. 3, misalignment degree is larger than threshold, static calibration fail. 4, can not be calibrated statically cause other reason. 5, auto-calibrate fail (cause the misalignment degree is larger than threshold or other reason). 6, misalignment degree is larger than threshold, dynamic calibration fail in factory or after-sales. 7, can not be calibrated dynamically cause other reason.";
CM_ SG_ 302 FrntSideRdrRiStsRdrStsMissCom "Signal used to detect missing communication from radar. Reserved";
CM_ SG_ 302 FrntSideRdrRiStsRdrStsSftyFlt "Safety faulty status";
CM_ SG_ 302 FrntSideRdrRiStsRdrStsTiStamp "Timestamp";
CM_ SG_ 302 FrntSideRdrRiStsRdrStsTiStampStsGlbTiBas "Time synchronization status - synchronized to global time base";
CM_ SG_ 302 FrntSideRdrRiStsRdrStsTiStampStsSyncToGatewy "Time synchronization status - synchronized to gateway";
CM_ SG_ 302 FrntSideRdrRiStsRdrStsTiStampStsTiLeap "Time synchronization status - time leap";
CM_ SG_ 302 FrntSideRdrRiStsRdrStsTiStampStsTiOut "Time synchronization status - time out";
CM_ SG_ 302 FrntSideRdrRiStsRdrStsWhlSpdCmpFac "reserved, not use";
CM_ SG_ 305 FrntSideRdrRiDetn1RdrDetnAzi "Azimuth Angle";
CM_ SG_ 305 FrntSideRdrRiDetn1RdrDetnChks "CRC";
CM_ SG_ 305 FrntSideRdrRiDetn1RdrDetnCntr "Counter";
CM_ SG_ 305 FrntSideRdrRiDetn1RdrDetnConf "Quality";
CM_ SG_ 305 FrntSideRdrRiDetn1RdrDetnElevn "Elevation Angle";
CM_ SG_ 305 FrntSideRdrRiDetn1RdrDetnPwr "Signal noise ratio";
CM_ SG_ 305 FrntSideRdrRiDetn1RdrDetnRng "Range";
CM_ SG_ 305 FrntSideRdrRiDetn1RdrDetnRngV "Range Velocity";
CM_ SG_ 305 FrntSideRdrRiDetn1RdrDetnSts "Detection type";
CM_ SG_ 305 FrntSideRdrRiDetn2RdrDetnAzi "Refer to the data element description in FrntSideRdrLeDetn1 with the same data element name.";
CM_ SG_ 305 FrntSideRdrRiDetn2RdrDetnChks "Refer to the data element description in FrntSideRdrLeDetn1 with the same data element name.";
CM_ SG_ 305 FrntSideRdrRiDetn2RdrDetnCntr "Refer to the data element description in FrntSideRdrLeDetn1 with the same data element name.";
CM_ SG_ 305 FrntSideRdrRiDetn2RdrDetnConf "Refer to the data element description in FrntSideRdrLeDetn1 with the same data element name.";
CM_ SG_ 305 FrntSideRdrRiDetn2RdrDetnElevn "Refer to the data element description in FrntSideRdrLeDetn1 with the same data element name.";
CM_ SG_ 305 FrntSideRdrRiDetn2RdrDetnPwr "Refer to the data element description in FrntSideRdrLeDetn1 with the same data element name.";
CM_ SG_ 305 FrntSideRdrRiDetn2RdrDetnRng "Refer to the data element description in FrntSideRdrLeDetn1 with the same data element name.";
CM_ SG_ 305 FrntSideRdrRiDetn2RdrDetnRngV "Range Velocity";
CM_ SG_ 305 FrntSideRdrRiDetn2RdrDetnSts "Refer to the data element description in FrntSideRdrLeDetn1 with the same data element name.";
CM_ SG_ 305 FrntSideRdrRiDetn3RdrDetnAzi "Refer to the data element description in FrntSideRdrLeDetn1 with the same data element name.";
CM_ SG_ 305 FrntSideRdrRiDetn3RdrDetnChks "Refer to the data element description in FrntSideRdrLeDetn1 with the same data element name.";
CM_ SG_ 305 FrntSideRdrRiDetn3RdrDetnCntr "Refer to the data element description in FrntSideRdrLeDetn1 with the same data element name.";
CM_ SG_ 305 FrntSideRdrRiDetn3RdrDetnConf "Refer to the data element description in FrntSideRdrLeDetn1 with the same data element name.";
CM_ SG_ 305 FrntSideRdrRiDetn3RdrDetnElevn "Refer to the data element description in FrntSideRdrLeDetn1 with the same data element name.";
CM_ SG_ 305 FrntSideRdrRiDetn3RdrDetnPwr "Refer to the data element description in FrntSideRdrLeDetn1 with the same data element name.";
CM_ SG_ 305 FrntSideRdrRiDetn3RdrDetnRng "Refer to the data element description in FrntSideRdrLeDetn1 with the same data element name.";
CM_ SG_ 305 FrntSideRdrRiDetn3RdrDetnRngV "Range Velocity";
CM_ SG_ 305 FrntSideRdrRiDetn3RdrDetnSts "Refer to the data element description in FrntSideRdrLeDetn1 with the same data element name.";
CM_ SG_ 305 FrntSideRdrRiDetn4RdrDetnAzi "Refer to the data element description in FrntSideRdrLeDetn1 with the same data element name.";
CM_ SG_ 305 FrntSideRdrRiDetn4RdrDetnChks "Refer to the data element description in FrntSideRdrLeDetn1 with the same data element name.";
CM_ SG_ 305 FrntSideRdrRiDetn4RdrDetnCntr "Refer to the data element description in FrntSideRdrLeDetn1 with the same data element name.";
CM_ SG_ 305 FrntSideRdrRiDetn4RdrDetnConf "Refer to the data element description in FrntSideRdrLeDetn1 with the same data element name.";
CM_ SG_ 305 FrntSideRdrRiDetn4RdrDetnElevn "Refer to the data element description in FrntSideRdrLeDetn1 with the same data element name.";
CM_ SG_ 305 FrntSideRdrRiDetn4RdrDetnPwr "Refer to the data element description in FrntSideRdrLeDetn1 with the same data element name.";
CM_ SG_ 305 FrntSideRdrRiDetn4RdrDetnRng "Refer to the data element description in FrntSideRdrLeDetn1 with the same data element name.";
CM_ SG_ 305 FrntSideRdrRiDetn4RdrDetnRngV "Range Velocity";
CM_ SG_ 305 FrntSideRdrRiDetn4RdrDetnSts "Refer to the data element description in FrntSideRdrLeDetn1 with the same data element name.";
CM_ SG_ 305 FrntSideRdrRiDetn5RdrDetnAzi "Refer to the data element description in FrntSideRdrLeDetn1 with the same data element name.";
CM_ SG_ 305 FrntSideRdrRiDetn5RdrDetnChks "Refer to the data element description in FrntSideRdrLeDetn1 with the same data element name.";
CM_ SG_ 305 FrntSideRdrRiDetn5RdrDetnCntr "Refer to the data element description in FrntSideRdrLeDetn1 with the same data element name.";
CM_ SG_ 305 FrntSideRdrRiDetn5RdrDetnConf "Refer to the data element description in FrntSideRdrLeDetn1 with the same data element name.";
CM_ SG_ 305 FrntSideRdrRiDetn5RdrDetnElevn "Refer to the data element description in FrntSideRdrLeDetn1 with the same data element name.";
CM_ SG_ 305 FrntSideRdrRiDetn5RdrDetnPwr "Refer to the data element description in FrntSideRdrLeDetn1 with the same data element name.";
CM_ SG_ 305 FrntSideRdrRiDetn5RdrDetnRng "Refer to the data element description in FrntSideRdrLeDetn1 with the same data element name.";
CM_ SG_ 305 FrntSideRdrRiDetn5RdrDetnRngV "Range Velocity";
CM_ SG_ 305 FrntSideRdrRiDetn5RdrDetnSts "Refer to the data element description in FrntSideRdrLeDetn1 with the same data element name.";
CM_ SG_ 305 FrntSideRdrRiDetn6RdrDetnAzi "Refer to the data element description in FrntSideRdrLeDetn1 with the same data element name.";
CM_ SG_ 305 FrntSideRdrRiDetn6RdrDetnChks "Refer to the data element description in FrntSideRdrLeDetn1 with the same data element name.";
CM_ SG_ 305 FrntSideRdrRiDetn6RdrDetnCntr "Refer to the data element description in FrntSideRdrLeDetn1 with the same data element name.";
CM_ SG_ 305 FrntSideRdrRiDetn6RdrDetnConf "Refer to the data element description in FrntSideRdrLeDetn1 with the same data element name.";
CM_ SG_ 305 FrntSideRdrRiDetn6RdrDetnElevn "Refer to the data element description in FrntSideRdrLeDetn1 with the same data element name.";
CM_ SG_ 305 FrntSideRdrRiDetn6RdrDetnPwr "Refer to the data element description in FrntSideRdrLeDetn1 with the same data element name.";
CM_ SG_ 305 FrntSideRdrRiDetn6RdrDetnRng "Refer to the data element description in FrntSideRdrLeDetn1 with the same data element name.";
CM_ SG_ 305 FrntSideRdrRiDetn6RdrDetnRngV "Range Velocity";
CM_ SG_ 305 FrntSideRdrRiDetn6RdrDetnSts "Refer to the data element description in FrntSideRdrLeDetn1 with the same data element name.";
CM_ SG_ 307 FrntSideRdrRiDetn10RdrDetnAzi "Refer to the data element description in FrntSideRdrLeDetn1 with the same data element name.";
CM_ SG_ 307 FrntSideRdrRiDetn10RdrDetnChks "Refer to the data element description in FrntSideRdrLeDetn1 with the same data element name.";
CM_ SG_ 307 FrntSideRdrRiDetn10RdrDetnCntr "Refer to the data element description in FrntSideRdrLeDetn1 with the same data element name.";
CM_ SG_ 307 FrntSideRdrRiDetn10RdrDetnConf "Refer to the data element description in FrntSideRdrLeDetn1 with the same data element name.";
CM_ SG_ 307 FrntSideRdrRiDetn10RdrDetnElevn "Refer to the data element description in FrntSideRdrLeDetn1 with the same data element name.";
CM_ SG_ 307 FrntSideRdrRiDetn10RdrDetnPwr "Refer to the data element description in FrntSideRdrLeDetn1 with the same data element name.";
CM_ SG_ 307 FrntSideRdrRiDetn10RdrDetnRng "Refer to the data element description in FrntSideRdrLeDetn1 with the same data element name.";
CM_ SG_ 307 FrntSideRdrRiDetn10RdrDetnRngV "Range Velocity";
CM_ SG_ 307 FrntSideRdrRiDetn10RdrDetnSts "Refer to the data element description in FrntSideRdrLeDetn1 with the same data element name.";
CM_ SG_ 307 FrntSideRdrRiDetn11RdrDetnAzi "Refer to the data element description in FrntSideRdrLeDetn1 with the same data element name.";
CM_ SG_ 307 FrntSideRdrRiDetn11RdrDetnChks "Refer to the data element description in FrntSideRdrLeDetn1 with the same data element name.";
CM_ SG_ 307 FrntSideRdrRiDetn11RdrDetnCntr "Refer to the data element description in FrntSideRdrLeDetn1 with the same data element name.";
CM_ SG_ 307 FrntSideRdrRiDetn11RdrDetnConf "Refer to the data element description in FrntSideRdrLeDetn1 with the same data element name.";
CM_ SG_ 307 FrntSideRdrRiDetn11RdrDetnElevn "Refer to the data element description in FrntSideRdrLeDetn1 with the same data element name.";
CM_ SG_ 307 FrntSideRdrRiDetn11RdrDetnPwr "Refer to the data element description in FrntSideRdrLeDetn1 with the same data element name.";
CM_ SG_ 307 FrntSideRdrRiDetn11RdrDetnRng "Refer to the data element description in FrntSideRdrLeDetn1 with the same data element name.";
CM_ SG_ 307 FrntSideRdrRiDetn11RdrDetnRngV "Range Velocity
";
CM_ SG_ 307 FrntSideRdrRiDetn11RdrDetnSts "Refer to the data element description in FrntSideRdrLeDetn1 with the same data element name.";
CM_ SG_ 307 FrntSideRdrRiDetn12RdrDetnAzi "Refer to the data element description in FrntSideRdrLeDetn1 with the same data element name.";
CM_ SG_ 307 FrntSideRdrRiDetn12RdrDetnChks "Refer to the data element description in FrntSideRdrLeDetn1 with the same data element name.";
CM_ SG_ 307 FrntSideRdrRiDetn12RdrDetnCntr "Refer to the data element description in FrntSideRdrLeDetn1 with the same data element name.";
CM_ SG_ 307 FrntSideRdrRiDetn12RdrDetnConf "Refer to the data element description in FrntSideRdrLeDetn1 with the same data element name.";
CM_ SG_ 307 FrntSideRdrRiDetn12RdrDetnElevn "Refer to the data element description in FrntSideRdrLeDetn1 with the same data element name.";
CM_ SG_ 307 FrntSideRdrRiDetn12RdrDetnPwr "Refer to the data element description in FrntSideRdrLeDetn1 with the same data element name.";
CM_ SG_ 307 FrntSideRdrRiDetn12RdrDetnRng "Refer to the data element description in FrntSideRdrLeDetn1 with the same data element name.";
CM_ SG_ 307 FrntSideRdrRiDetn12RdrDetnRngV "Range Velocity";
CM_ SG_ 307 FrntSideRdrRiDetn12RdrDetnSts "Refer to the data element description in FrntSideRdrLeDetn1 with the same data element name.";
CM_ SG_ 307 FrntSideRdrRiDetn7RdrDetnAzi "Refer to the data element description in FrntSideRdrLeDetn1 with the same data element name.";
CM_ SG_ 307 FrntSideRdrRiDetn7RdrDetnChks "Refer to the data element description in FrntSideRdrLeDetn1 with the same data element name.";
CM_ SG_ 307 FrntSideRdrRiDetn7RdrDetnCntr "Refer to the data element description in FrntSideRdrLeDetn1 with the same data element name.";
CM_ SG_ 307 FrntSideRdrRiDetn7RdrDetnConf "Refer to the data element description in FrntSideRdrLeDetn1 with the same data element name.";
CM_ SG_ 307 FrntSideRdrRiDetn7RdrDetnElevn "Refer to the data element description in FrntSideRdrLeDetn1 with the same data element name.";
CM_ SG_ 307 FrntSideRdrRiDetn7RdrDetnPwr "Refer to the data element description in FrntSideRdrLeDetn1 with the same data element name.";
CM_ SG_ 307 FrntSideRdrRiDetn7RdrDetnRng "Refer to the data element description in FrntSideRdrLeDetn1 with the same data element name.";
CM_ SG_ 307 FrntSideRdrRiDetn7RdrDetnRngV "Range Velocity";
CM_ SG_ 307 FrntSideRdrRiDetn7RdrDetnSts "Refer to the data element description in FrntSideRdrLeDetn1 with the same data element name.";
CM_ SG_ 307 FrntSideRdrRiDetn8RdrDetnAzi "Refer to the data element description in FrntSideRdrLeDetn1 with the same data element name.";
CM_ SG_ 307 FrntSideRdrRiDetn8RdrDetnChks "Refer to the data element description in FrntSideRdrLeDetn1 with the same data element name.";
CM_ SG_ 307 FrntSideRdrRiDetn8RdrDetnCntr "Refer to the data element description in FrntSideRdrLeDetn1 with the same data element name.";
CM_ SG_ 307 FrntSideRdrRiDetn8RdrDetnConf "Refer to the data element description in FrntSideRdrLeDetn1 with the same data element name.";
CM_ SG_ 307 FrntSideRdrRiDetn8RdrDetnElevn "Refer to the data element description in FrntSideRdrLeDetn1 with the same data element name.";
CM_ SG_ 307 FrntSideRdrRiDetn8RdrDetnPwr "Refer to the data element description in FrntSideRdrLeDetn1 with the same data element name.";
CM_ SG_ 307 FrntSideRdrRiDetn8RdrDetnRng "Refer to the data element description in FrntSideRdrLeDetn1 with the same data element name.";
CM_ SG_ 307 FrntSideRdrRiDetn8RdrDetnRngV "Range Velocity";
CM_ SG_ 307 FrntSideRdrRiDetn8RdrDetnSts "Refer to the data element description in FrntSideRdrLeDetn1 with the same data element name.";
CM_ SG_ 307 FrntSideRdrRiDetn9RdrDetnAzi "Refer to the data element description in FrntSideRdrLeDetn1 with the same data element name.";
CM_ SG_ 307 FrntSideRdrRiDetn9RdrDetnChks "Refer to the data element description in FrntSideRdrLeDetn1 with the same data element name.";
CM_ SG_ 307 FrntSideRdrRiDetn9RdrDetnCntr "Refer to the data element description in FrntSideRdrLeDetn1 with the same data element name.";
CM_ SG_ 307 FrntSideRdrRiDetn9RdrDetnConf "Refer to the data element description in FrntSideRdrLeDetn1 with the same data element name.";
CM_ SG_ 307 FrntSideRdrRiDetn9RdrDetnElevn "Refer to the data element description in FrntSideRdrLeDetn1 with the same data element name.";
CM_ SG_ 307 FrntSideRdrRiDetn9RdrDetnPwr "Refer to the data element description in FrntSideRdrLeDetn1 with the same data element name.";
CM_ SG_ 307 FrntSideRdrRiDetn9RdrDetnRng "Refer to the data element description in FrntSideRdrLeDetn1 with the same data element name.";
CM_ SG_ 307 FrntSideRdrRiDetn9RdrDetnRngV "Range Velocity";
CM_ SG_ 307 FrntSideRdrRiDetn9RdrDetnSts "Refer to the data element description in FrntSideRdrLeDetn1 with the same data element name.";
CM_ SG_ 309 FrntSideRdrRiDetn13RdrDetnAzi "Refer to the data element description in FrntSideRdrLeDetn1 with the same data element name.";
CM_ SG_ 309 FrntSideRdrRiDetn13RdrDetnChks "Refer to the data element description in FrntSideRdrLeDetn1 with the same data element name.";
CM_ SG_ 309 FrntSideRdrRiDetn13RdrDetnCntr "Refer to the data element description in FrntSideRdrLeDetn1 with the same data element name.";
CM_ SG_ 309 FrntSideRdrRiDetn13RdrDetnConf "Refer to the data element description in FrntSideRdrLeDetn1 with the same data element name.";
CM_ SG_ 309 FrntSideRdrRiDetn13RdrDetnElevn "Refer to the data element description in FrntSideRdrLeDetn1 with the same data element name.";
CM_ SG_ 309 FrntSideRdrRiDetn13RdrDetnPwr "Refer to the data element description in FrntSideRdrLeDetn1 with the same data element name.";
CM_ SG_ 309 FrntSideRdrRiDetn13RdrDetnRng "Refer to the data element description in FrntSideRdrLeDetn1 with the same data element name.";
CM_ SG_ 309 FrntSideRdrRiDetn13RdrDetnRngV "Range Velocity";
CM_ SG_ 309 FrntSideRdrRiDetn13RdrDetnSts "Refer to the data element description in FrntSideRdrLeDetn1 with the same data element name.";
CM_ SG_ 309 FrntSideRdrRiDetn14RdrDetnAzi "Refer to the data element description in FrntSideRdrLeDetn1 with the same data element name.";
CM_ SG_ 309 FrntSideRdrRiDetn14RdrDetnChks "Refer to the data element description in FrntSideRdrLeDetn1 with the same data element name.";
CM_ SG_ 309 FrntSideRdrRiDetn14RdrDetnCntr "Refer to the data element description in FrntSideRdrLeDetn1 with the same data element name.";
CM_ SG_ 309 FrntSideRdrRiDetn14RdrDetnConf "Refer to the data element description in FrntSideRdrLeDetn1 with the same data element name.";
CM_ SG_ 309 FrntSideRdrRiDetn14RdrDetnElevn "Refer to the data element description in FrntSideRdrLeDetn1 with the same data element name.";
CM_ SG_ 309 FrntSideRdrRiDetn14RdrDetnPwr "Refer to the data element description in FrntSideRdrLeDetn1 with the same data element name.";
CM_ SG_ 309 FrntSideRdrRiDetn14RdrDetnRng "Refer to the data element description in FrntSideRdrLeDetn1 with the same data element name.";
CM_ SG_ 309 FrntSideRdrRiDetn14RdrDetnRngV "Range Velocity";
CM_ SG_ 309 FrntSideRdrRiDetn14RdrDetnSts "Refer to the data element description in FrntSideRdrLeDetn1 with the same data element name.";
CM_ SG_ 309 FrntSideRdrRiDetn15RdrDetnAzi "Refer to the data element description in FrntSideRdrLeDetn1 with the same data element name.";
CM_ SG_ 309 FrntSideRdrRiDetn15RdrDetnChks "Refer to the data element description in FrntSideRdrLeDetn1 with the same data element name.";
CM_ SG_ 309 FrntSideRdrRiDetn15RdrDetnCntr "Refer to the data element description in FrntSideRdrLeDetn1 with the same data element name.";
CM_ SG_ 309 FrntSideRdrRiDetn15RdrDetnConf "Refer to the data element description in FrntSideRdrLeDetn1 with the same data element name.";
CM_ SG_ 309 FrntSideRdrRiDetn15RdrDetnElevn "Refer to the data element description in FrntSideRdrLeDetn1 with the same data element name.";
CM_ SG_ 309 FrntSideRdrRiDetn15RdrDetnPwr "Refer to the data element description in FrntSideRdrLeDetn1 with the same data element name.";
CM_ SG_ 309 FrntSideRdrRiDetn15RdrDetnRng "Refer to the data element description in FrntSideRdrLeDetn1 with the same data element name.";
CM_ SG_ 309 FrntSideRdrRiDetn15RdrDetnRngV "Range Velocity";
CM_ SG_ 309 FrntSideRdrRiDetn15RdrDetnSts "Refer to the data element description in FrntSideRdrLeDetn1 with the same data element name.";
CM_ SG_ 309 FrntSideRdrRiDetn16RdrDetnAzi "Refer to the data element description in FrntSideRdrLeDetn1 with the same data element name.";
CM_ SG_ 309 FrntSideRdrRiDetn16RdrDetnChks "Refer to the data element description in FrntSideRdrLeDetn1 with the same data element name.";
CM_ SG_ 309 FrntSideRdrRiDetn16RdrDetnCntr "Refer to the data element description in FrntSideRdrLeDetn1 with the same data element name.";
CM_ SG_ 309 FrntSideRdrRiDetn16RdrDetnConf "Refer to the data element description in FrntSideRdrLeDetn1 with the same data element name.";
CM_ SG_ 309 FrntSideRdrRiDetn16RdrDetnElevn "Refer to the data element description in FrntSideRdrLeDetn1 with the same data element name.";
CM_ SG_ 309 FrntSideRdrRiDetn16RdrDetnPwr "Refer to the data element description in FrntSideRdrLeDetn1 with the same data element name.";
CM_ SG_ 309 FrntSideRdrRiDetn16RdrDetnRng "Refer to the data element description in FrntSideRdrLeDetn1 with the same data element name.";
CM_ SG_ 309 FrntSideRdrRiDetn16RdrDetnRngV "Range Velocity";
CM_ SG_ 309 FrntSideRdrRiDetn16RdrDetnSts "Refer to the data element description in FrntSideRdrLeDetn1 with the same data element name.";
CM_ SG_ 309 FrntSideRdrRiDetn17RdrDetnAzi "Refer to the data element description in FrntSideRdrLeDetn1 with the same data element name.";
CM_ SG_ 309 FrntSideRdrRiDetn17RdrDetnChks "Refer to the data element description in FrntSideRdrLeDetn1 with the same data element name.";
CM_ SG_ 309 FrntSideRdrRiDetn17RdrDetnCntr "Refer to the data element description in FrntSideRdrLeDetn1 with the same data element name.";
CM_ SG_ 309 FrntSideRdrRiDetn17RdrDetnConf "Refer to the data element description in FrntSideRdrLeDetn1 with the same data element name.";
CM_ SG_ 309 FrntSideRdrRiDetn17RdrDetnElevn "Refer to the data element description in FrntSideRdrLeDetn1 with the same data element name.";
CM_ SG_ 309 FrntSideRdrRiDetn17RdrDetnPwr "Refer to the data element description in FrntSideRdrLeDetn1 with the same data element name.";
CM_ SG_ 309 FrntSideRdrRiDetn17RdrDetnRng "Refer to the data element description in FrntSideRdrLeDetn1 with the same data element name.";
CM_ SG_ 309 FrntSideRdrRiDetn17RdrDetnRngV "Range Velocity";
CM_ SG_ 309 FrntSideRdrRiDetn17RdrDetnSts "Refer to the data element description in FrntSideRdrLeDetn1 with the same data element name.";
CM_ SG_ 309 FrntSideRdrRiDetn18RdrDetnAzi "Refer to the data element description in FrntSideRdrLeDetn1 with the same data element name.";
CM_ SG_ 309 FrntSideRdrRiDetn18RdrDetnChks "Refer to the data element description in FrntSideRdrLeDetn1 with the same data element name.";
CM_ SG_ 309 FrntSideRdrRiDetn18RdrDetnCntr "Refer to the data element description in FrntSideRdrLeDetn1 with the same data element name.";
CM_ SG_ 309 FrntSideRdrRiDetn18RdrDetnConf "Refer to the data element description in FrntSideRdrLeDetn1 with the same data element name.";
CM_ SG_ 309 FrntSideRdrRiDetn18RdrDetnElevn "Refer to the data element description in FrntSideRdrLeDetn1 with the same data element name.";
CM_ SG_ 309 FrntSideRdrRiDetn18RdrDetnPwr "Refer to the data element description in FrntSideRdrLeDetn1 with the same data element name.";
CM_ SG_ 309 FrntSideRdrRiDetn18RdrDetnRng "Refer to the data element description in FrntSideRdrLeDetn1 with the same data element name.";
CM_ SG_ 309 FrntSideRdrRiDetn18RdrDetnRngV "Range Velocity";
CM_ SG_ 309 FrntSideRdrRiDetn18RdrDetnSts "Refer to the data element description in FrntSideRdrLeDetn1 with the same data element name.";
CM_ SG_ 311 FrntSideRdrRiDetn19RdrDetnAzi "Refer to the data element description in FrntSideRdrLeDetn1 with the same data element name.";
CM_ SG_ 311 FrntSideRdrRiDetn19RdrDetnChks "Refer to the data element description in FrntSideRdrLeDetn1 with the same data element name.";
CM_ SG_ 311 FrntSideRdrRiDetn19RdrDetnCntr "Refer to the data element description in FrntSideRdrLeDetn1 with the same data element name.";
CM_ SG_ 311 FrntSideRdrRiDetn19RdrDetnConf "Refer to the data element description in FrntSideRdrLeDetn1 with the same data element name.";
CM_ SG_ 311 FrntSideRdrRiDetn19RdrDetnElevn "Refer to the data element description in FrntSideRdrLeDetn1 with the same data element name.";
CM_ SG_ 311 FrntSideRdrRiDetn19RdrDetnPwr "Refer to the data element description in FrntSideRdrLeDetn1 with the same data element name.";
CM_ SG_ 311 FrntSideRdrRiDetn19RdrDetnRng "Refer to the data element description in FrntSideRdrLeDetn1 with the same data element name.";
CM_ SG_ 311 FrntSideRdrRiDetn19RdrDetnRngV "Range Velocity";
CM_ SG_ 311 FrntSideRdrRiDetn19RdrDetnSts "Refer to the data element description in FrntSideRdrLeDetn1 with the same data element name.";
CM_ SG_ 311 FrntSideRdrRiDetn20RdrDetnAzi "Refer to the data element description in FrntSideRdrLeDetn1 with the same data element name.";
CM_ SG_ 311 FrntSideRdrRiDetn20RdrDetnChks "Refer to the data element description in FrntSideRdrLeDetn1 with the same data element name.";
CM_ SG_ 311 FrntSideRdrRiDetn20RdrDetnCntr "Refer to the data element description in FrntSideRdrLeDetn1 with the same data element name.";
CM_ SG_ 311 FrntSideRdrRiDetn20RdrDetnConf "Refer to the data element description in FrntSideRdrLeDetn1 with the same data element name.";
CM_ SG_ 311 FrntSideRdrRiDetn20RdrDetnElevn "Refer to the data element description in FrntSideRdrLeDetn1 with the same data element name.";
CM_ SG_ 311 FrntSideRdrRiDetn20RdrDetnPwr "Refer to the data element description in FrntSideRdrLeDetn1 with the same data element name.";
CM_ SG_ 311 FrntSideRdrRiDetn20RdrDetnRng "Refer to the data element description in FrntSideRdrLeDetn1 with the same data element name.";
CM_ SG_ 311 FrntSideRdrRiDetn20RdrDetnRngV "Range Velocity";
CM_ SG_ 311 FrntSideRdrRiDetn20RdrDetnSts "Refer to the data element description in FrntSideRdrLeDetn1 with the same data element name.";
CM_ SG_ 311 FrntSideRdrRiDetn21RdrDetnAzi "Refer to the data element description in FrntSideRdrLeDetn1 with the same data element name.";
CM_ SG_ 311 FrntSideRdrRiDetn21RdrDetnChks "Refer to the data element description in FrntSideRdrLeDetn1 with the same data element name.";
CM_ SG_ 311 FrntSideRdrRiDetn21RdrDetnCntr "Refer to the data element description in FrntSideRdrLeDetn1 with the same data element name.";
CM_ SG_ 311 FrntSideRdrRiDetn21RdrDetnConf "Refer to the data element description in FrntSideRdrLeDetn1 with the same data element name.";
CM_ SG_ 311 FrntSideRdrRiDetn21RdrDetnElevn "Refer to the data element description in FrntSideRdrLeDetn1 with the same data element name.";
CM_ SG_ 311 FrntSideRdrRiDetn21RdrDetnPwr "Refer to the data element description in FrntSideRdrLeDetn1 with the same data element name.";
CM_ SG_ 311 FrntSideRdrRiDetn21RdrDetnRng "Refer to the data element description in FrntSideRdrLeDetn1 with the same data element name.";
CM_ SG_ 311 FrntSideRdrRiDetn21RdrDetnRngV "Range Velocity";
CM_ SG_ 311 FrntSideRdrRiDetn21RdrDetnSts "Refer to the data element description in FrntSideRdrLeDetn1 with the same data element name.";
CM_ SG_ 311 FrntSideRdrRiDetn22RdrDetnAzi "Refer to the data element description in FrntSideRdrLeDetn1 with the same data element name.";
CM_ SG_ 311 FrntSideRdrRiDetn22RdrDetnChks "Refer to the data element description in FrntSideRdrLeDetn1 with the same data element name.";
CM_ SG_ 311 FrntSideRdrRiDetn22RdrDetnCntr "Refer to the data element description in FrntSideRdrLeDetn1 with the same data element name.";
CM_ SG_ 311 FrntSideRdrRiDetn22RdrDetnConf "Refer to the data element description in FrntSideRdrLeDetn1 with the same data element name.";
CM_ SG_ 311 FrntSideRdrRiDetn22RdrDetnElevn "Refer to the data element description in FrntSideRdrLeDetn1 with the same data element name.";
CM_ SG_ 311 FrntSideRdrRiDetn22RdrDetnPwr "Refer to the data element description in FrntSideRdrLeDetn1 with the same data element name.";
CM_ SG_ 311 FrntSideRdrRiDetn22RdrDetnRng "Refer to the data element description in FrntSideRdrLeDetn1 with the same data element name.";
CM_ SG_ 311 FrntSideRdrRiDetn22RdrDetnRngV "Range Velocity";
CM_ SG_ 311 FrntSideRdrRiDetn22RdrDetnSts "Refer to the data element description in FrntSideRdrLeDetn1 with the same data element name.";
CM_ SG_ 311 FrntSideRdrRiDetn23RdrDetnAzi "Refer to the data element description in FrntSideRdrLeDetn1 with the same data element name.";
CM_ SG_ 311 FrntSideRdrRiDetn23RdrDetnChks "Refer to the data element description in FrntSideRdrLeDetn1 with the same data element name.";
CM_ SG_ 311 FrntSideRdrRiDetn23RdrDetnCntr "Refer to the data element description in FrntSideRdrLeDetn1 with the same data element name.";
CM_ SG_ 311 FrntSideRdrRiDetn23RdrDetnConf "Refer to the data element description in FrntSideRdrLeDetn1 with the same data element name.";
CM_ SG_ 311 FrntSideRdrRiDetn23RdrDetnElevn "Refer to the data element description in FrntSideRdrLeDetn1 with the same data element name.";
CM_ SG_ 311 FrntSideRdrRiDetn23RdrDetnPwr "Refer to the data element description in FrntSideRdrLeDetn1 with the same data element name.";
CM_ SG_ 311 FrntSideRdrRiDetn23RdrDetnRng "Refer to the data element description in FrntSideRdrLeDetn1 with the same data element name.";
CM_ SG_ 311 FrntSideRdrRiDetn23RdrDetnRngV "Range Velocity
";
CM_ SG_ 311 FrntSideRdrRiDetn23RdrDetnSts "Refer to the data element description in FrntSideRdrLeDetn1 with the same data element name.";
CM_ SG_ 311 FrntSideRdrRiDetn24RdrDetnAzi "Refer to the data element description in FrntSideRdrLeDetn1 with the same data element name.";
CM_ SG_ 311 FrntSideRdrRiDetn24RdrDetnChks "Refer to the data element description in FrntSideRdrLeDetn1 with the same data element name.";
CM_ SG_ 311 FrntSideRdrRiDetn24RdrDetnCntr "Refer to the data element description in FrntSideRdrLeDetn1 with the same data element name.";
CM_ SG_ 311 FrntSideRdrRiDetn24RdrDetnConf "Refer to the data element description in FrntSideRdrLeDetn1 with the same data element name.";
CM_ SG_ 311 FrntSideRdrRiDetn24RdrDetnElevn "Refer to the data element description in FrntSideRdrLeDetn1 with the same data element name.";
CM_ SG_ 311 FrntSideRdrRiDetn24RdrDetnPwr "Refer to the data element description in FrntSideRdrLeDetn1 with the same data element name.";
CM_ SG_ 311 FrntSideRdrRiDetn24RdrDetnRng "Refer to the data element description in FrntSideRdrLeDetn1 with the same data element name.";
CM_ SG_ 311 FrntSideRdrRiDetn24RdrDetnRngV "Range Velocity";
CM_ SG_ 311 FrntSideRdrRiDetn24RdrDetnSts "Refer to the data element description in FrntSideRdrLeDetn1 with the same data element name.";
CM_ SG_ 313 FrntSideRdrRiDetn25RdrDetnAzi "Refer to the data element description in FrntSideRdrLeDetn1 with the same data element name.";
CM_ SG_ 313 FrntSideRdrRiDetn25RdrDetnChks "Refer to the data element description in FrntSideRdrLeDetn1 with the same data element name.";
CM_ SG_ 313 FrntSideRdrRiDetn25RdrDetnCntr "Refer to the data element description in FrntSideRdrLeDetn1 with the same data element name.";
CM_ SG_ 313 FrntSideRdrRiDetn25RdrDetnConf "Refer to the data element description in FrntSideRdrLeDetn1 with the same data element name.";
CM_ SG_ 313 FrntSideRdrRiDetn25RdrDetnElevn "Refer to the data element description in FrntSideRdrLeDetn1 with the same data element name.";
CM_ SG_ 313 FrntSideRdrRiDetn25RdrDetnPwr "Refer to the data element description in FrntSideRdrLeDetn1 with the same data element name.";
CM_ SG_ 313 FrntSideRdrRiDetn25RdrDetnRng "Refer to the data element description in FrntSideRdrLeDetn1 with the same data element name.";
CM_ SG_ 313 FrntSideRdrRiDetn25RdrDetnRngV "Range Velocity";
CM_ SG_ 313 FrntSideRdrRiDetn25RdrDetnSts "Refer to the data element description in FrntSideRdrLeDetn1 with the same data element name.";
CM_ SG_ 313 FrntSideRdrRiDetn26RdrDetnAzi "Refer to the data element description in FrntSideRdrLeDetn1 with the same data element name.";
CM_ SG_ 313 FrntSideRdrRiDetn26RdrDetnChks "Refer to the data element description in FrntSideRdrLeDetn1 with the same data element name.";
CM_ SG_ 313 FrntSideRdrRiDetn26RdrDetnCntr "Refer to the data element description in FrntSideRdrLeDetn1 with the same data element name.";
CM_ SG_ 313 FrntSideRdrRiDetn26RdrDetnConf "Refer to the data element description in FrntSideRdrLeDetn1 with the same data element name.";
CM_ SG_ 313 FrntSideRdrRiDetn26RdrDetnElevn "Refer to the data element description in FrntSideRdrLeDetn1 with the same data element name.";
CM_ SG_ 313 FrntSideRdrRiDetn26RdrDetnPwr "Refer to the data element description in FrntSideRdrLeDetn1 with the same data element name.";
CM_ SG_ 313 FrntSideRdrRiDetn26RdrDetnRng "Refer to the data element description in FrntSideRdrLeDetn1 with the same data element name.";
CM_ SG_ 313 FrntSideRdrRiDetn26RdrDetnRngV "Range Velocity";
CM_ SG_ 313 FrntSideRdrRiDetn26RdrDetnSts "Refer to the data element description in FrntSideRdrLeDetn1 with the same data element name.";
CM_ SG_ 313 FrntSideRdrRiDetn27RdrDetnAzi "Refer to the data element description in FrntSideRdrLeDetn1 with the same data element name.";
CM_ SG_ 313 FrntSideRdrRiDetn27RdrDetnChks "Refer to the data element description in FrntSideRdrLeDetn1 with the same data element name.";
CM_ SG_ 313 FrntSideRdrRiDetn27RdrDetnCntr "Refer to the data element description in FrntSideRdrLeDetn1 with the same data element name.";
CM_ SG_ 313 FrntSideRdrRiDetn27RdrDetnConf "Refer to the data element description in FrntSideRdrLeDetn1 with the same data element name.";
CM_ SG_ 313 FrntSideRdrRiDetn27RdrDetnElevn "Refer to the data element description in FrntSideRdrLeDetn1 with the same data element name.";
CM_ SG_ 313 FrntSideRdrRiDetn27RdrDetnPwr "Refer to the data element description in FrntSideRdrLeDetn1 with the same data element name.";
CM_ SG_ 313 FrntSideRdrRiDetn27RdrDetnRng "Refer to the data element description in FrntSideRdrLeDetn1 with the same data element name.";
CM_ SG_ 313 FrntSideRdrRiDetn27RdrDetnRngV "Range Velocity";
CM_ SG_ 313 FrntSideRdrRiDetn27RdrDetnSts "Refer to the data element description in FrntSideRdrLeDetn1 with the same data element name.";
CM_ SG_ 313 FrntSideRdrRiDetn28RdrDetnAzi "Refer to the data element description in FrntSideRdrLeDetn1 with the same data element name.";
CM_ SG_ 313 FrntSideRdrRiDetn28RdrDetnChks "Refer to the data element description in FrntSideRdrLeDetn1 with the same data element name.";
CM_ SG_ 313 FrntSideRdrRiDetn28RdrDetnCntr "Refer to the data element description in FrntSideRdrLeDetn1 with the same data element name.";
CM_ SG_ 313 FrntSideRdrRiDetn28RdrDetnConf "Refer to the data element description in FrntSideRdrLeDetn1 with the same data element name.";
CM_ SG_ 313 FrntSideRdrRiDetn28RdrDetnElevn "Refer to the data element description in FrntSideRdrLeDetn1 with the same data element name.";
CM_ SG_ 313 FrntSideRdrRiDetn28RdrDetnPwr "Refer to the data element description in FrntSideRdrLeDetn1 with the same data element name.";
CM_ SG_ 313 FrntSideRdrRiDetn28RdrDetnRng "Refer to the data element description in FrntSideRdrLeDetn1 with the same data element name.";
CM_ SG_ 313 FrntSideRdrRiDetn28RdrDetnRngV "Range Velocity";
CM_ SG_ 313 FrntSideRdrRiDetn28RdrDetnSts "Refer to the data element description in FrntSideRdrLeDetn1 with the same data element name.";
CM_ SG_ 313 FrntSideRdrRiDetn29RdrDetnAzi "Refer to the data element description in FrntSideRdrLeDetn1 with the same data element name.";
CM_ SG_ 313 FrntSideRdrRiDetn29RdrDetnChks "Refer to the data element description in FrntSideRdrLeDetn1 with the same data element name.";
CM_ SG_ 313 FrntSideRdrRiDetn29RdrDetnCntr "Refer to the data element description in FrntSideRdrLeDetn1 with the same data element name.";
CM_ SG_ 313 FrntSideRdrRiDetn29RdrDetnConf "Refer to the data element description in FrntSideRdrLeDetn1 with the same data element name.";
CM_ SG_ 313 FrntSideRdrRiDetn29RdrDetnElevn "Refer to the data element description in FrntSideRdrLeDetn1 with the same data element name.";
CM_ SG_ 313 FrntSideRdrRiDetn29RdrDetnPwr "Refer to the data element description in FrntSideRdrLeDetn1 with the same data element name.";
CM_ SG_ 313 FrntSideRdrRiDetn29RdrDetnRng "Refer to the data element description in FrntSideRdrLeDetn1 with the same data element name.";
CM_ SG_ 313 FrntSideRdrRiDetn29RdrDetnRngV "Range Velocity";
CM_ SG_ 313 FrntSideRdrRiDetn29RdrDetnSts "Refer to the data element description in FrntSideRdrLeDetn1 with the same data element name.";
CM_ SG_ 313 FrntSideRdrRiDetn30RdrDetnAzi "Refer to the data element description in FrntSideRdrLeDetn1 with the same data element name.";
CM_ SG_ 313 FrntSideRdrRiDetn30RdrDetnChks "Refer to the data element description in FrntSideRdrLeDetn1 with the same data element name.";
CM_ SG_ 313 FrntSideRdrRiDetn30RdrDetnCntr "Refer to the data element description in FrntSideRdrLeDetn1 with the same data element name.";
CM_ SG_ 313 FrntSideRdrRiDetn30RdrDetnConf "Refer to the data element description in FrntSideRdrLeDetn1 with the same data element name.";
CM_ SG_ 313 FrntSideRdrRiDetn30RdrDetnElevn "Refer to the data element description in FrntSideRdrLeDetn1 with the same data element name.";
CM_ SG_ 313 FrntSideRdrRiDetn30RdrDetnPwr "Refer to the data element description in FrntSideRdrLeDetn1 with the same data element name.";
CM_ SG_ 313 FrntSideRdrRiDetn30RdrDetnRng "Refer to the data element description in FrntSideRdrLeDetn1 with the same data element name.";
CM_ SG_ 313 FrntSideRdrRiDetn30RdrDetnRngV "Range Velocity";
CM_ SG_ 313 FrntSideRdrRiDetn30RdrDetnSts "Refer to the data element description in FrntSideRdrLeDetn1 with the same data element name.";
CM_ SG_ 315 FrntSideRdrRiDetn31RdrDetnAzi "Refer to the data element description in FrntSideRdrLeDetn1 with the same data element name.";
CM_ SG_ 315 FrntSideRdrRiDetn31RdrDetnChks "Refer to the data element description in FrntSideRdrLeDetn1 with the same data element name.";
CM_ SG_ 315 FrntSideRdrRiDetn31RdrDetnCntr "Refer to the data element description in FrntSideRdrLeDetn1 with the same data element name.";
CM_ SG_ 315 FrntSideRdrRiDetn31RdrDetnConf "Refer to the data element description in FrntSideRdrLeDetn1 with the same data element name.";
CM_ SG_ 315 FrntSideRdrRiDetn31RdrDetnElevn "Refer to the data element description in FrntSideRdrLeDetn1 with the same data element name.";
CM_ SG_ 315 FrntSideRdrRiDetn31RdrDetnPwr "Refer to the data element description in FrntSideRdrLeDetn1 with the same data element name.";
CM_ SG_ 315 FrntSideRdrRiDetn31RdrDetnRng "Refer to the data element description in FrntSideRdrLeDetn1 with the same data element name.";
CM_ SG_ 315 FrntSideRdrRiDetn31RdrDetnRngV "Range Velocity";
CM_ SG_ 315 FrntSideRdrRiDetn31RdrDetnSts "Refer to the data element description in FrntSideRdrLeDetn1 with the same data element name.";
CM_ SG_ 315 FrntSideRdrRiDetn32RdrDetnAzi "Refer to the data element description in FrntSideRdrLeDetn1 with the same data element name.";
CM_ SG_ 315 FrntSideRdrRiDetn32RdrDetnChks "Refer to the data element description in FrntSideRdrLeDetn1 with the same data element name.";
CM_ SG_ 315 FrntSideRdrRiDetn32RdrDetnCntr "Refer to the data element description in FrntSideRdrLeDetn1 with the same data element name.";
CM_ SG_ 315 FrntSideRdrRiDetn32RdrDetnConf "Refer to the data element description in FrntSideRdrLeDetn1 with the same data element name.";
CM_ SG_ 315 FrntSideRdrRiDetn32RdrDetnElevn "Refer to the data element description in FrntSideRdrLeDetn1 with the same data element name.";
CM_ SG_ 315 FrntSideRdrRiDetn32RdrDetnPwr "Refer to the data element description in FrntSideRdrLeDetn1 with the same data element name.";
CM_ SG_ 315 FrntSideRdrRiDetn32RdrDetnRng "Refer to the data element description in FrntSideRdrLeDetn1 with the same data element name.";
CM_ SG_ 315 FrntSideRdrRiDetn32RdrDetnRngV "Range Velocity";
CM_ SG_ 315 FrntSideRdrRiDetn32RdrDetnSts "Refer to the data element description in FrntSideRdrLeDetn1 with the same data element name.";
CM_ SG_ 315 FrntSideRdrRiDetn33RdrDetnAzi "Refer to the data element description in FrntSideRdrLeDetn1 with the same data element name.";
CM_ SG_ 315 FrntSideRdrRiDetn33RdrDetnChks "Refer to the data element description in FrntSideRdrLeDetn1 with the same data element name.";
CM_ SG_ 315 FrntSideRdrRiDetn33RdrDetnCntr "Refer to the data element description in FrntSideRdrLeDetn1 with the same data element name.";
CM_ SG_ 315 FrntSideRdrRiDetn33RdrDetnConf "Refer to the data element description in FrntSideRdrLeDetn1 with the same data element name.";
CM_ SG_ 315 FrntSideRdrRiDetn33RdrDetnElevn "Refer to the data element description in FrntSideRdrLeDetn1 with the same data element name.";
CM_ SG_ 315 FrntSideRdrRiDetn33RdrDetnPwr "Refer to the data element description in FrntSideRdrLeDetn1 with the same data element name.";
CM_ SG_ 315 FrntSideRdrRiDetn33RdrDetnRng "Refer to the data element description in FrntSideRdrLeDetn1 with the same data element name.";
CM_ SG_ 315 FrntSideRdrRiDetn33RdrDetnRngV "Range Velocity";
CM_ SG_ 315 FrntSideRdrRiDetn33RdrDetnSts "Refer to the data element description in FrntSideRdrLeDetn1 with the same data element name.";
CM_ SG_ 315 FrntSideRdrRiDetn34RdrDetnAzi "Refer to the data element description in FrntSideRdrLeDetn1 with the same data element name.";
CM_ SG_ 315 FrntSideRdrRiDetn34RdrDetnChks "Refer to the data element description in FrntSideRdrLeDetn1 with the same data element name.";
CM_ SG_ 315 FrntSideRdrRiDetn34RdrDetnCntr "Refer to the data element description in FrntSideRdrLeDetn1 with the same data element name.";
CM_ SG_ 315 FrntSideRdrRiDetn34RdrDetnConf "Refer to the data element description in FrntSideRdrLeDetn1 with the same data element name.";
CM_ SG_ 315 FrntSideRdrRiDetn34RdrDetnElevn "Refer to the data element description in FrntSideRdrLeDetn1 with the same data element name.";
CM_ SG_ 315 FrntSideRdrRiDetn34RdrDetnPwr "Refer to the data element description in FrntSideRdrLeDetn1 with the same data element name.";
CM_ SG_ 315 FrntSideRdrRiDetn34RdrDetnRng "Refer to the data element description in FrntSideRdrLeDetn1 with the same data element name.";
CM_ SG_ 315 FrntSideRdrRiDetn34RdrDetnRngV "Range Velocity";
CM_ SG_ 315 FrntSideRdrRiDetn34RdrDetnSts "Refer to the data element description in FrntSideRdrLeDetn1 with the same data element name.";
CM_ SG_ 315 FrntSideRdrRiDetn35RdrDetnAzi "Refer to the data element description in FrntSideRdrLeDetn1 with the same data element name.";
CM_ SG_ 315 FrntSideRdrRiDetn35RdrDetnChks "Refer to the data element description in FrntSideRdrLeDetn1 with the same data element name.";
CM_ SG_ 315 FrntSideRdrRiDetn35RdrDetnCntr "Refer to the data element description in FrntSideRdrLeDetn1 with the same data element name.";
CM_ SG_ 315 FrntSideRdrRiDetn35RdrDetnConf "Refer to the data element description in FrntSideRdrLeDetn1 with the same data element name.";
CM_ SG_ 315 FrntSideRdrRiDetn35RdrDetnElevn "Refer to the data element description in FrntSideRdrLeDetn1 with the same data element name.";
CM_ SG_ 315 FrntSideRdrRiDetn35RdrDetnPwr "Refer to the data element description in FrntSideRdrLeDetn1 with the same data element name.";
CM_ SG_ 315 FrntSideRdrRiDetn35RdrDetnRng "Refer to the data element description in FrntSideRdrLeDetn1 with the same data element name.";
CM_ SG_ 315 FrntSideRdrRiDetn35RdrDetnRngV "Range Velocity";
CM_ SG_ 315 FrntSideRdrRiDetn35RdrDetnSts "Refer to the data element description in FrntSideRdrLeDetn1 with the same data element name.";
CM_ SG_ 315 FrntSideRdrRiDetn36RdrDetnAzi "Refer to the data element description in FrntSideRdrLeDetn1 with the same data element name.";
CM_ SG_ 315 FrntSideRdrRiDetn36RdrDetnChks "Refer to the data element description in FrntSideRdrLeDetn1 with the same data element name.";
CM_ SG_ 315 FrntSideRdrRiDetn36RdrDetnCntr "Refer to the data element description in FrntSideRdrLeDetn1 with the same data element name.";
CM_ SG_ 315 FrntSideRdrRiDetn36RdrDetnConf "Refer to the data element description in FrntSideRdrLeDetn1 with the same data element name.";
CM_ SG_ 315 FrntSideRdrRiDetn36RdrDetnElevn "Refer to the data element description in FrntSideRdrLeDetn1 with the same data element name.";
CM_ SG_ 315 FrntSideRdrRiDetn36RdrDetnPwr "Refer to the data element description in FrntSideRdrLeDetn1 with the same data element name.";
CM_ SG_ 315 FrntSideRdrRiDetn36RdrDetnRng "Refer to the data element description in FrntSideRdrLeDetn1 with the same data element name.";
CM_ SG_ 315 FrntSideRdrRiDetn36RdrDetnRngV "Range Velocity";
CM_ SG_ 315 FrntSideRdrRiDetn36RdrDetnSts "Refer to the data element description in FrntSideRdrLeDetn1 with the same data element name.";
CM_ SG_ 317 FrntSideRdrRiDetn37RdrDetnAzi "Refer to the data element description in FrntSideRdrLeDetn1 with the same data element name.";
CM_ SG_ 317 FrntSideRdrRiDetn37RdrDetnChks "Refer to the data element description in FrntSideRdrLeDetn1 with the same data element name.";
CM_ SG_ 317 FrntSideRdrRiDetn37RdrDetnCntr "Refer to the data element description in FrntSideRdrLeDetn1 with the same data element name.";
CM_ SG_ 317 FrntSideRdrRiDetn37RdrDetnConf "Refer to the data element description in FrntSideRdrLeDetn1 with the same data element name.";
CM_ SG_ 317 FrntSideRdrRiDetn37RdrDetnElevn "Refer to the data element description in FrntSideRdrLeDetn1 with the same data element name.";
CM_ SG_ 317 FrntSideRdrRiDetn37RdrDetnPwr "Refer to the data element description in FrntSideRdrLeDetn1 with the same data element name.";
CM_ SG_ 317 FrntSideRdrRiDetn37RdrDetnRng "Refer to the data element description in FrntSideRdrLeDetn1 with the same data element name.";
CM_ SG_ 317 FrntSideRdrRiDetn37RdrDetnRngV "Range Velocity";
CM_ SG_ 317 FrntSideRdrRiDetn37RdrDetnSts "Refer to the data element description in FrntSideRdrLeDetn1 with the same data element name.";
CM_ SG_ 317 FrntSideRdrRiDetn38RdrDetnAzi "Refer to the data element description in FrntSideRdrLeDetn1 with the same data element name.";
CM_ SG_ 317 FrntSideRdrRiDetn38RdrDetnChks "Refer to the data element description in FrntSideRdrLeDetn1 with the same data element name.";
CM_ SG_ 317 FrntSideRdrRiDetn38RdrDetnCntr "Refer to the data element description in FrntSideRdrLeDetn1 with the same data element name.";
CM_ SG_ 317 FrntSideRdrRiDetn38RdrDetnConf "Refer to the data element description in FrntSideRdrLeDetn1 with the same data element name.";
CM_ SG_ 317 FrntSideRdrRiDetn38RdrDetnElevn "Refer to the data element description in FrntSideRdrLeDetn1 with the same data element name.";
CM_ SG_ 317 FrntSideRdrRiDetn38RdrDetnPwr "Refer to the data element description in FrntSideRdrLeDetn1 with the same data element name.";
CM_ SG_ 317 FrntSideRdrRiDetn38RdrDetnRng "Refer to the data element description in FrntSideRdrLeDetn1 with the same data element name.";
CM_ SG_ 317 FrntSideRdrRiDetn38RdrDetnRngV "Range Velocity";
CM_ SG_ 317 FrntSideRdrRiDetn38RdrDetnSts "Refer to the data element description in FrntSideRdrLeDetn1 with the same data element name.";
CM_ SG_ 317 FrntSideRdrRiDetn39RdrDetnAzi "Refer to the data element description in FrntSideRdrLeDetn1 with the same data element name.";
CM_ SG_ 317 FrntSideRdrRiDetn39RdrDetnChks "Refer to the data element description in FrntSideRdrLeDetn1 with the same data element name.";
CM_ SG_ 317 FrntSideRdrRiDetn39RdrDetnCntr "Refer to the data element description in FrntSideRdrLeDetn1 with the same data element name.";
CM_ SG_ 317 FrntSideRdrRiDetn39RdrDetnConf "Refer to the data element description in FrntSideRdrLeDetn1 with the same data element name.";
CM_ SG_ 317 FrntSideRdrRiDetn39RdrDetnElevn "Refer to the data element description in FrntSideRdrLeDetn1 with the same data element name.";
CM_ SG_ 317 FrntSideRdrRiDetn39RdrDetnPwr "Refer to the data element description in FrntSideRdrLeDetn1 with the same data element name.";
CM_ SG_ 317 FrntSideRdrRiDetn39RdrDetnRng "Refer to the data element description in FrntSideRdrLeDetn1 with the same data element name.";
CM_ SG_ 317 FrntSideRdrRiDetn39RdrDetnRngV "Range Velocity";
CM_ SG_ 317 FrntSideRdrRiDetn39RdrDetnSts "Refer to the data element description in FrntSideRdrLeDetn1 with the same data element name.";
CM_ SG_ 317 FrntSideRdrRiDetn40RdrDetnAzi "Refer to the data element description in FrntSideRdrLeDetn1 with the same data element name.";
CM_ SG_ 317 FrntSideRdrRiDetn40RdrDetnChks "Refer to the data element description in FrntSideRdrLeDetn1 with the same data element name.";
CM_ SG_ 317 FrntSideRdrRiDetn40RdrDetnCntr "Refer to the data element description in FrntSideRdrLeDetn1 with the same data element name.";
CM_ SG_ 317 FrntSideRdrRiDetn40RdrDetnConf "Refer to the data element description in FrntSideRdrLeDetn1 with the same data element name.";
CM_ SG_ 317 FrntSideRdrRiDetn40RdrDetnElevn "Refer to the data element description in FrntSideRdrLeDetn1 with the same data element name.";
CM_ SG_ 317 FrntSideRdrRiDetn40RdrDetnPwr "Refer to the data element description in FrntSideRdrLeDetn1 with the same data element name.";
CM_ SG_ 317 FrntSideRdrRiDetn40RdrDetnRng "Refer to the data element description in FrntSideRdrLeDetn1 with the same data element name.";
CM_ SG_ 317 FrntSideRdrRiDetn40RdrDetnRngV "Range Velocity";
CM_ SG_ 317 FrntSideRdrRiDetn40RdrDetnSts "Refer to the data element description in FrntSideRdrLeDetn1 with the same data element name.";
CM_ SG_ 317 FrntSideRdrRiDetn41RdrDetnAzi "Refer to the data element description in FrntSideRdrLeDetn1 with the same data element name.";
CM_ SG_ 317 FrntSideRdrRiDetn41RdrDetnChks "Refer to the data element description in FrntSideRdrLeDetn1 with the same data element name.";
CM_ SG_ 317 FrntSideRdrRiDetn41RdrDetnCntr "Refer to the data element description in FrntSideRdrLeDetn1 with the same data element name.";
CM_ SG_ 317 FrntSideRdrRiDetn41RdrDetnConf "Refer to the data element description in FrntSideRdrLeDetn1 with the same data element name.";
CM_ SG_ 317 FrntSideRdrRiDetn41RdrDetnElevn "Refer to the data element description in FrntSideRdrLeDetn1 with the same data element name.";
CM_ SG_ 317 FrntSideRdrRiDetn41RdrDetnPwr "Refer to the data element description in FrntSideRdrLeDetn1 with the same data element name.";
CM_ SG_ 317 FrntSideRdrRiDetn41RdrDetnRng "Refer to the data element description in FrntSideRdrLeDetn1 with the same data element name.";
CM_ SG_ 317 FrntSideRdrRiDetn41RdrDetnRngV "Range Velocity";
CM_ SG_ 317 FrntSideRdrRiDetn41RdrDetnSts "Refer to the data element description in FrntSideRdrLeDetn1 with the same data element name.";
CM_ SG_ 317 FrntSideRdrRiDetn42RdrDetnAzi "Refer to the data element description in FrntSideRdrLeDetn1 with the same data element name.";
CM_ SG_ 317 FrntSideRdrRiDetn42RdrDetnChks "Refer to the data element description in FrntSideRdrLeDetn1 with the same data element name.";
CM_ SG_ 317 FrntSideRdrRiDetn42RdrDetnCntr "Refer to the data element description in FrntSideRdrLeDetn1 with the same data element name.";
CM_ SG_ 317 FrntSideRdrRiDetn42RdrDetnConf "Refer to the data element description in FrntSideRdrLeDetn1 with the same data element name.";
CM_ SG_ 317 FrntSideRdrRiDetn42RdrDetnElevn "Refer to the data element description in FrntSideRdrLeDetn1 with the same data element name.";
CM_ SG_ 317 FrntSideRdrRiDetn42RdrDetnPwr "Refer to the data element description in FrntSideRdrLeDetn1 with the same data element name.";
CM_ SG_ 317 FrntSideRdrRiDetn42RdrDetnRng "Refer to the data element description in FrntSideRdrLeDetn1 with the same data element name.";
CM_ SG_ 317 FrntSideRdrRiDetn42RdrDetnRngV "Range Velocity";
CM_ SG_ 317 FrntSideRdrRiDetn42RdrDetnSts "Refer to the data element description in FrntSideRdrLeDetn1 with the same data element name.";
CM_ SG_ 319 FrntSideRdrRiDetn43RdrDetnAzi "Refer to the data element description in FrntSideRdrLeDetn1 with the same data element name.";
CM_ SG_ 319 FrntSideRdrRiDetn43RdrDetnChks "Refer to the data element description in FrntSideRdrLeDetn1 with the same data element name.";
CM_ SG_ 319 FrntSideRdrRiDetn43RdrDetnCntr "Refer to the data element description in FrntSideRdrLeDetn1 with the same data element name.";
CM_ SG_ 319 FrntSideRdrRiDetn43RdrDetnConf "Refer to the data element description in FrntSideRdrLeDetn1 with the same data element name.";
CM_ SG_ 319 FrntSideRdrRiDetn43RdrDetnElevn "Refer to the data element description in FrntSideRdrLeDetn1 with the same data element name.";
CM_ SG_ 319 FrntSideRdrRiDetn43RdrDetnPwr "Refer to the data element description in FrntSideRdrLeDetn1 with the same data element name.";
CM_ SG_ 319 FrntSideRdrRiDetn43RdrDetnRng "Refer to the data element description in FrntSideRdrLeDetn1 with the same data element name.";
CM_ SG_ 319 FrntSideRdrRiDetn43RdrDetnRngV "Range Velocity";
CM_ SG_ 319 FrntSideRdrRiDetn43RdrDetnSts "Refer to the data element description in FrntSideRdrLeDetn1 with the same data element name.";
CM_ SG_ 319 FrntSideRdrRiDetn44RdrDetnAzi "Refer to the data element description in FrntSideRdrLeDetn1 with the same data element name.";
CM_ SG_ 319 FrntSideRdrRiDetn44RdrDetnChks "Refer to the data element description in FrntSideRdrLeDetn1 with the same data element name.";
CM_ SG_ 319 FrntSideRdrRiDetn44RdrDetnCntr "Refer to the data element description in FrntSideRdrLeDetn1 with the same data element name.";
CM_ SG_ 319 FrntSideRdrRiDetn44RdrDetnConf "Refer to the data element description in FrntSideRdrLeDetn1 with the same data element name.";
CM_ SG_ 319 FrntSideRdrRiDetn44RdrDetnElevn "Refer to the data element description in FrntSideRdrLeDetn1 with the same data element name.";
CM_ SG_ 319 FrntSideRdrRiDetn44RdrDetnPwr "Refer to the data element description in FrntSideRdrLeDetn1 with the same data element name.";
CM_ SG_ 319 FrntSideRdrRiDetn44RdrDetnRng "Refer to the data element description in FrntSideRdrLeDetn1 with the same data element name.";
CM_ SG_ 319 FrntSideRdrRiDetn44RdrDetnRngV "Range Velocity";
CM_ SG_ 319 FrntSideRdrRiDetn44RdrDetnSts "Refer to the data element description in FrntSideRdrLeDetn1 with the same data element name.";
CM_ SG_ 319 FrntSideRdrRiDetn45RdrDetnAzi "Refer to the data element description in FrntSideRdrLeDetn1 with the same data element name.";
CM_ SG_ 319 FrntSideRdrRiDetn45RdrDetnChks "Refer to the data element description in FrntSideRdrLeDetn1 with the same data element name.";
CM_ SG_ 319 FrntSideRdrRiDetn45RdrDetnCntr "Refer to the data element description in FrntSideRdrLeDetn1 with the same data element name.";
CM_ SG_ 319 FrntSideRdrRiDetn45RdrDetnConf "Refer to the data element description in FrntSideRdrLeDetn1 with the same data element name.";
CM_ SG_ 319 FrntSideRdrRiDetn45RdrDetnElevn "Refer to the data element description in FrntSideRdrLeDetn1 with the same data element name.";
CM_ SG_ 319 FrntSideRdrRiDetn45RdrDetnPwr "Refer to the data element description in FrntSideRdrLeDetn1 with the same data element name.";
CM_ SG_ 319 FrntSideRdrRiDetn45RdrDetnRng "Refer to the data element description in FrntSideRdrLeDetn1 with the same data element name.";
CM_ SG_ 319 FrntSideRdrRiDetn45RdrDetnRngV "Range Velocity";
CM_ SG_ 319 FrntSideRdrRiDetn45RdrDetnSts "Refer to the data element description in FrntSideRdrLeDetn1 with the same data element name.";
CM_ SG_ 319 FrntSideRdrRiDetn46RdrDetnAzi "Refer to the data element description in FrntSideRdrLeDetn1 with the same data element name.";
CM_ SG_ 319 FrntSideRdrRiDetn46RdrDetnChks "Refer to the data element description in FrntSideRdrLeDetn1 with the same data element name.";
CM_ SG_ 319 FrntSideRdrRiDetn46RdrDetnCntr "Refer to the data element description in FrntSideRdrLeDetn1 with the same data element name.";
CM_ SG_ 319 FrntSideRdrRiDetn46RdrDetnConf "Refer to the data element description in FrntSideRdrLeDetn1 with the same data element name.";
CM_ SG_ 319 FrntSideRdrRiDetn46RdrDetnElevn "Refer to the data element description in FrntSideRdrLeDetn1 with the same data element name.";
CM_ SG_ 319 FrntSideRdrRiDetn46RdrDetnPwr "Refer to the data element description in FrntSideRdrLeDetn1 with the same data element name.";
CM_ SG_ 319 FrntSideRdrRiDetn46RdrDetnRng "Refer to the data element description in FrntSideRdrLeDetn1 with the same data element name.";
CM_ SG_ 319 FrntSideRdrRiDetn46RdrDetnRngV "Range Velocity";
CM_ SG_ 319 FrntSideRdrRiDetn46RdrDetnSts "Refer to the data element description in FrntSideRdrLeDetn1 with the same data element name.";
CM_ SG_ 319 FrntSideRdrRiDetn47RdrDetnAzi "Refer to the data element description in FrntSideRdrLeDetn1 with the same data element name.";
CM_ SG_ 319 FrntSideRdrRiDetn47RdrDetnChks "Refer to the data element description in FrntSideRdrLeDetn1 with the same data element name.";
CM_ SG_ 319 FrntSideRdrRiDetn47RdrDetnCntr "Refer to the data element description in FrntSideRdrLeDetn1 with the same data element name.";
CM_ SG_ 319 FrntSideRdrRiDetn47RdrDetnConf "Refer to the data element description in FrntSideRdrLeDetn1 with the same data element name.";
CM_ SG_ 319 FrntSideRdrRiDetn47RdrDetnElevn "Refer to the data element description in FrntSideRdrLeDetn1 with the same data element name.";
CM_ SG_ 319 FrntSideRdrRiDetn47RdrDetnPwr "Refer to the data element description in FrntSideRdrLeDetn1 with the same data element name.";
CM_ SG_ 319 FrntSideRdrRiDetn47RdrDetnRng "Refer to the data element description in FrntSideRdrLeDetn1 with the same data element name.";
CM_ SG_ 319 FrntSideRdrRiDetn47RdrDetnRngV "Range Velocity";
CM_ SG_ 319 FrntSideRdrRiDetn47RdrDetnSts "Refer to the data element description in FrntSideRdrLeDetn1 with the same data element name.";
CM_ SG_ 319 FrntSideRdrRiDetn48RdrDetnAzi "Refer to the data element description in FrntSideRdrLeDetn1 with the same data element name.";
CM_ SG_ 319 FrntSideRdrRiDetn48RdrDetnChks "Refer to the data element description in FrntSideRdrLeDetn1 with the same data element name.";
CM_ SG_ 319 FrntSideRdrRiDetn48RdrDetnCntr "Refer to the data element description in FrntSideRdrLeDetn1 with the same data element name.";
CM_ SG_ 319 FrntSideRdrRiDetn48RdrDetnConf "Refer to the data element description in FrntSideRdrLeDetn1 with the same data element name.";
CM_ SG_ 319 FrntSideRdrRiDetn48RdrDetnElevn "Refer to the data element description in FrntSideRdrLeDetn1 with the same data element name.";
CM_ SG_ 319 FrntSideRdrRiDetn48RdrDetnPwr "Refer to the data element description in FrntSideRdrLeDetn1 with the same data element name.";
CM_ SG_ 319 FrntSideRdrRiDetn48RdrDetnRng "Refer to the data element description in FrntSideRdrLeDetn1 with the same data element name.";
CM_ SG_ 319 FrntSideRdrRiDetn48RdrDetnRngV "Range Velocity";
CM_ SG_ 319 FrntSideRdrRiDetn48RdrDetnSts "Refer to the data element description in FrntSideRdrLeDetn1 with the same data element name.";
BA_DEF_ BO_ "CANFD_BRS" ENUM "0","1";
BA_DEF_ BO_ "GenMsgCycleTime" INT 0 65536; // [ms]
BA_DEF_ BO_ "GenMsgDelayTime" INT 0 65536; // [ms]
BA_DEF_ BO_ "GenMsgSendType" ENUM "cyclic", "spontaneous", "not-used", "not-used", "not-used", "cyclicAndSpontaneous", "not-used", "cyclicIfActive", "NoMsgSendType"; // [us]
BA_DEF_ BO_ "GenMsgStartDelayTime" INT 0 65536; // [ms]
BA_DEF_ BO_ "VFrameFormat" ENUM "StandardCAN","ExtendedCAN","reserved","J1939PG","reserved","reserved","reserved","reserved","reserved","reserved","reserved","reserved","reserved","reserved","StandardCAN_FD","ExtendedCAN_FD";
BA_DEF_ SG_ "GenSigSendType" ENUM "Cyclic","OnWrite","OnWriteWithRepetition","OnChange","OnChangeWithRepetition","IfActive","IfActiveWithRepetition","NoSigSendType";
BA_DEF_ SG_ "GenSigStartValue" HEX 0 80000000;
BA_DEF_ BO_ "GenMsgILSupport" ENUM "No","Yes";
BA_DEF_ BO_ "NmAsrMessage" ENUM "No","Yes";
BA_DEF_ SG_ "GenSigFuncType" ENUM "NoFunction","n/a","n/a","n/a","n/a","n/a","n/a","n/a","n/a","n/a","n/a","n/a","n/a","n/a","n/a","CHK","CNTR","n/a","n/a","n/a","CNTR_AR_01","CRC_AR_01_BOTH","CRC_AR_01_ALT","CRC_AR_01_LOW","CRC_AR_01_NIBBLE","CNTR_AR_04","CRC_AR_04A","CNTR_AR_05","CRC_AR_05";
BA_DEF_ SG_ "GenSigDataID" STRING;
BA_DEF_DEF_ "CANFD_BRS" "1";
BA_DEF_DEF_ "GenSigStartValue" 0;
BA_DEF_DEF_ "VFrameFormat" "J1939PG";
BA_DEF_DEF_ "GenSigSendType" "NoSigSendType";
BA_DEF_DEF_ "GenMsgCycleTime" 0;
BA_DEF_DEF_ "GenMsgDelayTime" 0;
BA_DEF_DEF_ "GenMsgStartDelayTime" 0;
BA_DEF_DEF_ "GenMsgSendType" "NoMsgSendType";
BA_DEF_DEF_ "GenMsgILSupport" "Yes";
BA_DEF_DEF_ "NmAsrMessage" "No";
BA_DEF_DEF_ "GenSigFuncType" "NoFunction";
BA_DEF_DEF_ "GenSigDataID" "";
// Frame: FSRRSafetyCANFD1Frame00
BA_ "GenMsgCycleTime" BO_ 302 50.000;
BA_ "GenMsgSendType" BO_ 302 0;
BA_ "VFrameFormat" BO_ 302 14;
// Frame: FSRRSafetyCANFD1Frame01
BA_ "GenMsgCycleTime" BO_ 305 50.000;
BA_ "GenMsgSendType" BO_ 305 0;
BA_ "VFrameFormat" BO_ 305 14;
// Frame: FSRRSafetyCANFD1Frame02
BA_ "GenMsgCycleTime" BO_ 307 50.000;
BA_ "GenMsgSendType" BO_ 307 0;
BA_ "VFrameFormat" BO_ 307 14;
// Frame: FSRRSafetyCANFD1Frame03
BA_ "GenMsgCycleTime" BO_ 309 50.000;
BA_ "GenMsgSendType" BO_ 309 0;
BA_ "VFrameFormat" BO_ 309 14;
// Frame: FSRRSafetyCANFD1Frame04
BA_ "GenMsgCycleTime" BO_ 311 50.000;
BA_ "GenMsgSendType" BO_ 311 0;
BA_ "VFrameFormat" BO_ 311 14;
// Frame: FSRRSafetyCANFD1Frame05
BA_ "GenMsgCycleTime" BO_ 313 50.000;
BA_ "GenMsgSendType" BO_ 313 0;
BA_ "VFrameFormat" BO_ 313 14;
// Frame: FSRRSafetyCANFD1Frame06
BA_ "GenMsgCycleTime" BO_ 315 50.000;
BA_ "GenMsgSendType" BO_ 315 0;
BA_ "VFrameFormat" BO_ 315 14;
// Frame: FSRRSafetyCANFD1Frame07
BA_ "GenMsgCycleTime" BO_ 317 50.000;
BA_ "GenMsgSendType" BO_ 317 0;
BA_ "VFrameFormat" BO_ 317 14;
// Frame: FSRRSafetyCANFD1Frame08
BA_ "GenMsgCycleTime" BO_ 319 50.000;
BA_ "GenMsgSendType" BO_ 319 0;
BA_ "VFrameFormat" BO_ 319 14;
// Frame: FsrlToAsdmSafetyCanFD1DiagResFrame
BA_ "GenMsgDelayTime" BO_ 1585 5.000;
BA_ "GenMsgSendType" BO_ 1585 1;
BA_ "VFrameFormat" BO_ 1585 14;
// Frame: FsrltoEtcXcpFr01
BA_ "GenMsgDelayTime" BO_ 1415 5.000;
BA_ "GenMsgSendType" BO_ 1415 1;
BA_ "VFrameFormat" BO_ 1415 0;
// Frame: FsrltoEtcXcpFr02
BA_ "GenMsgDelayTime" BO_ 1427 10.000;
BA_ "GenMsgSendType" BO_ 1427 1;
BA_ "VFrameFormat" BO_ 1427 0;
BA_ "GenSigSendType" SG_ 307 FrntSideRdrRiDetn10RdrDetnAzi 0;
BA_ "GenSigStartValue" SG_ 307 FrntSideRdrRiDetn10RdrDetnAzi 900;
BA_ "GenSigDataID" SG_ 307 FrntSideRdrRiDetn10RdrDetnChks "0x8EC";
BA_ "GenSigFuncType" SG_ 307 FrntSideRdrRiDetn10RdrDetnChks 15;
BA_ "GenSigSendType" SG_ 307 FrntSideRdrRiDetn10RdrDetnChks 0;
BA_ "GenSigFuncType" SG_ 307 FrntSideRdrRiDetn10RdrDetnCntr 16;
BA_ "GenSigSendType" SG_ 307 FrntSideRdrRiDetn10RdrDetnCntr 0;
BA_ "GenSigSendType" SG_ 307 FrntSideRdrRiDetn10RdrDetnConf 0;
BA_ "GenSigSendType" SG_ 307 FrntSideRdrRiDetn10RdrDetnElevn 0;
BA_ "GenSigStartValue" SG_ 307 FrntSideRdrRiDetn10RdrDetnElevn 15;
BA_ "GenSigSendType" SG_ 307 FrntSideRdrRiDetn10RdrDetnPwr 0;
BA_ "GenSigSendType" SG_ 307 FrntSideRdrRiDetn10RdrDetnRng 0;
BA_ "GenSigStartValue" SG_ 307 FrntSideRdrRiDetn10RdrDetnRng 10050;
BA_ "GenSigSendType" SG_ 307 FrntSideRdrRiDetn10RdrDetnRngV 0;
BA_ "GenSigStartValue" SG_ 307 FrntSideRdrRiDetn10RdrDetnRngV 4000;
BA_ "GenSigSendType" SG_ 307 FrntSideRdrRiDetn10RdrDetnSts 0;
BA_ "GenSigStartValue" SG_ 307 FrntSideRdrRiDetn10RdrDetnSts 3;
BA_ "GenSigSendType" SG_ 307 FrntSideRdrRiDetn11RdrDetnAzi 0;
BA_ "GenSigStartValue" SG_ 307 FrntSideRdrRiDetn11RdrDetnAzi 900;
BA_ "GenSigDataID" SG_ 307 FrntSideRdrRiDetn11RdrDetnChks "0x8ED";
BA_ "GenSigFuncType" SG_ 307 FrntSideRdrRiDetn11RdrDetnChks 15;
BA_ "GenSigSendType" SG_ 307 FrntSideRdrRiDetn11RdrDetnChks 0;
BA_ "GenSigFuncType" SG_ 307 FrntSideRdrRiDetn11RdrDetnCntr 16;
BA_ "GenSigSendType" SG_ 307 FrntSideRdrRiDetn11RdrDetnCntr 0;
BA_ "GenSigSendType" SG_ 307 FrntSideRdrRiDetn11RdrDetnConf 0;
BA_ "GenSigSendType" SG_ 307 FrntSideRdrRiDetn11RdrDetnElevn 0;
BA_ "GenSigStartValue" SG_ 307 FrntSideRdrRiDetn11RdrDetnElevn 15;
BA_ "GenSigSendType" SG_ 307 FrntSideRdrRiDetn11RdrDetnPwr 0;
BA_ "GenSigSendType" SG_ 307 FrntSideRdrRiDetn11RdrDetnRng 0;
BA_ "GenSigStartValue" SG_ 307 FrntSideRdrRiDetn11RdrDetnRng 10050;
BA_ "GenSigSendType" SG_ 307 FrntSideRdrRiDetn11RdrDetnRngV 0;
BA_ "GenSigStartValue" SG_ 307 FrntSideRdrRiDetn11RdrDetnRngV 4000;
BA_ "GenSigSendType" SG_ 307 FrntSideRdrRiDetn11RdrDetnSts 0;
BA_ "GenSigStartValue" SG_ 307 FrntSideRdrRiDetn11RdrDetnSts 3;
BA_ "GenSigSendType" SG_ 307 FrntSideRdrRiDetn12RdrDetnAzi 0;
BA_ "GenSigStartValue" SG_ 307 FrntSideRdrRiDetn12RdrDetnAzi 900;
BA_ "GenSigDataID" SG_ 307 FrntSideRdrRiDetn12RdrDetnChks "0x8EE";
BA_ "GenSigFuncType" SG_ 307 FrntSideRdrRiDetn12RdrDetnChks 15;
BA_ "GenSigSendType" SG_ 307 FrntSideRdrRiDetn12RdrDetnChks 0;
BA_ "GenSigFuncType" SG_ 307 FrntSideRdrRiDetn12RdrDetnCntr 16;
BA_ "GenSigSendType" SG_ 307 FrntSideRdrRiDetn12RdrDetnCntr 0;
BA_ "GenSigSendType" SG_ 307 FrntSideRdrRiDetn12RdrDetnConf 0;
BA_ "GenSigSendType" SG_ 307 FrntSideRdrRiDetn12RdrDetnElevn 0;
BA_ "GenSigStartValue" SG_ 307 FrntSideRdrRiDetn12RdrDetnElevn 15;
BA_ "GenSigSendType" SG_ 307 FrntSideRdrRiDetn12RdrDetnPwr 0;
BA_ "GenSigSendType" SG_ 307 FrntSideRdrRiDetn12RdrDetnRng 0;
BA_ "GenSigStartValue" SG_ 307 FrntSideRdrRiDetn12RdrDetnRng 10050;
BA_ "GenSigSendType" SG_ 307 FrntSideRdrRiDetn12RdrDetnRngV 0;
BA_ "GenSigStartValue" SG_ 307 FrntSideRdrRiDetn12RdrDetnRngV 4000;
BA_ "GenSigSendType" SG_ 307 FrntSideRdrRiDetn12RdrDetnSts 0;
BA_ "GenSigStartValue" SG_ 307 FrntSideRdrRiDetn12RdrDetnSts 3;
BA_ "GenSigSendType" SG_ 309 FrntSideRdrRiDetn13RdrDetnAzi 0;
BA_ "GenSigStartValue" SG_ 309 FrntSideRdrRiDetn13RdrDetnAzi 900;
BA_ "GenSigDataID" SG_ 309 FrntSideRdrRiDetn13RdrDetnChks "0x8EF";
BA_ "GenSigFuncType" SG_ 309 FrntSideRdrRiDetn13RdrDetnChks 15;
BA_ "GenSigSendType" SG_ 309 FrntSideRdrRiDetn13RdrDetnChks 0;
BA_ "GenSigFuncType" SG_ 309 FrntSideRdrRiDetn13RdrDetnCntr 16;
BA_ "GenSigSendType" SG_ 309 FrntSideRdrRiDetn13RdrDetnCntr 0;
BA_ "GenSigSendType" SG_ 309 FrntSideRdrRiDetn13RdrDetnConf 0;
BA_ "GenSigSendType" SG_ 309 FrntSideRdrRiDetn13RdrDetnElevn 0;
BA_ "GenSigStartValue" SG_ 309 FrntSideRdrRiDetn13RdrDetnElevn 15;
BA_ "GenSigSendType" SG_ 309 FrntSideRdrRiDetn13RdrDetnPwr 0;
BA_ "GenSigSendType" SG_ 309 FrntSideRdrRiDetn13RdrDetnRng 0;
BA_ "GenSigStartValue" SG_ 309 FrntSideRdrRiDetn13RdrDetnRng 10050;
BA_ "GenSigSendType" SG_ 309 FrntSideRdrRiDetn13RdrDetnRngV 0;
BA_ "GenSigStartValue" SG_ 309 FrntSideRdrRiDetn13RdrDetnRngV 4000;
BA_ "GenSigSendType" SG_ 309 FrntSideRdrRiDetn13RdrDetnSts 0;
BA_ "GenSigStartValue" SG_ 309 FrntSideRdrRiDetn13RdrDetnSts 3;
BA_ "GenSigSendType" SG_ 309 FrntSideRdrRiDetn14RdrDetnAzi 0;
BA_ "GenSigStartValue" SG_ 309 FrntSideRdrRiDetn14RdrDetnAzi 900;
BA_ "GenSigDataID" SG_ 309 FrntSideRdrRiDetn14RdrDetnChks "0x8F0";
BA_ "GenSigFuncType" SG_ 309 FrntSideRdrRiDetn14RdrDetnChks 15;
BA_ "GenSigSendType" SG_ 309 FrntSideRdrRiDetn14RdrDetnChks 0;
BA_ "GenSigFuncType" SG_ 309 FrntSideRdrRiDetn14RdrDetnCntr 16;
BA_ "GenSigSendType" SG_ 309 FrntSideRdrRiDetn14RdrDetnCntr 0;
BA_ "GenSigSendType" SG_ 309 FrntSideRdrRiDetn14RdrDetnConf 0;
BA_ "GenSigSendType" SG_ 309 FrntSideRdrRiDetn14RdrDetnElevn 0;
BA_ "GenSigStartValue" SG_ 309 FrntSideRdrRiDetn14RdrDetnElevn 15;
BA_ "GenSigSendType" SG_ 309 FrntSideRdrRiDetn14RdrDetnPwr 0;
BA_ "GenSigSendType" SG_ 309 FrntSideRdrRiDetn14RdrDetnRng 0;
BA_ "GenSigStartValue" SG_ 309 FrntSideRdrRiDetn14RdrDetnRng 10050;
BA_ "GenSigSendType" SG_ 309 FrntSideRdrRiDetn14RdrDetnRngV 0;
BA_ "GenSigStartValue" SG_ 309 FrntSideRdrRiDetn14RdrDetnRngV 4000;
BA_ "GenSigSendType" SG_ 309 FrntSideRdrRiDetn14RdrDetnSts 0;
BA_ "GenSigStartValue" SG_ 309 FrntSideRdrRiDetn14RdrDetnSts 3;
BA_ "GenSigSendType" SG_ 309 FrntSideRdrRiDetn15RdrDetnAzi 0;
BA_ "GenSigStartValue" SG_ 309 FrntSideRdrRiDetn15RdrDetnAzi 900;
BA_ "GenSigDataID" SG_ 309 FrntSideRdrRiDetn15RdrDetnChks "0x8F1";
BA_ "GenSigFuncType" SG_ 309 FrntSideRdrRiDetn15RdrDetnChks 15;
BA_ "GenSigSendType" SG_ 309 FrntSideRdrRiDetn15RdrDetnChks 0;
BA_ "GenSigFuncType" SG_ 309 FrntSideRdrRiDetn15RdrDetnCntr 16;
BA_ "GenSigSendType" SG_ 309 FrntSideRdrRiDetn15RdrDetnCntr 0;
BA_ "GenSigSendType" SG_ 309 FrntSideRdrRiDetn15RdrDetnConf 0;
BA_ "GenSigSendType" SG_ 309 FrntSideRdrRiDetn15RdrDetnElevn 0;
BA_ "GenSigStartValue" SG_ 309 FrntSideRdrRiDetn15RdrDetnElevn 15;
BA_ "GenSigSendType" SG_ 309 FrntSideRdrRiDetn15RdrDetnPwr 0;
BA_ "GenSigSendType" SG_ 309 FrntSideRdrRiDetn15RdrDetnRng 0;
BA_ "GenSigStartValue" SG_ 309 FrntSideRdrRiDetn15RdrDetnRng 10050;
BA_ "GenSigSendType" SG_ 309 FrntSideRdrRiDetn15RdrDetnRngV 0;
BA_ "GenSigStartValue" SG_ 309 FrntSideRdrRiDetn15RdrDetnRngV 4000;
BA_ "GenSigSendType" SG_ 309 FrntSideRdrRiDetn15RdrDetnSts 0;
BA_ "GenSigStartValue" SG_ 309 FrntSideRdrRiDetn15RdrDetnSts 3;
BA_ "GenSigSendType" SG_ 309 FrntSideRdrRiDetn16RdrDetnAzi 0;
BA_ "GenSigStartValue" SG_ 309 FrntSideRdrRiDetn16RdrDetnAzi 900;
BA_ "GenSigDataID" SG_ 309 FrntSideRdrRiDetn16RdrDetnChks "0x8F2";
BA_ "GenSigFuncType" SG_ 309 FrntSideRdrRiDetn16RdrDetnChks 15;
BA_ "GenSigSendType" SG_ 309 FrntSideRdrRiDetn16RdrDetnChks 0;
BA_ "GenSigFuncType" SG_ 309 FrntSideRdrRiDetn16RdrDetnCntr 16;
BA_ "GenSigSendType" SG_ 309 FrntSideRdrRiDetn16RdrDetnCntr 0;
BA_ "GenSigSendType" SG_ 309 FrntSideRdrRiDetn16RdrDetnConf 0;
BA_ "GenSigSendType" SG_ 309 FrntSideRdrRiDetn16RdrDetnElevn 0;
BA_ "GenSigStartValue" SG_ 309 FrntSideRdrRiDetn16RdrDetnElevn 15;
BA_ "GenSigSendType" SG_ 309 FrntSideRdrRiDetn16RdrDetnPwr 0;
BA_ "GenSigSendType" SG_ 309 FrntSideRdrRiDetn16RdrDetnRng 0;
BA_ "GenSigStartValue" SG_ 309 FrntSideRdrRiDetn16RdrDetnRng 10050;
BA_ "GenSigSendType" SG_ 309 FrntSideRdrRiDetn16RdrDetnRngV 0;
BA_ "GenSigStartValue" SG_ 309 FrntSideRdrRiDetn16RdrDetnRngV 4000;
BA_ "GenSigSendType" SG_ 309 FrntSideRdrRiDetn16RdrDetnSts 0;
BA_ "GenSigStartValue" SG_ 309 FrntSideRdrRiDetn16RdrDetnSts 3;
BA_ "GenSigSendType" SG_ 309 FrntSideRdrRiDetn17RdrDetnAzi 0;
BA_ "GenSigStartValue" SG_ 309 FrntSideRdrRiDetn17RdrDetnAzi 900;
BA_ "GenSigDataID" SG_ 309 FrntSideRdrRiDetn17RdrDetnChks "0x8F3";
BA_ "GenSigFuncType" SG_ 309 FrntSideRdrRiDetn17RdrDetnChks 15;
BA_ "GenSigSendType" SG_ 309 FrntSideRdrRiDetn17RdrDetnChks 0;
BA_ "GenSigFuncType" SG_ 309 FrntSideRdrRiDetn17RdrDetnCntr 16;
BA_ "GenSigSendType" SG_ 309 FrntSideRdrRiDetn17RdrDetnCntr 0;
BA_ "GenSigSendType" SG_ 309 FrntSideRdrRiDetn17RdrDetnConf 0;
BA_ "GenSigSendType" SG_ 309 FrntSideRdrRiDetn17RdrDetnElevn 0;
BA_ "GenSigStartValue" SG_ 309 FrntSideRdrRiDetn17RdrDetnElevn 15;
BA_ "GenSigSendType" SG_ 309 FrntSideRdrRiDetn17RdrDetnPwr 0;
BA_ "GenSigSendType" SG_ 309 FrntSideRdrRiDetn17RdrDetnRng 0;
BA_ "GenSigStartValue" SG_ 309 FrntSideRdrRiDetn17RdrDetnRng 10050;
BA_ "GenSigSendType" SG_ 309 FrntSideRdrRiDetn17RdrDetnRngV 0;
BA_ "GenSigStartValue" SG_ 309 FrntSideRdrRiDetn17RdrDetnRngV 4000;
BA_ "GenSigSendType" SG_ 309 FrntSideRdrRiDetn17RdrDetnSts 0;
BA_ "GenSigStartValue" SG_ 309 FrntSideRdrRiDetn17RdrDetnSts 3;
BA_ "GenSigSendType" SG_ 309 FrntSideRdrRiDetn18RdrDetnAzi 0;
BA_ "GenSigStartValue" SG_ 309 FrntSideRdrRiDetn18RdrDetnAzi 900;
BA_ "GenSigDataID" SG_ 309 FrntSideRdrRiDetn18RdrDetnChks "0x8F4";
BA_ "GenSigFuncType" SG_ 309 FrntSideRdrRiDetn18RdrDetnChks 15;
BA_ "GenSigSendType" SG_ 309 FrntSideRdrRiDetn18RdrDetnChks 0;
BA_ "GenSigFuncType" SG_ 309 FrntSideRdrRiDetn18RdrDetnCntr 16;
BA_ "GenSigSendType" SG_ 309 FrntSideRdrRiDetn18RdrDetnCntr 0;
BA_ "GenSigSendType" SG_ 309 FrntSideRdrRiDetn18RdrDetnConf 0;
BA_ "GenSigSendType" SG_ 309 FrntSideRdrRiDetn18RdrDetnElevn 0;
BA_ "GenSigStartValue" SG_ 309 FrntSideRdrRiDetn18RdrDetnElevn 15;
BA_ "GenSigSendType" SG_ 309 FrntSideRdrRiDetn18RdrDetnPwr 0;
BA_ "GenSigSendType" SG_ 309 FrntSideRdrRiDetn18RdrDetnRng 0;
BA_ "GenSigStartValue" SG_ 309 FrntSideRdrRiDetn18RdrDetnRng 10050;
BA_ "GenSigSendType" SG_ 309 FrntSideRdrRiDetn18RdrDetnRngV 0;
BA_ "GenSigStartValue" SG_ 309 FrntSideRdrRiDetn18RdrDetnRngV 4000;
BA_ "GenSigSendType" SG_ 309 FrntSideRdrRiDetn18RdrDetnSts 0;
BA_ "GenSigStartValue" SG_ 309 FrntSideRdrRiDetn18RdrDetnSts 3;
BA_ "GenSigSendType" SG_ 311 FrntSideRdrRiDetn19RdrDetnAzi 0;
BA_ "GenSigStartValue" SG_ 311 FrntSideRdrRiDetn19RdrDetnAzi 900;
BA_ "GenSigDataID" SG_ 311 FrntSideRdrRiDetn19RdrDetnChks "0x8F5";
BA_ "GenSigFuncType" SG_ 311 FrntSideRdrRiDetn19RdrDetnChks 15;
BA_ "GenSigSendType" SG_ 311 FrntSideRdrRiDetn19RdrDetnChks 0;
BA_ "GenSigFuncType" SG_ 311 FrntSideRdrRiDetn19RdrDetnCntr 16;
BA_ "GenSigSendType" SG_ 311 FrntSideRdrRiDetn19RdrDetnCntr 0;
BA_ "GenSigSendType" SG_ 311 FrntSideRdrRiDetn19RdrDetnConf 0;
BA_ "GenSigSendType" SG_ 311 FrntSideRdrRiDetn19RdrDetnElevn 0;
BA_ "GenSigStartValue" SG_ 311 FrntSideRdrRiDetn19RdrDetnElevn 15;
BA_ "GenSigSendType" SG_ 311 FrntSideRdrRiDetn19RdrDetnPwr 0;
BA_ "GenSigSendType" SG_ 311 FrntSideRdrRiDetn19RdrDetnRng 0;
BA_ "GenSigStartValue" SG_ 311 FrntSideRdrRiDetn19RdrDetnRng 10050;
BA_ "GenSigSendType" SG_ 311 FrntSideRdrRiDetn19RdrDetnRngV 0;
BA_ "GenSigStartValue" SG_ 311 FrntSideRdrRiDetn19RdrDetnRngV 4000;
BA_ "GenSigSendType" SG_ 311 FrntSideRdrRiDetn19RdrDetnSts 0;
BA_ "GenSigStartValue" SG_ 311 FrntSideRdrRiDetn19RdrDetnSts 3;
BA_ "GenSigSendType" SG_ 305 FrntSideRdrRiDetn1RdrDetnAzi 0;
BA_ "GenSigStartValue" SG_ 305 FrntSideRdrRiDetn1RdrDetnAzi 900;
BA_ "GenSigDataID" SG_ 305 FrntSideRdrRiDetn1RdrDetnChks "0x8E3";
BA_ "GenSigFuncType" SG_ 305 FrntSideRdrRiDetn1RdrDetnChks 15;
BA_ "GenSigSendType" SG_ 305 FrntSideRdrRiDetn1RdrDetnChks 0;
BA_ "GenSigFuncType" SG_ 305 FrntSideRdrRiDetn1RdrDetnCntr 16;
BA_ "GenSigSendType" SG_ 305 FrntSideRdrRiDetn1RdrDetnCntr 0;
BA_ "GenSigSendType" SG_ 305 FrntSideRdrRiDetn1RdrDetnConf 0;
BA_ "GenSigSendType" SG_ 305 FrntSideRdrRiDetn1RdrDetnElevn 0;
BA_ "GenSigStartValue" SG_ 305 FrntSideRdrRiDetn1RdrDetnElevn 15;
BA_ "GenSigSendType" SG_ 305 FrntSideRdrRiDetn1RdrDetnPwr 0;
BA_ "GenSigSendType" SG_ 305 FrntSideRdrRiDetn1RdrDetnRng 0;
BA_ "GenSigStartValue" SG_ 305 FrntSideRdrRiDetn1RdrDetnRng 10050;
BA_ "GenSigSendType" SG_ 305 FrntSideRdrRiDetn1RdrDetnRngV 0;
BA_ "GenSigStartValue" SG_ 305 FrntSideRdrRiDetn1RdrDetnRngV 4000;
BA_ "GenSigSendType" SG_ 305 FrntSideRdrRiDetn1RdrDetnSts 0;
BA_ "GenSigStartValue" SG_ 305 FrntSideRdrRiDetn1RdrDetnSts 3;
BA_ "GenSigSendType" SG_ 311 FrntSideRdrRiDetn20RdrDetnAzi 0;
BA_ "GenSigStartValue" SG_ 311 FrntSideRdrRiDetn20RdrDetnAzi 900;
BA_ "GenSigDataID" SG_ 311 FrntSideRdrRiDetn20RdrDetnChks "0x8F6";
BA_ "GenSigFuncType" SG_ 311 FrntSideRdrRiDetn20RdrDetnChks 15;
BA_ "GenSigSendType" SG_ 311 FrntSideRdrRiDetn20RdrDetnChks 0;
BA_ "GenSigFuncType" SG_ 311 FrntSideRdrRiDetn20RdrDetnCntr 16;
BA_ "GenSigSendType" SG_ 311 FrntSideRdrRiDetn20RdrDetnCntr 0;
BA_ "GenSigSendType" SG_ 311 FrntSideRdrRiDetn20RdrDetnConf 0;
BA_ "GenSigSendType" SG_ 311 FrntSideRdrRiDetn20RdrDetnElevn 0;
BA_ "GenSigStartValue" SG_ 311 FrntSideRdrRiDetn20RdrDetnElevn 15;
BA_ "GenSigSendType" SG_ 311 FrntSideRdrRiDetn20RdrDetnPwr 0;
BA_ "GenSigSendType" SG_ 311 FrntSideRdrRiDetn20RdrDetnRng 0;
BA_ "GenSigStartValue" SG_ 311 FrntSideRdrRiDetn20RdrDetnRng 10050;
BA_ "GenSigSendType" SG_ 311 FrntSideRdrRiDetn20RdrDetnRngV 0;
BA_ "GenSigStartValue" SG_ 311 FrntSideRdrRiDetn20RdrDetnRngV 4000;
BA_ "GenSigSendType" SG_ 311 FrntSideRdrRiDetn20RdrDetnSts 0;
BA_ "GenSigStartValue" SG_ 311 FrntSideRdrRiDetn20RdrDetnSts 3;
BA_ "GenSigSendType" SG_ 311 FrntSideRdrRiDetn21RdrDetnAzi 0;
BA_ "GenSigStartValue" SG_ 311 FrntSideRdrRiDetn21RdrDetnAzi 900;
BA_ "GenSigDataID" SG_ 311 FrntSideRdrRiDetn21RdrDetnChks "0x8F7";
BA_ "GenSigFuncType" SG_ 311 FrntSideRdrRiDetn21RdrDetnChks 15;
BA_ "GenSigSendType" SG_ 311 FrntSideRdrRiDetn21RdrDetnChks 0;
BA_ "GenSigFuncType" SG_ 311 FrntSideRdrRiDetn21RdrDetnCntr 16;
BA_ "GenSigSendType" SG_ 311 FrntSideRdrRiDetn21RdrDetnCntr 0;
BA_ "GenSigSendType" SG_ 311 FrntSideRdrRiDetn21RdrDetnConf 0;
BA_ "GenSigSendType" SG_ 311 FrntSideRdrRiDetn21RdrDetnElevn 0;
BA_ "GenSigStartValue" SG_ 311 FrntSideRdrRiDetn21RdrDetnElevn 15;
BA_ "GenSigSendType" SG_ 311 FrntSideRdrRiDetn21RdrDetnPwr 0;
BA_ "GenSigSendType" SG_ 311 FrntSideRdrRiDetn21RdrDetnRng 0;
BA_ "GenSigStartValue" SG_ 311 FrntSideRdrRiDetn21RdrDetnRng 10050;
BA_ "GenSigSendType" SG_ 311 FrntSideRdrRiDetn21RdrDetnRngV 0;
BA_ "GenSigStartValue" SG_ 311 FrntSideRdrRiDetn21RdrDetnRngV 4000;
BA_ "GenSigSendType" SG_ 311 FrntSideRdrRiDetn21RdrDetnSts 0;
BA_ "GenSigStartValue" SG_ 311 FrntSideRdrRiDetn21RdrDetnSts 3;
BA_ "GenSigSendType" SG_ 311 FrntSideRdrRiDetn22RdrDetnAzi 0;
BA_ "GenSigStartValue" SG_ 311 FrntSideRdrRiDetn22RdrDetnAzi 900;
BA_ "GenSigDataID" SG_ 311 FrntSideRdrRiDetn22RdrDetnChks "0x8F8";
BA_ "GenSigFuncType" SG_ 311 FrntSideRdrRiDetn22RdrDetnChks 15;
BA_ "GenSigSendType" SG_ 311 FrntSideRdrRiDetn22RdrDetnChks 0;
BA_ "GenSigFuncType" SG_ 311 FrntSideRdrRiDetn22RdrDetnCntr 16;
BA_ "GenSigSendType" SG_ 311 FrntSideRdrRiDetn22RdrDetnCntr 0;
BA_ "GenSigSendType" SG_ 311 FrntSideRdrRiDetn22RdrDetnConf 0;
BA_ "GenSigSendType" SG_ 311 FrntSideRdrRiDetn22RdrDetnElevn 0;
BA_ "GenSigStartValue" SG_ 311 FrntSideRdrRiDetn22RdrDetnElevn 15;
BA_ "GenSigSendType" SG_ 311 FrntSideRdrRiDetn22RdrDetnPwr 0;
BA_ "GenSigSendType" SG_ 311 FrntSideRdrRiDetn22RdrDetnRng 0;
BA_ "GenSigStartValue" SG_ 311 FrntSideRdrRiDetn22RdrDetnRng 10050;
BA_ "GenSigSendType" SG_ 311 FrntSideRdrRiDetn22RdrDetnRngV 0;
BA_ "GenSigStartValue" SG_ 311 FrntSideRdrRiDetn22RdrDetnRngV 4000;
BA_ "GenSigSendType" SG_ 311 FrntSideRdrRiDetn22RdrDetnSts 0;
BA_ "GenSigStartValue" SG_ 311 FrntSideRdrRiDetn22RdrDetnSts 3;
BA_ "GenSigSendType" SG_ 311 FrntSideRdrRiDetn23RdrDetnAzi 0;
BA_ "GenSigStartValue" SG_ 311 FrntSideRdrRiDetn23RdrDetnAzi 900;
BA_ "GenSigDataID" SG_ 311 FrntSideRdrRiDetn23RdrDetnChks "0x8F9";
BA_ "GenSigFuncType" SG_ 311 FrntSideRdrRiDetn23RdrDetnChks 15;
BA_ "GenSigSendType" SG_ 311 FrntSideRdrRiDetn23RdrDetnChks 0;
BA_ "GenSigFuncType" SG_ 311 FrntSideRdrRiDetn23RdrDetnCntr 16;
BA_ "GenSigSendType" SG_ 311 FrntSideRdrRiDetn23RdrDetnCntr 0;
BA_ "GenSigSendType" SG_ 311 FrntSideRdrRiDetn23RdrDetnConf 0;
BA_ "GenSigSendType" SG_ 311 FrntSideRdrRiDetn23RdrDetnElevn 0;
BA_ "GenSigStartValue" SG_ 311 FrntSideRdrRiDetn23RdrDetnElevn 15;
BA_ "GenSigSendType" SG_ 311 FrntSideRdrRiDetn23RdrDetnPwr 0;
BA_ "GenSigSendType" SG_ 311 FrntSideRdrRiDetn23RdrDetnRng 0;
BA_ "GenSigStartValue" SG_ 311 FrntSideRdrRiDetn23RdrDetnRng 10050;
BA_ "GenSigSendType" SG_ 311 FrntSideRdrRiDetn23RdrDetnRngV 0;
BA_ "GenSigStartValue" SG_ 311 FrntSideRdrRiDetn23RdrDetnRngV 4000;
BA_ "GenSigSendType" SG_ 311 FrntSideRdrRiDetn23RdrDetnSts 0;
BA_ "GenSigStartValue" SG_ 311 FrntSideRdrRiDetn23RdrDetnSts 3;
BA_ "GenSigSendType" SG_ 311 FrntSideRdrRiDetn24RdrDetnAzi 0;
BA_ "GenSigStartValue" SG_ 311 FrntSideRdrRiDetn24RdrDetnAzi 900;
BA_ "GenSigDataID" SG_ 311 FrntSideRdrRiDetn24RdrDetnChks "0x8FA";
BA_ "GenSigFuncType" SG_ 311 FrntSideRdrRiDetn24RdrDetnChks 15;
BA_ "GenSigSendType" SG_ 311 FrntSideRdrRiDetn24RdrDetnChks 0;
BA_ "GenSigFuncType" SG_ 311 FrntSideRdrRiDetn24RdrDetnCntr 16;
BA_ "GenSigSendType" SG_ 311 FrntSideRdrRiDetn24RdrDetnCntr 0;
BA_ "GenSigSendType" SG_ 311 FrntSideRdrRiDetn24RdrDetnConf 0;
BA_ "GenSigSendType" SG_ 311 FrntSideRdrRiDetn24RdrDetnElevn 0;
BA_ "GenSigStartValue" SG_ 311 FrntSideRdrRiDetn24RdrDetnElevn 15;
BA_ "GenSigSendType" SG_ 311 FrntSideRdrRiDetn24RdrDetnPwr 0;
BA_ "GenSigSendType" SG_ 311 FrntSideRdrRiDetn24RdrDetnRng 0;
BA_ "GenSigStartValue" SG_ 311 FrntSideRdrRiDetn24RdrDetnRng 10050;
BA_ "GenSigSendType" SG_ 311 FrntSideRdrRiDetn24RdrDetnRngV 0;
BA_ "GenSigStartValue" SG_ 311 FrntSideRdrRiDetn24RdrDetnRngV 4000;
BA_ "GenSigSendType" SG_ 311 FrntSideRdrRiDetn24RdrDetnSts 0;
BA_ "GenSigStartValue" SG_ 311 FrntSideRdrRiDetn24RdrDetnSts 3;
BA_ "GenSigSendType" SG_ 313 FrntSideRdrRiDetn25RdrDetnAzi 0;
BA_ "GenSigStartValue" SG_ 313 FrntSideRdrRiDetn25RdrDetnAzi 900;
BA_ "GenSigDataID" SG_ 313 FrntSideRdrRiDetn25RdrDetnChks "0x8FB";
BA_ "GenSigFuncType" SG_ 313 FrntSideRdrRiDetn25RdrDetnChks 15;
BA_ "GenSigSendType" SG_ 313 FrntSideRdrRiDetn25RdrDetnChks 0;
BA_ "GenSigFuncType" SG_ 313 FrntSideRdrRiDetn25RdrDetnCntr 16;
BA_ "GenSigSendType" SG_ 313 FrntSideRdrRiDetn25RdrDetnCntr 0;
BA_ "GenSigSendType" SG_ 313 FrntSideRdrRiDetn25RdrDetnConf 0;
BA_ "GenSigSendType" SG_ 313 FrntSideRdrRiDetn25RdrDetnElevn 0;
BA_ "GenSigStartValue" SG_ 313 FrntSideRdrRiDetn25RdrDetnElevn 15;
BA_ "GenSigSendType" SG_ 313 FrntSideRdrRiDetn25RdrDetnPwr 0;
BA_ "GenSigSendType" SG_ 313 FrntSideRdrRiDetn25RdrDetnRng 0;
BA_ "GenSigStartValue" SG_ 313 FrntSideRdrRiDetn25RdrDetnRng 10050;
BA_ "GenSigSendType" SG_ 313 FrntSideRdrRiDetn25RdrDetnRngV 0;
BA_ "GenSigStartValue" SG_ 313 FrntSideRdrRiDetn25RdrDetnRngV 4000;
BA_ "GenSigSendType" SG_ 313 FrntSideRdrRiDetn25RdrDetnSts 0;
BA_ "GenSigStartValue" SG_ 313 FrntSideRdrRiDetn25RdrDetnSts 3;
BA_ "GenSigSendType" SG_ 313 FrntSideRdrRiDetn26RdrDetnAzi 0;
BA_ "GenSigStartValue" SG_ 313 FrntSideRdrRiDetn26RdrDetnAzi 900;
BA_ "GenSigDataID" SG_ 313 FrntSideRdrRiDetn26RdrDetnChks "0x8FC";
BA_ "GenSigFuncType" SG_ 313 FrntSideRdrRiDetn26RdrDetnChks 15;
BA_ "GenSigSendType" SG_ 313 FrntSideRdrRiDetn26RdrDetnChks 0;
BA_ "GenSigFuncType" SG_ 313 FrntSideRdrRiDetn26RdrDetnCntr 16;
BA_ "GenSigSendType" SG_ 313 FrntSideRdrRiDetn26RdrDetnCntr 0;
BA_ "GenSigSendType" SG_ 313 FrntSideRdrRiDetn26RdrDetnConf 0;
BA_ "GenSigSendType" SG_ 313 FrntSideRdrRiDetn26RdrDetnElevn 0;
BA_ "GenSigStartValue" SG_ 313 FrntSideRdrRiDetn26RdrDetnElevn 15;
BA_ "GenSigSendType" SG_ 313 FrntSideRdrRiDetn26RdrDetnPwr 0;
BA_ "GenSigSendType" SG_ 313 FrntSideRdrRiDetn26RdrDetnRng 0;
BA_ "GenSigStartValue" SG_ 313 FrntSideRdrRiDetn26RdrDetnRng 10050;
BA_ "GenSigSendType" SG_ 313 FrntSideRdrRiDetn26RdrDetnRngV 0;
BA_ "GenSigStartValue" SG_ 313 FrntSideRdrRiDetn26RdrDetnRngV 4000;
BA_ "GenSigSendType" SG_ 313 FrntSideRdrRiDetn26RdrDetnSts 0;
BA_ "GenSigStartValue" SG_ 313 FrntSideRdrRiDetn26RdrDetnSts 3;
BA_ "GenSigSendType" SG_ 313 FrntSideRdrRiDetn27RdrDetnAzi 0;
BA_ "GenSigStartValue" SG_ 313 FrntSideRdrRiDetn27RdrDetnAzi 900;
BA_ "GenSigDataID" SG_ 313 FrntSideRdrRiDetn27RdrDetnChks "0x8FD";
BA_ "GenSigFuncType" SG_ 313 FrntSideRdrRiDetn27RdrDetnChks 15;
BA_ "GenSigSendType" SG_ 313 FrntSideRdrRiDetn27RdrDetnChks 0;
BA_ "GenSigFuncType" SG_ 313 FrntSideRdrRiDetn27RdrDetnCntr 16;
BA_ "GenSigSendType" SG_ 313 FrntSideRdrRiDetn27RdrDetnCntr 0;
BA_ "GenSigSendType" SG_ 313 FrntSideRdrRiDetn27RdrDetnConf 0;
BA_ "GenSigSendType" SG_ 313 FrntSideRdrRiDetn27RdrDetnElevn 0;
BA_ "GenSigStartValue" SG_ 313 FrntSideRdrRiDetn27RdrDetnElevn 15;
BA_ "GenSigSendType" SG_ 313 FrntSideRdrRiDetn27RdrDetnPwr 0;
BA_ "GenSigSendType" SG_ 313 FrntSideRdrRiDetn27RdrDetnRng 0;
BA_ "GenSigStartValue" SG_ 313 FrntSideRdrRiDetn27RdrDetnRng 10050;
BA_ "GenSigSendType" SG_ 313 FrntSideRdrRiDetn27RdrDetnRngV 0;
BA_ "GenSigStartValue" SG_ 313 FrntSideRdrRiDetn27RdrDetnRngV 4000;
BA_ "GenSigSendType" SG_ 313 FrntSideRdrRiDetn27RdrDetnSts 0;
BA_ "GenSigStartValue" SG_ 313 FrntSideRdrRiDetn27RdrDetnSts 3;
BA_ "GenSigSendType" SG_ 313 FrntSideRdrRiDetn28RdrDetnAzi 0;
BA_ "GenSigStartValue" SG_ 313 FrntSideRdrRiDetn28RdrDetnAzi 900;
BA_ "GenSigDataID" SG_ 313 FrntSideRdrRiDetn28RdrDetnChks "0x8FE";
BA_ "GenSigFuncType" SG_ 313 FrntSideRdrRiDetn28RdrDetnChks 15;
BA_ "GenSigSendType" SG_ 313 FrntSideRdrRiDetn28RdrDetnChks 0;
BA_ "GenSigFuncType" SG_ 313 FrntSideRdrRiDetn28RdrDetnCntr 16;
BA_ "GenSigSendType" SG_ 313 FrntSideRdrRiDetn28RdrDetnCntr 0;
BA_ "GenSigSendType" SG_ 313 FrntSideRdrRiDetn28RdrDetnConf 0;
BA_ "GenSigSendType" SG_ 313 FrntSideRdrRiDetn28RdrDetnElevn 0;
BA_ "GenSigStartValue" SG_ 313 FrntSideRdrRiDetn28RdrDetnElevn 15;
BA_ "GenSigSendType" SG_ 313 FrntSideRdrRiDetn28RdrDetnPwr 0;
BA_ "GenSigSendType" SG_ 313 FrntSideRdrRiDetn28RdrDetnRng 0;
BA_ "GenSigStartValue" SG_ 313 FrntSideRdrRiDetn28RdrDetnRng 10050;
BA_ "GenSigSendType" SG_ 313 FrntSideRdrRiDetn28RdrDetnRngV 0;
BA_ "GenSigStartValue" SG_ 313 FrntSideRdrRiDetn28RdrDetnRngV 4000;
BA_ "GenSigSendType" SG_ 313 FrntSideRdrRiDetn28RdrDetnSts 0;
BA_ "GenSigStartValue" SG_ 313 FrntSideRdrRiDetn28RdrDetnSts 3;
BA_ "GenSigSendType" SG_ 313 FrntSideRdrRiDetn29RdrDetnAzi 0;
BA_ "GenSigStartValue" SG_ 313 FrntSideRdrRiDetn29RdrDetnAzi 900;
BA_ "GenSigDataID" SG_ 313 FrntSideRdrRiDetn29RdrDetnChks "0x8FF";
BA_ "GenSigFuncType" SG_ 313 FrntSideRdrRiDetn29RdrDetnChks 15;
BA_ "GenSigSendType" SG_ 313 FrntSideRdrRiDetn29RdrDetnChks 0;
BA_ "GenSigFuncType" SG_ 313 FrntSideRdrRiDetn29RdrDetnCntr 16;
BA_ "GenSigSendType" SG_ 313 FrntSideRdrRiDetn29RdrDetnCntr 0;
BA_ "GenSigSendType" SG_ 313 FrntSideRdrRiDetn29RdrDetnConf 0;
BA_ "GenSigSendType" SG_ 313 FrntSideRdrRiDetn29RdrDetnElevn 0;
BA_ "GenSigStartValue" SG_ 313 FrntSideRdrRiDetn29RdrDetnElevn 15;
BA_ "GenSigSendType" SG_ 313 FrntSideRdrRiDetn29RdrDetnPwr 0;
BA_ "GenSigSendType" SG_ 313 FrntSideRdrRiDetn29RdrDetnRng 0;
BA_ "GenSigStartValue" SG_ 313 FrntSideRdrRiDetn29RdrDetnRng 10050;
BA_ "GenSigSendType" SG_ 313 FrntSideRdrRiDetn29RdrDetnRngV 0;
BA_ "GenSigStartValue" SG_ 313 FrntSideRdrRiDetn29RdrDetnRngV 4000;
BA_ "GenSigSendType" SG_ 313 FrntSideRdrRiDetn29RdrDetnSts 0;
BA_ "GenSigStartValue" SG_ 313 FrntSideRdrRiDetn29RdrDetnSts 3;
BA_ "GenSigSendType" SG_ 305 FrntSideRdrRiDetn2RdrDetnAzi 0;
BA_ "GenSigStartValue" SG_ 305 FrntSideRdrRiDetn2RdrDetnAzi 900;
BA_ "GenSigDataID" SG_ 305 FrntSideRdrRiDetn2RdrDetnChks "0x8E4";
BA_ "GenSigFuncType" SG_ 305 FrntSideRdrRiDetn2RdrDetnChks 15;
BA_ "GenSigSendType" SG_ 305 FrntSideRdrRiDetn2RdrDetnChks 0;
BA_ "GenSigFuncType" SG_ 305 FrntSideRdrRiDetn2RdrDetnCntr 16;
BA_ "GenSigSendType" SG_ 305 FrntSideRdrRiDetn2RdrDetnCntr 0;
BA_ "GenSigSendType" SG_ 305 FrntSideRdrRiDetn2RdrDetnConf 0;
BA_ "GenSigSendType" SG_ 305 FrntSideRdrRiDetn2RdrDetnElevn 0;
BA_ "GenSigStartValue" SG_ 305 FrntSideRdrRiDetn2RdrDetnElevn 15;
BA_ "GenSigSendType" SG_ 305 FrntSideRdrRiDetn2RdrDetnPwr 0;
BA_ "GenSigSendType" SG_ 305 FrntSideRdrRiDetn2RdrDetnRng 0;
BA_ "GenSigStartValue" SG_ 305 FrntSideRdrRiDetn2RdrDetnRng 10050;
BA_ "GenSigSendType" SG_ 305 FrntSideRdrRiDetn2RdrDetnRngV 0;
BA_ "GenSigStartValue" SG_ 305 FrntSideRdrRiDetn2RdrDetnRngV 4000;
BA_ "GenSigSendType" SG_ 305 FrntSideRdrRiDetn2RdrDetnSts 0;
BA_ "GenSigStartValue" SG_ 305 FrntSideRdrRiDetn2RdrDetnSts 3;
BA_ "GenSigSendType" SG_ 313 FrntSideRdrRiDetn30RdrDetnAzi 0;
BA_ "GenSigStartValue" SG_ 313 FrntSideRdrRiDetn30RdrDetnAzi 900;
BA_ "GenSigDataID" SG_ 313 FrntSideRdrRiDetn30RdrDetnChks "0x900";
BA_ "GenSigFuncType" SG_ 313 FrntSideRdrRiDetn30RdrDetnChks 15;
BA_ "GenSigSendType" SG_ 313 FrntSideRdrRiDetn30RdrDetnChks 0;
BA_ "GenSigFuncType" SG_ 313 FrntSideRdrRiDetn30RdrDetnCntr 16;
BA_ "GenSigSendType" SG_ 313 FrntSideRdrRiDetn30RdrDetnCntr 0;
BA_ "GenSigSendType" SG_ 313 FrntSideRdrRiDetn30RdrDetnConf 0;
BA_ "GenSigSendType" SG_ 313 FrntSideRdrRiDetn30RdrDetnElevn 0;
BA_ "GenSigStartValue" SG_ 313 FrntSideRdrRiDetn30RdrDetnElevn 15;
BA_ "GenSigSendType" SG_ 313 FrntSideRdrRiDetn30RdrDetnPwr 0;
BA_ "GenSigSendType" SG_ 313 FrntSideRdrRiDetn30RdrDetnRng 0;
BA_ "GenSigStartValue" SG_ 313 FrntSideRdrRiDetn30RdrDetnRng 10050;
BA_ "GenSigSendType" SG_ 313 FrntSideRdrRiDetn30RdrDetnRngV 0;
BA_ "GenSigStartValue" SG_ 313 FrntSideRdrRiDetn30RdrDetnRngV 4000;
BA_ "GenSigSendType" SG_ 313 FrntSideRdrRiDetn30RdrDetnSts 0;
BA_ "GenSigStartValue" SG_ 313 FrntSideRdrRiDetn30RdrDetnSts 3;
BA_ "GenSigSendType" SG_ 315 FrntSideRdrRiDetn31RdrDetnAzi 0;
BA_ "GenSigStartValue" SG_ 315 FrntSideRdrRiDetn31RdrDetnAzi 900;
BA_ "GenSigDataID" SG_ 315 FrntSideRdrRiDetn31RdrDetnChks "0x901";
BA_ "GenSigFuncType" SG_ 315 FrntSideRdrRiDetn31RdrDetnChks 15;
BA_ "GenSigSendType" SG_ 315 FrntSideRdrRiDetn31RdrDetnChks 0;
BA_ "GenSigFuncType" SG_ 315 FrntSideRdrRiDetn31RdrDetnCntr 16;
BA_ "GenSigSendType" SG_ 315 FrntSideRdrRiDetn31RdrDetnCntr 0;
BA_ "GenSigSendType" SG_ 315 FrntSideRdrRiDetn31RdrDetnConf 0;
BA_ "GenSigSendType" SG_ 315 FrntSideRdrRiDetn31RdrDetnElevn 0;
BA_ "GenSigStartValue" SG_ 315 FrntSideRdrRiDetn31RdrDetnElevn 15;
BA_ "GenSigSendType" SG_ 315 FrntSideRdrRiDetn31RdrDetnPwr 0;
BA_ "GenSigSendType" SG_ 315 FrntSideRdrRiDetn31RdrDetnRng 0;
BA_ "GenSigStartValue" SG_ 315 FrntSideRdrRiDetn31RdrDetnRng 10050;
BA_ "GenSigSendType" SG_ 315 FrntSideRdrRiDetn31RdrDetnRngV 0;
BA_ "GenSigStartValue" SG_ 315 FrntSideRdrRiDetn31RdrDetnRngV 4000;
BA_ "GenSigSendType" SG_ 315 FrntSideRdrRiDetn31RdrDetnSts 0;
BA_ "GenSigStartValue" SG_ 315 FrntSideRdrRiDetn31RdrDetnSts 3;
BA_ "GenSigSendType" SG_ 315 FrntSideRdrRiDetn32RdrDetnAzi 0;
BA_ "GenSigStartValue" SG_ 315 FrntSideRdrRiDetn32RdrDetnAzi 900;
BA_ "GenSigDataID" SG_ 315 FrntSideRdrRiDetn32RdrDetnChks "0x902";
BA_ "GenSigFuncType" SG_ 315 FrntSideRdrRiDetn32RdrDetnChks 15;
BA_ "GenSigSendType" SG_ 315 FrntSideRdrRiDetn32RdrDetnChks 0;
BA_ "GenSigFuncType" SG_ 315 FrntSideRdrRiDetn32RdrDetnCntr 16;
BA_ "GenSigSendType" SG_ 315 FrntSideRdrRiDetn32RdrDetnCntr 0;
BA_ "GenSigSendType" SG_ 315 FrntSideRdrRiDetn32RdrDetnConf 0;
BA_ "GenSigSendType" SG_ 315 FrntSideRdrRiDetn32RdrDetnElevn 0;
BA_ "GenSigStartValue" SG_ 315 FrntSideRdrRiDetn32RdrDetnElevn 15;
BA_ "GenSigSendType" SG_ 315 FrntSideRdrRiDetn32RdrDetnPwr 0;
BA_ "GenSigSendType" SG_ 315 FrntSideRdrRiDetn32RdrDetnRng 0;
BA_ "GenSigStartValue" SG_ 315 FrntSideRdrRiDetn32RdrDetnRng 10050;
BA_ "GenSigSendType" SG_ 315 FrntSideRdrRiDetn32RdrDetnRngV 0;
BA_ "GenSigStartValue" SG_ 315 FrntSideRdrRiDetn32RdrDetnRngV 4000;
BA_ "GenSigSendType" SG_ 315 FrntSideRdrRiDetn32RdrDetnSts 0;
BA_ "GenSigStartValue" SG_ 315 FrntSideRdrRiDetn32RdrDetnSts 3;
BA_ "GenSigSendType" SG_ 315 FrntSideRdrRiDetn33RdrDetnAzi 0;
BA_ "GenSigStartValue" SG_ 315 FrntSideRdrRiDetn33RdrDetnAzi 900;
BA_ "GenSigDataID" SG_ 315 FrntSideRdrRiDetn33RdrDetnChks "0x903";
BA_ "GenSigFuncType" SG_ 315 FrntSideRdrRiDetn33RdrDetnChks 15;
BA_ "GenSigSendType" SG_ 315 FrntSideRdrRiDetn33RdrDetnChks 0;
BA_ "GenSigFuncType" SG_ 315 FrntSideRdrRiDetn33RdrDetnCntr 16;
BA_ "GenSigSendType" SG_ 315 FrntSideRdrRiDetn33RdrDetnCntr 0;
BA_ "GenSigSendType" SG_ 315 FrntSideRdrRiDetn33RdrDetnConf 0;
BA_ "GenSigSendType" SG_ 315 FrntSideRdrRiDetn33RdrDetnElevn 0;
BA_ "GenSigStartValue" SG_ 315 FrntSideRdrRiDetn33RdrDetnElevn 15;
BA_ "GenSigSendType" SG_ 315 FrntSideRdrRiDetn33RdrDetnPwr 0;
BA_ "GenSigSendType" SG_ 315 FrntSideRdrRiDetn33RdrDetnRng 0;
BA_ "GenSigStartValue" SG_ 315 FrntSideRdrRiDetn33RdrDetnRng 10050;
BA_ "GenSigSendType" SG_ 315 FrntSideRdrRiDetn33RdrDetnRngV 0;
BA_ "GenSigStartValue" SG_ 315 FrntSideRdrRiDetn33RdrDetnRngV 4000;
BA_ "GenSigSendType" SG_ 315 FrntSideRdrRiDetn33RdrDetnSts 0;
BA_ "GenSigStartValue" SG_ 315 FrntSideRdrRiDetn33RdrDetnSts 3;
BA_ "GenSigSendType" SG_ 315 FrntSideRdrRiDetn34RdrDetnAzi 0;
BA_ "GenSigStartValue" SG_ 315 FrntSideRdrRiDetn34RdrDetnAzi 900;
BA_ "GenSigDataID" SG_ 315 FrntSideRdrRiDetn34RdrDetnChks "0x904";
BA_ "GenSigFuncType" SG_ 315 FrntSideRdrRiDetn34RdrDetnChks 15;
BA_ "GenSigSendType" SG_ 315 FrntSideRdrRiDetn34RdrDetnChks 0;
BA_ "GenSigFuncType" SG_ 315 FrntSideRdrRiDetn34RdrDetnCntr 16;
BA_ "GenSigSendType" SG_ 315 FrntSideRdrRiDetn34RdrDetnCntr 0;
BA_ "GenSigSendType" SG_ 315 FrntSideRdrRiDetn34RdrDetnConf 0;
BA_ "GenSigSendType" SG_ 315 FrntSideRdrRiDetn34RdrDetnElevn 0;
BA_ "GenSigStartValue" SG_ 315 FrntSideRdrRiDetn34RdrDetnElevn 15;
BA_ "GenSigSendType" SG_ 315 FrntSideRdrRiDetn34RdrDetnPwr 0;
BA_ "GenSigSendType" SG_ 315 FrntSideRdrRiDetn34RdrDetnRng 0;
BA_ "GenSigStartValue" SG_ 315 FrntSideRdrRiDetn34RdrDetnRng 10050;
BA_ "GenSigSendType" SG_ 315 FrntSideRdrRiDetn34RdrDetnRngV 0;
BA_ "GenSigStartValue" SG_ 315 FrntSideRdrRiDetn34RdrDetnRngV 4000;
BA_ "GenSigSendType" SG_ 315 FrntSideRdrRiDetn34RdrDetnSts 0;
BA_ "GenSigStartValue" SG_ 315 FrntSideRdrRiDetn34RdrDetnSts 3;
BA_ "GenSigSendType" SG_ 315 FrntSideRdrRiDetn35RdrDetnAzi 0;
BA_ "GenSigStartValue" SG_ 315 FrntSideRdrRiDetn35RdrDetnAzi 900;
BA_ "GenSigDataID" SG_ 315 FrntSideRdrRiDetn35RdrDetnChks "0x905";
BA_ "GenSigFuncType" SG_ 315 FrntSideRdrRiDetn35RdrDetnChks 15;
BA_ "GenSigSendType" SG_ 315 FrntSideRdrRiDetn35RdrDetnChks 0;
BA_ "GenSigFuncType" SG_ 315 FrntSideRdrRiDetn35RdrDetnCntr 16;
BA_ "GenSigSendType" SG_ 315 FrntSideRdrRiDetn35RdrDetnCntr 0;
BA_ "GenSigSendType" SG_ 315 FrntSideRdrRiDetn35RdrDetnConf 0;
BA_ "GenSigSendType" SG_ 315 FrntSideRdrRiDetn35RdrDetnElevn 0;
BA_ "GenSigStartValue" SG_ 315 FrntSideRdrRiDetn35RdrDetnElevn 15;
BA_ "GenSigSendType" SG_ 315 FrntSideRdrRiDetn35RdrDetnPwr 0;
BA_ "GenSigSendType" SG_ 315 FrntSideRdrRiDetn35RdrDetnRng 0;
BA_ "GenSigStartValue" SG_ 315 FrntSideRdrRiDetn35RdrDetnRng 10050;
BA_ "GenSigSendType" SG_ 315 FrntSideRdrRiDetn35RdrDetnRngV 0;
BA_ "GenSigStartValue" SG_ 315 FrntSideRdrRiDetn35RdrDetnRngV 4000;
BA_ "GenSigSendType" SG_ 315 FrntSideRdrRiDetn35RdrDetnSts 0;
BA_ "GenSigStartValue" SG_ 315 FrntSideRdrRiDetn35RdrDetnSts 3;
BA_ "GenSigSendType" SG_ 315 FrntSideRdrRiDetn36RdrDetnAzi 0;
BA_ "GenSigStartValue" SG_ 315 FrntSideRdrRiDetn36RdrDetnAzi 900;
BA_ "GenSigDataID" SG_ 315 FrntSideRdrRiDetn36RdrDetnChks "0x906";
BA_ "GenSigFuncType" SG_ 315 FrntSideRdrRiDetn36RdrDetnChks 15;
BA_ "GenSigSendType" SG_ 315 FrntSideRdrRiDetn36RdrDetnChks 0;
BA_ "GenSigFuncType" SG_ 315 FrntSideRdrRiDetn36RdrDetnCntr 16;
BA_ "GenSigSendType" SG_ 315 FrntSideRdrRiDetn36RdrDetnCntr 0;
BA_ "GenSigSendType" SG_ 315 FrntSideRdrRiDetn36RdrDetnConf 0;
BA_ "GenSigSendType" SG_ 315 FrntSideRdrRiDetn36RdrDetnElevn 0;
BA_ "GenSigStartValue" SG_ 315 FrntSideRdrRiDetn36RdrDetnElevn 15;
BA_ "GenSigSendType" SG_ 315 FrntSideRdrRiDetn36RdrDetnPwr 0;
BA_ "GenSigSendType" SG_ 315 FrntSideRdrRiDetn36RdrDetnRng 0;
BA_ "GenSigStartValue" SG_ 315 FrntSideRdrRiDetn36RdrDetnRng 10050;
BA_ "GenSigSendType" SG_ 315 FrntSideRdrRiDetn36RdrDetnRngV 0;
BA_ "GenSigStartValue" SG_ 315 FrntSideRdrRiDetn36RdrDetnRngV 4000;
BA_ "GenSigSendType" SG_ 315 FrntSideRdrRiDetn36RdrDetnSts 0;
BA_ "GenSigStartValue" SG_ 315 FrntSideRdrRiDetn36RdrDetnSts 3;
BA_ "GenSigSendType" SG_ 317 FrntSideRdrRiDetn37RdrDetnAzi 0;
BA_ "GenSigStartValue" SG_ 317 FrntSideRdrRiDetn37RdrDetnAzi 900;
BA_ "GenSigDataID" SG_ 317 FrntSideRdrRiDetn37RdrDetnChks "0x907";
BA_ "GenSigFuncType" SG_ 317 FrntSideRdrRiDetn37RdrDetnChks 15;
BA_ "GenSigSendType" SG_ 317 FrntSideRdrRiDetn37RdrDetnChks 0;
BA_ "GenSigFuncType" SG_ 317 FrntSideRdrRiDetn37RdrDetnCntr 16;
BA_ "GenSigSendType" SG_ 317 FrntSideRdrRiDetn37RdrDetnCntr 0;
BA_ "GenSigSendType" SG_ 317 FrntSideRdrRiDetn37RdrDetnConf 0;
BA_ "GenSigSendType" SG_ 317 FrntSideRdrRiDetn37RdrDetnElevn 0;
BA_ "GenSigStartValue" SG_ 317 FrntSideRdrRiDetn37RdrDetnElevn 15;
BA_ "GenSigSendType" SG_ 317 FrntSideRdrRiDetn37RdrDetnPwr 0;
BA_ "GenSigSendType" SG_ 317 FrntSideRdrRiDetn37RdrDetnRng 0;
BA_ "GenSigStartValue" SG_ 317 FrntSideRdrRiDetn37RdrDetnRng 10050;
BA_ "GenSigSendType" SG_ 317 FrntSideRdrRiDetn37RdrDetnRngV 0;
BA_ "GenSigStartValue" SG_ 317 FrntSideRdrRiDetn37RdrDetnRngV 4000;
BA_ "GenSigSendType" SG_ 317 FrntSideRdrRiDetn37RdrDetnSts 0;
BA_ "GenSigStartValue" SG_ 317 FrntSideRdrRiDetn37RdrDetnSts 3;
BA_ "GenSigSendType" SG_ 317 FrntSideRdrRiDetn38RdrDetnAzi 0;
BA_ "GenSigStartValue" SG_ 317 FrntSideRdrRiDetn38RdrDetnAzi 900;
BA_ "GenSigDataID" SG_ 317 FrntSideRdrRiDetn38RdrDetnChks "0x908";
BA_ "GenSigFuncType" SG_ 317 FrntSideRdrRiDetn38RdrDetnChks 15;
BA_ "GenSigSendType" SG_ 317 FrntSideRdrRiDetn38RdrDetnChks 0;
BA_ "GenSigFuncType" SG_ 317 FrntSideRdrRiDetn38RdrDetnCntr 16;
BA_ "GenSigSendType" SG_ 317 FrntSideRdrRiDetn38RdrDetnCntr 0;
BA_ "GenSigSendType" SG_ 317 FrntSideRdrRiDetn38RdrDetnConf 0;
BA_ "GenSigSendType" SG_ 317 FrntSideRdrRiDetn38RdrDetnElevn 0;
BA_ "GenSigStartValue" SG_ 317 FrntSideRdrRiDetn38RdrDetnElevn 15;
BA_ "GenSigSendType" SG_ 317 FrntSideRdrRiDetn38RdrDetnPwr 0;
BA_ "GenSigSendType" SG_ 317 FrntSideRdrRiDetn38RdrDetnRng 0;
BA_ "GenSigStartValue" SG_ 317 FrntSideRdrRiDetn38RdrDetnRng 10050;
BA_ "GenSigSendType" SG_ 317 FrntSideRdrRiDetn38RdrDetnRngV 0;
BA_ "GenSigStartValue" SG_ 317 FrntSideRdrRiDetn38RdrDetnRngV 4000;
BA_ "GenSigSendType" SG_ 317 FrntSideRdrRiDetn38RdrDetnSts 0;
BA_ "GenSigStartValue" SG_ 317 FrntSideRdrRiDetn38RdrDetnSts 3;
BA_ "GenSigSendType" SG_ 317 FrntSideRdrRiDetn39RdrDetnAzi 0;
BA_ "GenSigStartValue" SG_ 317 FrntSideRdrRiDetn39RdrDetnAzi 900;
BA_ "GenSigDataID" SG_ 317 FrntSideRdrRiDetn39RdrDetnChks "0x909";
BA_ "GenSigFuncType" SG_ 317 FrntSideRdrRiDetn39RdrDetnChks 15;
BA_ "GenSigSendType" SG_ 317 FrntSideRdrRiDetn39RdrDetnChks 0;
BA_ "GenSigFuncType" SG_ 317 FrntSideRdrRiDetn39RdrDetnCntr 16;
BA_ "GenSigSendType" SG_ 317 FrntSideRdrRiDetn39RdrDetnCntr 0;
BA_ "GenSigSendType" SG_ 317 FrntSideRdrRiDetn39RdrDetnConf 0;
BA_ "GenSigSendType" SG_ 317 FrntSideRdrRiDetn39RdrDetnElevn 0;
BA_ "GenSigStartValue" SG_ 317 FrntSideRdrRiDetn39RdrDetnElevn 15;
BA_ "GenSigSendType" SG_ 317 FrntSideRdrRiDetn39RdrDetnPwr 0;
BA_ "GenSigSendType" SG_ 317 FrntSideRdrRiDetn39RdrDetnRng 0;
BA_ "GenSigStartValue" SG_ 317 FrntSideRdrRiDetn39RdrDetnRng 10050;
BA_ "GenSigSendType" SG_ 317 FrntSideRdrRiDetn39RdrDetnRngV 0;
BA_ "GenSigStartValue" SG_ 317 FrntSideRdrRiDetn39RdrDetnRngV 4000;
BA_ "GenSigSendType" SG_ 317 FrntSideRdrRiDetn39RdrDetnSts 0;
BA_ "GenSigStartValue" SG_ 317 FrntSideRdrRiDetn39RdrDetnSts 3;
BA_ "GenSigSendType" SG_ 305 FrntSideRdrRiDetn3RdrDetnAzi 0;
BA_ "GenSigStartValue" SG_ 305 FrntSideRdrRiDetn3RdrDetnAzi 900;
BA_ "GenSigDataID" SG_ 305 FrntSideRdrRiDetn3RdrDetnChks "0x8E5";
BA_ "GenSigFuncType" SG_ 305 FrntSideRdrRiDetn3RdrDetnChks 15;
BA_ "GenSigSendType" SG_ 305 FrntSideRdrRiDetn3RdrDetnChks 0;
BA_ "GenSigFuncType" SG_ 305 FrntSideRdrRiDetn3RdrDetnCntr 16;
BA_ "GenSigSendType" SG_ 305 FrntSideRdrRiDetn3RdrDetnCntr 0;
BA_ "GenSigSendType" SG_ 305 FrntSideRdrRiDetn3RdrDetnConf 0;
BA_ "GenSigSendType" SG_ 305 FrntSideRdrRiDetn3RdrDetnElevn 0;
BA_ "GenSigStartValue" SG_ 305 FrntSideRdrRiDetn3RdrDetnElevn 15;
BA_ "GenSigSendType" SG_ 305 FrntSideRdrRiDetn3RdrDetnPwr 0;
BA_ "GenSigSendType" SG_ 305 FrntSideRdrRiDetn3RdrDetnRng 0;
BA_ "GenSigStartValue" SG_ 305 FrntSideRdrRiDetn3RdrDetnRng 10050;
BA_ "GenSigSendType" SG_ 305 FrntSideRdrRiDetn3RdrDetnRngV 0;
BA_ "GenSigStartValue" SG_ 305 FrntSideRdrRiDetn3RdrDetnRngV 4000;
BA_ "GenSigSendType" SG_ 305 FrntSideRdrRiDetn3RdrDetnSts 0;
BA_ "GenSigStartValue" SG_ 305 FrntSideRdrRiDetn3RdrDetnSts 3;
BA_ "GenSigSendType" SG_ 317 FrntSideRdrRiDetn40RdrDetnAzi 0;
BA_ "GenSigStartValue" SG_ 317 FrntSideRdrRiDetn40RdrDetnAzi 900;
BA_ "GenSigDataID" SG_ 317 FrntSideRdrRiDetn40RdrDetnChks "0x90A";
BA_ "GenSigFuncType" SG_ 317 FrntSideRdrRiDetn40RdrDetnChks 15;
BA_ "GenSigSendType" SG_ 317 FrntSideRdrRiDetn40RdrDetnChks 0;
BA_ "GenSigFuncType" SG_ 317 FrntSideRdrRiDetn40RdrDetnCntr 16;
BA_ "GenSigSendType" SG_ 317 FrntSideRdrRiDetn40RdrDetnCntr 0;
BA_ "GenSigSendType" SG_ 317 FrntSideRdrRiDetn40RdrDetnConf 0;
BA_ "GenSigSendType" SG_ 317 FrntSideRdrRiDetn40RdrDetnElevn 0;
BA_ "GenSigStartValue" SG_ 317 FrntSideRdrRiDetn40RdrDetnElevn 15;
BA_ "GenSigSendType" SG_ 317 FrntSideRdrRiDetn40RdrDetnPwr 0;
BA_ "GenSigSendType" SG_ 317 FrntSideRdrRiDetn40RdrDetnRng 0;
BA_ "GenSigStartValue" SG_ 317 FrntSideRdrRiDetn40RdrDetnRng 10050;
BA_ "GenSigSendType" SG_ 317 FrntSideRdrRiDetn40RdrDetnRngV 0;
BA_ "GenSigStartValue" SG_ 317 FrntSideRdrRiDetn40RdrDetnRngV 4000;
BA_ "GenSigSendType" SG_ 317 FrntSideRdrRiDetn40RdrDetnSts 0;
BA_ "GenSigStartValue" SG_ 317 FrntSideRdrRiDetn40RdrDetnSts 3;
BA_ "GenSigSendType" SG_ 317 FrntSideRdrRiDetn41RdrDetnAzi 0;
BA_ "GenSigStartValue" SG_ 317 FrntSideRdrRiDetn41RdrDetnAzi 900;
BA_ "GenSigDataID" SG_ 317 FrntSideRdrRiDetn41RdrDetnChks "0x90B";
BA_ "GenSigFuncType" SG_ 317 FrntSideRdrRiDetn41RdrDetnChks 15;
BA_ "GenSigSendType" SG_ 317 FrntSideRdrRiDetn41RdrDetnChks 0;
BA_ "GenSigFuncType" SG_ 317 FrntSideRdrRiDetn41RdrDetnCntr 16;
BA_ "GenSigSendType" SG_ 317 FrntSideRdrRiDetn41RdrDetnCntr 0;
BA_ "GenSigSendType" SG_ 317 FrntSideRdrRiDetn41RdrDetnConf 0;
BA_ "GenSigSendType" SG_ 317 FrntSideRdrRiDetn41RdrDetnElevn 0;
BA_ "GenSigStartValue" SG_ 317 FrntSideRdrRiDetn41RdrDetnElevn 15;
BA_ "GenSigSendType" SG_ 317 FrntSideRdrRiDetn41RdrDetnPwr 0;
BA_ "GenSigSendType" SG_ 317 FrntSideRdrRiDetn41RdrDetnRng 0;
BA_ "GenSigStartValue" SG_ 317 FrntSideRdrRiDetn41RdrDetnRng 10050;
BA_ "GenSigSendType" SG_ 317 FrntSideRdrRiDetn41RdrDetnRngV 0;
BA_ "GenSigStartValue" SG_ 317 FrntSideRdrRiDetn41RdrDetnRngV 4000;
BA_ "GenSigSendType" SG_ 317 FrntSideRdrRiDetn41RdrDetnSts 0;
BA_ "GenSigStartValue" SG_ 317 FrntSideRdrRiDetn41RdrDetnSts 3;
BA_ "GenSigSendType" SG_ 317 FrntSideRdrRiDetn42RdrDetnAzi 0;
BA_ "GenSigStartValue" SG_ 317 FrntSideRdrRiDetn42RdrDetnAzi 900;
BA_ "GenSigDataID" SG_ 317 FrntSideRdrRiDetn42RdrDetnChks "0x90C";
BA_ "GenSigFuncType" SG_ 317 FrntSideRdrRiDetn42RdrDetnChks 15;
BA_ "GenSigSendType" SG_ 317 FrntSideRdrRiDetn42RdrDetnChks 0;
BA_ "GenSigFuncType" SG_ 317 FrntSideRdrRiDetn42RdrDetnCntr 16;
BA_ "GenSigSendType" SG_ 317 FrntSideRdrRiDetn42RdrDetnCntr 0;
BA_ "GenSigSendType" SG_ 317 FrntSideRdrRiDetn42RdrDetnConf 0;
BA_ "GenSigSendType" SG_ 317 FrntSideRdrRiDetn42RdrDetnElevn 0;
BA_ "GenSigStartValue" SG_ 317 FrntSideRdrRiDetn42RdrDetnElevn 15;
BA_ "GenSigSendType" SG_ 317 FrntSideRdrRiDetn42RdrDetnPwr 0;
BA_ "GenSigSendType" SG_ 317 FrntSideRdrRiDetn42RdrDetnRng 0;
BA_ "GenSigStartValue" SG_ 317 FrntSideRdrRiDetn42RdrDetnRng 10050;
BA_ "GenSigSendType" SG_ 317 FrntSideRdrRiDetn42RdrDetnRngV 0;
BA_ "GenSigStartValue" SG_ 317 FrntSideRdrRiDetn42RdrDetnRngV 4000;
BA_ "GenSigSendType" SG_ 317 FrntSideRdrRiDetn42RdrDetnSts 0;
BA_ "GenSigStartValue" SG_ 317 FrntSideRdrRiDetn42RdrDetnSts 3;
BA_ "GenSigSendType" SG_ 319 FrntSideRdrRiDetn43RdrDetnAzi 0;
BA_ "GenSigStartValue" SG_ 319 FrntSideRdrRiDetn43RdrDetnAzi 900;
BA_ "GenSigDataID" SG_ 319 FrntSideRdrRiDetn43RdrDetnChks "0x90D";
BA_ "GenSigFuncType" SG_ 319 FrntSideRdrRiDetn43RdrDetnChks 15;
BA_ "GenSigSendType" SG_ 319 FrntSideRdrRiDetn43RdrDetnChks 0;
BA_ "GenSigFuncType" SG_ 319 FrntSideRdrRiDetn43RdrDetnCntr 16;
BA_ "GenSigSendType" SG_ 319 FrntSideRdrRiDetn43RdrDetnCntr 0;
BA_ "GenSigSendType" SG_ 319 FrntSideRdrRiDetn43RdrDetnConf 0;
BA_ "GenSigSendType" SG_ 319 FrntSideRdrRiDetn43RdrDetnElevn 0;
BA_ "GenSigStartValue" SG_ 319 FrntSideRdrRiDetn43RdrDetnElevn 15;
BA_ "GenSigSendType" SG_ 319 FrntSideRdrRiDetn43RdrDetnPwr 0;
BA_ "GenSigSendType" SG_ 319 FrntSideRdrRiDetn43RdrDetnRng 0;
BA_ "GenSigStartValue" SG_ 319 FrntSideRdrRiDetn43RdrDetnRng 10050;
BA_ "GenSigSendType" SG_ 319 FrntSideRdrRiDetn43RdrDetnRngV 0;
BA_ "GenSigStartValue" SG_ 319 FrntSideRdrRiDetn43RdrDetnRngV 4000;
BA_ "GenSigSendType" SG_ 319 FrntSideRdrRiDetn43RdrDetnSts 0;
BA_ "GenSigStartValue" SG_ 319 FrntSideRdrRiDetn43RdrDetnSts 3;
BA_ "GenSigSendType" SG_ 319 FrntSideRdrRiDetn44RdrDetnAzi 0;
BA_ "GenSigStartValue" SG_ 319 FrntSideRdrRiDetn44RdrDetnAzi 900;
BA_ "GenSigDataID" SG_ 319 FrntSideRdrRiDetn44RdrDetnChks "0x90E";
BA_ "GenSigFuncType" SG_ 319 FrntSideRdrRiDetn44RdrDetnChks 15;
BA_ "GenSigSendType" SG_ 319 FrntSideRdrRiDetn44RdrDetnChks 0;
BA_ "GenSigFuncType" SG_ 319 FrntSideRdrRiDetn44RdrDetnCntr 16;
BA_ "GenSigSendType" SG_ 319 FrntSideRdrRiDetn44RdrDetnCntr 0;
BA_ "GenSigSendType" SG_ 319 FrntSideRdrRiDetn44RdrDetnConf 0;
BA_ "GenSigSendType" SG_ 319 FrntSideRdrRiDetn44RdrDetnElevn 0;
BA_ "GenSigStartValue" SG_ 319 FrntSideRdrRiDetn44RdrDetnElevn 15;
BA_ "GenSigSendType" SG_ 319 FrntSideRdrRiDetn44RdrDetnPwr 0;
BA_ "GenSigSendType" SG_ 319 FrntSideRdrRiDetn44RdrDetnRng 0;
BA_ "GenSigStartValue" SG_ 319 FrntSideRdrRiDetn44RdrDetnRng 10050;
BA_ "GenSigSendType" SG_ 319 FrntSideRdrRiDetn44RdrDetnRngV 0;
BA_ "GenSigStartValue" SG_ 319 FrntSideRdrRiDetn44RdrDetnRngV 4000;
BA_ "GenSigSendType" SG_ 319 FrntSideRdrRiDetn44RdrDetnSts 0;
BA_ "GenSigStartValue" SG_ 319 FrntSideRdrRiDetn44RdrDetnSts 3;
BA_ "GenSigSendType" SG_ 319 FrntSideRdrRiDetn45RdrDetnAzi 0;
BA_ "GenSigStartValue" SG_ 319 FrntSideRdrRiDetn45RdrDetnAzi 900;
BA_ "GenSigDataID" SG_ 319 FrntSideRdrRiDetn45RdrDetnChks "0x90F";
BA_ "GenSigFuncType" SG_ 319 FrntSideRdrRiDetn45RdrDetnChks 15;
BA_ "GenSigSendType" SG_ 319 FrntSideRdrRiDetn45RdrDetnChks 0;
BA_ "GenSigFuncType" SG_ 319 FrntSideRdrRiDetn45RdrDetnCntr 16;
BA_ "GenSigSendType" SG_ 319 FrntSideRdrRiDetn45RdrDetnCntr 0;
BA_ "GenSigSendType" SG_ 319 FrntSideRdrRiDetn45RdrDetnConf 0;
BA_ "GenSigSendType" SG_ 319 FrntSideRdrRiDetn45RdrDetnElevn 0;
BA_ "GenSigStartValue" SG_ 319 FrntSideRdrRiDetn45RdrDetnElevn 15;
BA_ "GenSigSendType" SG_ 319 FrntSideRdrRiDetn45RdrDetnPwr 0;
BA_ "GenSigSendType" SG_ 319 FrntSideRdrRiDetn45RdrDetnRng 0;
BA_ "GenSigStartValue" SG_ 319 FrntSideRdrRiDetn45RdrDetnRng 10050;
BA_ "GenSigSendType" SG_ 319 FrntSideRdrRiDetn45RdrDetnRngV 0;
BA_ "GenSigStartValue" SG_ 319 FrntSideRdrRiDetn45RdrDetnRngV 4000;
BA_ "GenSigSendType" SG_ 319 FrntSideRdrRiDetn45RdrDetnSts 0;
BA_ "GenSigStartValue" SG_ 319 FrntSideRdrRiDetn45RdrDetnSts 3;
BA_ "GenSigSendType" SG_ 319 FrntSideRdrRiDetn46RdrDetnAzi 0;
BA_ "GenSigStartValue" SG_ 319 FrntSideRdrRiDetn46RdrDetnAzi 900;
BA_ "GenSigDataID" SG_ 319 FrntSideRdrRiDetn46RdrDetnChks "0x910";
BA_ "GenSigFuncType" SG_ 319 FrntSideRdrRiDetn46RdrDetnChks 15;
BA_ "GenSigSendType" SG_ 319 FrntSideRdrRiDetn46RdrDetnChks 0;
BA_ "GenSigFuncType" SG_ 319 FrntSideRdrRiDetn46RdrDetnCntr 16;
BA_ "GenSigSendType" SG_ 319 FrntSideRdrRiDetn46RdrDetnCntr 0;
BA_ "GenSigSendType" SG_ 319 FrntSideRdrRiDetn46RdrDetnConf 0;
BA_ "GenSigSendType" SG_ 319 FrntSideRdrRiDetn46RdrDetnElevn 0;
BA_ "GenSigStartValue" SG_ 319 FrntSideRdrRiDetn46RdrDetnElevn 15;
BA_ "GenSigSendType" SG_ 319 FrntSideRdrRiDetn46RdrDetnPwr 0;
BA_ "GenSigSendType" SG_ 319 FrntSideRdrRiDetn46RdrDetnRng 0;
BA_ "GenSigStartValue" SG_ 319 FrntSideRdrRiDetn46RdrDetnRng 10050;
BA_ "GenSigSendType" SG_ 319 FrntSideRdrRiDetn46RdrDetnRngV 0;
BA_ "GenSigStartValue" SG_ 319 FrntSideRdrRiDetn46RdrDetnRngV 4000;
BA_ "GenSigSendType" SG_ 319 FrntSideRdrRiDetn46RdrDetnSts 0;
BA_ "GenSigStartValue" SG_ 319 FrntSideRdrRiDetn46RdrDetnSts 3;
BA_ "GenSigSendType" SG_ 319 FrntSideRdrRiDetn47RdrDetnAzi 0;
BA_ "GenSigStartValue" SG_ 319 FrntSideRdrRiDetn47RdrDetnAzi 900;
BA_ "GenSigDataID" SG_ 319 FrntSideRdrRiDetn47RdrDetnChks "0x911";
BA_ "GenSigFuncType" SG_ 319 FrntSideRdrRiDetn47RdrDetnChks 15;
BA_ "GenSigSendType" SG_ 319 FrntSideRdrRiDetn47RdrDetnChks 0;
BA_ "GenSigFuncType" SG_ 319 FrntSideRdrRiDetn47RdrDetnCntr 16;
BA_ "GenSigSendType" SG_ 319 FrntSideRdrRiDetn47RdrDetnCntr 0;
BA_ "GenSigSendType" SG_ 319 FrntSideRdrRiDetn47RdrDetnConf 0;
BA_ "GenSigSendType" SG_ 319 FrntSideRdrRiDetn47RdrDetnElevn 0;
BA_ "GenSigStartValue" SG_ 319 FrntSideRdrRiDetn47RdrDetnElevn 15;
BA_ "GenSigSendType" SG_ 319 FrntSideRdrRiDetn47RdrDetnPwr 0;
BA_ "GenSigSendType" SG_ 319 FrntSideRdrRiDetn47RdrDetnRng 0;
BA_ "GenSigStartValue" SG_ 319 FrntSideRdrRiDetn47RdrDetnRng 10050;
BA_ "GenSigSendType" SG_ 319 FrntSideRdrRiDetn47RdrDetnRngV 0;
BA_ "GenSigStartValue" SG_ 319 FrntSideRdrRiDetn47RdrDetnRngV 4000;
BA_ "GenSigSendType" SG_ 319 FrntSideRdrRiDetn47RdrDetnSts 0;
BA_ "GenSigStartValue" SG_ 319 FrntSideRdrRiDetn47RdrDetnSts 3;
BA_ "GenSigSendType" SG_ 319 FrntSideRdrRiDetn48RdrDetnAzi 0;
BA_ "GenSigStartValue" SG_ 319 FrntSideRdrRiDetn48RdrDetnAzi 900;
BA_ "GenSigDataID" SG_ 319 FrntSideRdrRiDetn48RdrDetnChks "0x912";
BA_ "GenSigFuncType" SG_ 319 FrntSideRdrRiDetn48RdrDetnChks 15;
BA_ "GenSigSendType" SG_ 319 FrntSideRdrRiDetn48RdrDetnChks 0;
BA_ "GenSigFuncType" SG_ 319 FrntSideRdrRiDetn48RdrDetnCntr 16;
BA_ "GenSigSendType" SG_ 319 FrntSideRdrRiDetn48RdrDetnCntr 0;
BA_ "GenSigSendType" SG_ 319 FrntSideRdrRiDetn48RdrDetnConf 0;
BA_ "GenSigSendType" SG_ 319 FrntSideRdrRiDetn48RdrDetnElevn 0;
BA_ "GenSigStartValue" SG_ 319 FrntSideRdrRiDetn48RdrDetnElevn 15;
BA_ "GenSigSendType" SG_ 319 FrntSideRdrRiDetn48RdrDetnPwr 0;
BA_ "GenSigSendType" SG_ 319 FrntSideRdrRiDetn48RdrDetnRng 0;
BA_ "GenSigStartValue" SG_ 319 FrntSideRdrRiDetn48RdrDetnRng 10050;
BA_ "GenSigSendType" SG_ 319 FrntSideRdrRiDetn48RdrDetnRngV 0;
BA_ "GenSigStartValue" SG_ 319 FrntSideRdrRiDetn48RdrDetnRngV 4000;
BA_ "GenSigSendType" SG_ 319 FrntSideRdrRiDetn48RdrDetnSts 0;
BA_ "GenSigStartValue" SG_ 319 FrntSideRdrRiDetn48RdrDetnSts 3;
BA_ "GenSigSendType" SG_ 305 FrntSideRdrRiDetn4RdrDetnAzi 0;
BA_ "GenSigStartValue" SG_ 305 FrntSideRdrRiDetn4RdrDetnAzi 900;
BA_ "GenSigDataID" SG_ 305 FrntSideRdrRiDetn4RdrDetnChks "0x8E6";
BA_ "GenSigFuncType" SG_ 305 FrntSideRdrRiDetn4RdrDetnChks 15;
BA_ "GenSigSendType" SG_ 305 FrntSideRdrRiDetn4RdrDetnChks 0;
BA_ "GenSigFuncType" SG_ 305 FrntSideRdrRiDetn4RdrDetnCntr 16;
BA_ "GenSigSendType" SG_ 305 FrntSideRdrRiDetn4RdrDetnCntr 0;
BA_ "GenSigSendType" SG_ 305 FrntSideRdrRiDetn4RdrDetnConf 0;
BA_ "GenSigSendType" SG_ 305 FrntSideRdrRiDetn4RdrDetnElevn 0;
BA_ "GenSigStartValue" SG_ 305 FrntSideRdrRiDetn4RdrDetnElevn 15;
BA_ "GenSigSendType" SG_ 305 FrntSideRdrRiDetn4RdrDetnPwr 0;
BA_ "GenSigSendType" SG_ 305 FrntSideRdrRiDetn4RdrDetnRng 0;
BA_ "GenSigStartValue" SG_ 305 FrntSideRdrRiDetn4RdrDetnRng 10050;
BA_ "GenSigSendType" SG_ 305 FrntSideRdrRiDetn4RdrDetnRngV 0;
BA_ "GenSigStartValue" SG_ 305 FrntSideRdrRiDetn4RdrDetnRngV 4000;
BA_ "GenSigSendType" SG_ 305 FrntSideRdrRiDetn4RdrDetnSts 0;
BA_ "GenSigStartValue" SG_ 305 FrntSideRdrRiDetn4RdrDetnSts 3;
BA_ "GenSigSendType" SG_ 305 FrntSideRdrRiDetn5RdrDetnAzi 0;
BA_ "GenSigStartValue" SG_ 305 FrntSideRdrRiDetn5RdrDetnAzi 900;
BA_ "GenSigDataID" SG_ 305 FrntSideRdrRiDetn5RdrDetnChks "0x8E7";
BA_ "GenSigFuncType" SG_ 305 FrntSideRdrRiDetn5RdrDetnChks 15;
BA_ "GenSigSendType" SG_ 305 FrntSideRdrRiDetn5RdrDetnChks 0;
BA_ "GenSigFuncType" SG_ 305 FrntSideRdrRiDetn5RdrDetnCntr 16;
BA_ "GenSigSendType" SG_ 305 FrntSideRdrRiDetn5RdrDetnCntr 0;
BA_ "GenSigSendType" SG_ 305 FrntSideRdrRiDetn5RdrDetnConf 0;
BA_ "GenSigSendType" SG_ 305 FrntSideRdrRiDetn5RdrDetnElevn 0;
BA_ "GenSigStartValue" SG_ 305 FrntSideRdrRiDetn5RdrDetnElevn 15;
BA_ "GenSigSendType" SG_ 305 FrntSideRdrRiDetn5RdrDetnPwr 0;
BA_ "GenSigSendType" SG_ 305 FrntSideRdrRiDetn5RdrDetnRng 0;
BA_ "GenSigStartValue" SG_ 305 FrntSideRdrRiDetn5RdrDetnRng 10050;
BA_ "GenSigSendType" SG_ 305 FrntSideRdrRiDetn5RdrDetnRngV 0;
BA_ "GenSigStartValue" SG_ 305 FrntSideRdrRiDetn5RdrDetnRngV 4000;
BA_ "GenSigSendType" SG_ 305 FrntSideRdrRiDetn5RdrDetnSts 0;
BA_ "GenSigStartValue" SG_ 305 FrntSideRdrRiDetn5RdrDetnSts 3;
BA_ "GenSigSendType" SG_ 305 FrntSideRdrRiDetn6RdrDetnAzi 0;
BA_ "GenSigStartValue" SG_ 305 FrntSideRdrRiDetn6RdrDetnAzi 900;
BA_ "GenSigDataID" SG_ 305 FrntSideRdrRiDetn6RdrDetnChks "0x8E8";
BA_ "GenSigFuncType" SG_ 305 FrntSideRdrRiDetn6RdrDetnChks 15;
BA_ "GenSigSendType" SG_ 305 FrntSideRdrRiDetn6RdrDetnChks 0;
BA_ "GenSigFuncType" SG_ 305 FrntSideRdrRiDetn6RdrDetnCntr 16;
BA_ "GenSigSendType" SG_ 305 FrntSideRdrRiDetn6RdrDetnCntr 0;
BA_ "GenSigSendType" SG_ 305 FrntSideRdrRiDetn6RdrDetnConf 0;
BA_ "GenSigSendType" SG_ 305 FrntSideRdrRiDetn6RdrDetnElevn 0;
BA_ "GenSigStartValue" SG_ 305 FrntSideRdrRiDetn6RdrDetnElevn 15;
BA_ "GenSigSendType" SG_ 305 FrntSideRdrRiDetn6RdrDetnPwr 0;
BA_ "GenSigSendType" SG_ 305 FrntSideRdrRiDetn6RdrDetnRng 0;
BA_ "GenSigStartValue" SG_ 305 FrntSideRdrRiDetn6RdrDetnRng 10050;
BA_ "GenSigSendType" SG_ 305 FrntSideRdrRiDetn6RdrDetnRngV 0;
BA_ "GenSigStartValue" SG_ 305 FrntSideRdrRiDetn6RdrDetnRngV 4000;
BA_ "GenSigSendType" SG_ 305 FrntSideRdrRiDetn6RdrDetnSts 0;
BA_ "GenSigStartValue" SG_ 305 FrntSideRdrRiDetn6RdrDetnSts 3;
BA_ "GenSigSendType" SG_ 307 FrntSideRdrRiDetn7RdrDetnAzi 0;
BA_ "GenSigStartValue" SG_ 307 FrntSideRdrRiDetn7RdrDetnAzi 900;
BA_ "GenSigDataID" SG_ 307 FrntSideRdrRiDetn7RdrDetnChks "0x8E9";
BA_ "GenSigFuncType" SG_ 307 FrntSideRdrRiDetn7RdrDetnChks 15;
BA_ "GenSigSendType" SG_ 307 FrntSideRdrRiDetn7RdrDetnChks 0;
BA_ "GenSigFuncType" SG_ 307 FrntSideRdrRiDetn7RdrDetnCntr 16;
BA_ "GenSigSendType" SG_ 307 FrntSideRdrRiDetn7RdrDetnCntr 0;
BA_ "GenSigSendType" SG_ 307 FrntSideRdrRiDetn7RdrDetnConf 0;
BA_ "GenSigSendType" SG_ 307 FrntSideRdrRiDetn7RdrDetnElevn 0;
BA_ "GenSigStartValue" SG_ 307 FrntSideRdrRiDetn7RdrDetnElevn 15;
BA_ "GenSigSendType" SG_ 307 FrntSideRdrRiDetn7RdrDetnPwr 0;
BA_ "GenSigSendType" SG_ 307 FrntSideRdrRiDetn7RdrDetnRng 0;
BA_ "GenSigStartValue" SG_ 307 FrntSideRdrRiDetn7RdrDetnRng 10050;
BA_ "GenSigSendType" SG_ 307 FrntSideRdrRiDetn7RdrDetnRngV 0;
BA_ "GenSigStartValue" SG_ 307 FrntSideRdrRiDetn7RdrDetnRngV 4000;
BA_ "GenSigSendType" SG_ 307 FrntSideRdrRiDetn7RdrDetnSts 0;
BA_ "GenSigStartValue" SG_ 307 FrntSideRdrRiDetn7RdrDetnSts 3;
BA_ "GenSigSendType" SG_ 307 FrntSideRdrRiDetn8RdrDetnAzi 0;
BA_ "GenSigStartValue" SG_ 307 FrntSideRdrRiDetn8RdrDetnAzi 900;
BA_ "GenSigDataID" SG_ 307 FrntSideRdrRiDetn8RdrDetnChks "0x8EA";
BA_ "GenSigFuncType" SG_ 307 FrntSideRdrRiDetn8RdrDetnChks 15;
BA_ "GenSigSendType" SG_ 307 FrntSideRdrRiDetn8RdrDetnChks 0;
BA_ "GenSigFuncType" SG_ 307 FrntSideRdrRiDetn8RdrDetnCntr 16;
BA_ "GenSigSendType" SG_ 307 FrntSideRdrRiDetn8RdrDetnCntr 0;
BA_ "GenSigSendType" SG_ 307 FrntSideRdrRiDetn8RdrDetnConf 0;
BA_ "GenSigSendType" SG_ 307 FrntSideRdrRiDetn8RdrDetnElevn 0;
BA_ "GenSigStartValue" SG_ 307 FrntSideRdrRiDetn8RdrDetnElevn 15;
BA_ "GenSigSendType" SG_ 307 FrntSideRdrRiDetn8RdrDetnPwr 0;
BA_ "GenSigSendType" SG_ 307 FrntSideRdrRiDetn8RdrDetnRng 0;
BA_ "GenSigStartValue" SG_ 307 FrntSideRdrRiDetn8RdrDetnRng 10050;
BA_ "GenSigSendType" SG_ 307 FrntSideRdrRiDetn8RdrDetnRngV 0;
BA_ "GenSigStartValue" SG_ 307 FrntSideRdrRiDetn8RdrDetnRngV 4000;
BA_ "GenSigSendType" SG_ 307 FrntSideRdrRiDetn8RdrDetnSts 0;
BA_ "GenSigStartValue" SG_ 307 FrntSideRdrRiDetn8RdrDetnSts 3;
BA_ "GenSigSendType" SG_ 307 FrntSideRdrRiDetn9RdrDetnAzi 0;
BA_ "GenSigStartValue" SG_ 307 FrntSideRdrRiDetn9RdrDetnAzi 900;
BA_ "GenSigDataID" SG_ 307 FrntSideRdrRiDetn9RdrDetnChks "0x8EB";
BA_ "GenSigFuncType" SG_ 307 FrntSideRdrRiDetn9RdrDetnChks 15;
BA_ "GenSigSendType" SG_ 307 FrntSideRdrRiDetn9RdrDetnChks 0;
BA_ "GenSigFuncType" SG_ 307 FrntSideRdrRiDetn9RdrDetnCntr 16;
BA_ "GenSigSendType" SG_ 307 FrntSideRdrRiDetn9RdrDetnCntr 0;
BA_ "GenSigSendType" SG_ 307 FrntSideRdrRiDetn9RdrDetnConf 0;
BA_ "GenSigSendType" SG_ 307 FrntSideRdrRiDetn9RdrDetnElevn 0;
BA_ "GenSigStartValue" SG_ 307 FrntSideRdrRiDetn9RdrDetnElevn 15;
BA_ "GenSigSendType" SG_ 307 FrntSideRdrRiDetn9RdrDetnPwr 0;
BA_ "GenSigSendType" SG_ 307 FrntSideRdrRiDetn9RdrDetnRng 0;
BA_ "GenSigStartValue" SG_ 307 FrntSideRdrRiDetn9RdrDetnRng 10050;
BA_ "GenSigSendType" SG_ 307 FrntSideRdrRiDetn9RdrDetnRngV 0;
BA_ "GenSigStartValue" SG_ 307 FrntSideRdrRiDetn9RdrDetnRngV 4000;
BA_ "GenSigSendType" SG_ 307 FrntSideRdrRiDetn9RdrDetnSts 0;
BA_ "GenSigStartValue" SG_ 307 FrntSideRdrRiDetn9RdrDetnSts 3;
BA_ "GenSigSendType" SG_ 302 FrntSideRdrRiStsForDim 0;
BA_ "GenSigStartValue" SG_ 302 FrntSideRdrRiStsForDim 1;
BA_ "GenSigSendType" SG_ 302 FrntSideRdrRiStsRdrNrDetn 0;
BA_ "GenSigSendType" SG_ 302 FrntSideRdrRiStsRdrNrObj 0;
BA_ "GenSigSendType" SG_ 302 FrntSideRdrRiStsRdrStsBlkd0bin 0;
BA_ "GenSigSendType" SG_ 302 FrntSideRdrRiStsRdrStsBlkdConf 0;
BA_ "GenSigDataID" SG_ 302 FrntSideRdrRiStsRdrStsChks "0x990";
BA_ "GenSigFuncType" SG_ 302 FrntSideRdrRiStsRdrStsChks 15;
BA_ "GenSigSendType" SG_ 302 FrntSideRdrRiStsRdrStsChks 0;
BA_ "GenSigFuncType" SG_ 302 FrntSideRdrRiStsRdrStsCntr 16;
BA_ "GenSigSendType" SG_ 302 FrntSideRdrRiStsRdrStsCntr 0;
BA_ "GenSigSendType" SG_ 302 FrntSideRdrRiStsRdrStsDstbc 0;
BA_ "GenSigSendType" SG_ 302 FrntSideRdrRiStsRdrStsEna 0;
BA_ "GenSigSendType" SG_ 302 FrntSideRdrRiStsRdrStsFaulty 0;
BA_ "GenSigSendType" SG_ 302 FrntSideRdrRiStsRdrStsIfVersMajor 0;
BA_ "GenSigSendType" SG_ 302 FrntSideRdrRiStsRdrStsIfVersMinor 0;
BA_ "GenSigSendType" SG_ 302 FrntSideRdrRiStsRdrStsLatency 0;
BA_ "GenSigStartValue" SG_ 302 FrntSideRdrRiStsRdrStsLatency 65535;
BA_ "GenSigSendType" SG_ 302 FrntSideRdrRiStsRdrStsMisAlign 0;
BA_ "GenSigSendType" SG_ 302 FrntSideRdrRiStsRdrStsMissCom 0;
BA_ "GenSigSendType" SG_ 302 FrntSideRdrRiStsRdrStsSftyFlt 0;
BA_ "GenSigStartValue" SG_ 302 FrntSideRdrRiStsRdrStsSftyFlt 1;
BA_ "GenSigSendType" SG_ 302 FrntSideRdrRiStsRdrStsTiStamp 0;
BA_ "GenSigSendType" SG_ 302 FrntSideRdrRiStsRdrStsTiStampStsGlbTiBas 0;
BA_ "GenSigSendType" SG_ 302 FrntSideRdrRiStsRdrStsTiStampStsSyncToGatewy 0;
BA_ "GenSigSendType" SG_ 302 FrntSideRdrRiStsRdrStsTiStampStsTiLeap 0;
BA_ "GenSigSendType" SG_ 302 FrntSideRdrRiStsRdrStsTiStampStsTiOut 0;
BA_ "GenSigSendType" SG_ 302 FrntSideRdrRiStsRdrStsWhlSpdCmpFac 0;
BA_ "GenSigStartValue" SG_ 302 FrntSideRdrRiStsRdrStsWhlSpdCmpFac 16;
VAL_ 302 FrntSideRdrRiStsForDim 0 "RsdsMstSt_Cfg" 1 "RsdsMstSt_StrtUp" 2 "RsdsMstSt_Runng" 3 "RsdsMstSt_Blkd" 4 "RsdsMstSt_Faulty" 5 "RsdsMstSt_Shutdown" 6 "RsdsMstSt_Hot" 7 "RsdsMstSt_Cal";
VAL_ 302 FrntSideRdrRiStsRdrStsBlkd0bin 0 "YesNo2_No" 1 "YesNo2_Yes";
VAL_ 302 FrntSideRdrRiStsRdrStsEna 0 "YesNo2_No" 1 "YesNo2_Yes";
VAL_ 302 FrntSideRdrRiStsRdrStsFaulty 0 "YesNo2_No" 1 "YesNo2_Yes";
VAL_ 302 FrntSideRdrRiStsRdrStsMisAlign 0 "MisAlign_CalibrationNotStart" 1 "MisAlign_SuccessfullyCalibratedInFactoryOrAftersales" 2 "MisAlign_SuccessfullyAutoCalibrated" 3 "MisAlign_MisalignmentDegreeIsLargerThanThreshold_StaticCalibrationFail" 4 "MisAlign_CanNotBeCalibratedStaticallyCauseOtherReason" 5 "MisAlign_AutoCalibrateFail_CauseMisalignmentDegreeIsLargerThanThresholdOrOtherReason" 6 "MisAlign_MisalignmentDegreeIsLargerThanThreshold_DynamicCalibrationFailInFactoryOrAftersales" 7 "MisAlign_CanNotBeCalibratedDynamicallyCauseOtherReason";
VAL_ 302 FrntSideRdrRiStsRdrStsMissCom 0 "YesNo2_No" 1 "YesNo2_Yes";
VAL_ 302 FrntSideRdrRiStsRdrStsSftyFlt 0 "SftyFlt_Undefined" 1 "SftyFlt_NoSafetyFault" 2 "SftyFlt_SafetyFault" 3 "SftyFlt_Reserved";
VAL_ 302 FrntSideRdrRiStsRdrStsTiStampStsGlbTiBas 0 "YesNo2_No" 1 "YesNo2_Yes";
VAL_ 302 FrntSideRdrRiStsRdrStsTiStampStsSyncToGatewy 0 "YesNo2_No" 1 "YesNo2_Yes";
VAL_ 302 FrntSideRdrRiStsRdrStsTiStampStsTiLeap 0 "YesNo2_No" 1 "YesNo2_Yes";
VAL_ 302 FrntSideRdrRiStsRdrStsTiStampStsTiOut 0 "YesNo2_No" 1 "YesNo2_Yes";
VAL_ 305 FrntSideRdrRiDetn1RdrDetnSts 0 "RdrDetnSts_Ukwn" 1 "RdrDetnSts_Movg" 2 "RdrDetnSts_Staty" 3 "RdrDetnSts_Invalid";
VAL_ 305 FrntSideRdrRiDetn2RdrDetnSts 0 "RdrDetnSts_Ukwn" 1 "RdrDetnSts_Movg" 2 "RdrDetnSts_Staty" 3 "RdrDetnSts_Invalid";
VAL_ 305 FrntSideRdrRiDetn3RdrDetnSts 0 "RdrDetnSts_Ukwn" 1 "RdrDetnSts_Movg" 2 "RdrDetnSts_Staty" 3 "RdrDetnSts_Invalid";
VAL_ 305 FrntSideRdrRiDetn4RdrDetnSts 0 "RdrDetnSts_Ukwn" 1 "RdrDetnSts_Movg" 2 "RdrDetnSts_Staty" 3 "RdrDetnSts_Invalid";
VAL_ 305 FrntSideRdrRiDetn5RdrDetnSts 0 "RdrDetnSts_Ukwn" 1 "RdrDetnSts_Movg" 2 "RdrDetnSts_Staty" 3 "RdrDetnSts_Invalid";
VAL_ 305 FrntSideRdrRiDetn6RdrDetnSts 0 "RdrDetnSts_Ukwn" 1 "RdrDetnSts_Movg" 2 "RdrDetnSts_Staty" 3 "RdrDetnSts_Invalid";
VAL_ 307 FrntSideRdrRiDetn10RdrDetnSts 0 "RdrDetnSts_Ukwn" 1 "RdrDetnSts_Movg" 2 "RdrDetnSts_Staty" 3 "RdrDetnSts_Invalid";
VAL_ 307 FrntSideRdrRiDetn11RdrDetnSts 0 "RdrDetnSts_Ukwn" 1 "RdrDetnSts_Movg" 2 "RdrDetnSts_Staty" 3 "RdrDetnSts_Invalid";
VAL_ 307 FrntSideRdrRiDetn12RdrDetnSts 0 "RdrDetnSts_Ukwn" 1 "RdrDetnSts_Movg" 2 "RdrDetnSts_Staty" 3 "RdrDetnSts_Invalid";
VAL_ 307 FrntSideRdrRiDetn7RdrDetnSts 0 "RdrDetnSts_Ukwn" 1 "RdrDetnSts_Movg" 2 "RdrDetnSts_Staty" 3 "RdrDetnSts_Invalid";
VAL_ 307 FrntSideRdrRiDetn8RdrDetnSts 0 "RdrDetnSts_Ukwn" 1 "RdrDetnSts_Movg" 2 "RdrDetnSts_Staty" 3 "RdrDetnSts_Invalid";
VAL_ 307 FrntSideRdrRiDetn9RdrDetnSts 0 "RdrDetnSts_Ukwn" 1 "RdrDetnSts_Movg" 2 "RdrDetnSts_Staty" 3 "RdrDetnSts_Invalid";
VAL_ 309 FrntSideRdrRiDetn13RdrDetnSts 0 "RdrDetnSts_Ukwn" 1 "RdrDetnSts_Movg" 2 "RdrDetnSts_Staty" 3 "RdrDetnSts_Invalid";
VAL_ 309 FrntSideRdrRiDetn14RdrDetnSts 0 "RdrDetnSts_Ukwn" 1 "RdrDetnSts_Movg" 2 "RdrDetnSts_Staty" 3 "RdrDetnSts_Invalid";
VAL_ 309 FrntSideRdrRiDetn15RdrDetnSts 0 "RdrDetnSts_Ukwn" 1 "RdrDetnSts_Movg" 2 "RdrDetnSts_Staty" 3 "RdrDetnSts_Invalid";
VAL_ 309 FrntSideRdrRiDetn16RdrDetnSts 0 "RdrDetnSts_Ukwn" 1 "RdrDetnSts_Movg" 2 "RdrDetnSts_Staty" 3 "RdrDetnSts_Invalid";
VAL_ 309 FrntSideRdrRiDetn17RdrDetnSts 0 "RdrDetnSts_Ukwn" 1 "RdrDetnSts_Movg" 2 "RdrDetnSts_Staty" 3 "RdrDetnSts_Invalid";
VAL_ 309 FrntSideRdrRiDetn18RdrDetnSts 0 "RdrDetnSts_Ukwn" 1 "RdrDetnSts_Movg" 2 "RdrDetnSts_Staty" 3 "RdrDetnSts_Invalid";
VAL_ 311 FrntSideRdrRiDetn19RdrDetnSts 0 "RdrDetnSts_Ukwn" 1 "RdrDetnSts_Movg" 2 "RdrDetnSts_Staty" 3 "RdrDetnSts_Invalid";
VAL_ 311 FrntSideRdrRiDetn20RdrDetnSts 0 "RdrDetnSts_Ukwn" 1 "RdrDetnSts_Movg" 2 "RdrDetnSts_Staty" 3 "RdrDetnSts_Invalid";
VAL_ 311 FrntSideRdrRiDetn21RdrDetnSts 0 "RdrDetnSts_Ukwn" 1 "RdrDetnSts_Movg" 2 "RdrDetnSts_Staty" 3 "RdrDetnSts_Invalid";
VAL_ 311 FrntSideRdrRiDetn22RdrDetnSts 0 "RdrDetnSts_Ukwn" 1 "RdrDetnSts_Movg" 2 "RdrDetnSts_Staty" 3 "RdrDetnSts_Invalid";
VAL_ 311 FrntSideRdrRiDetn23RdrDetnSts 0 "RdrDetnSts_Ukwn" 1 "RdrDetnSts_Movg" 2 "RdrDetnSts_Staty" 3 "RdrDetnSts_Invalid";
VAL_ 311 FrntSideRdrRiDetn24RdrDetnSts 0 "RdrDetnSts_Ukwn" 1 "RdrDetnSts_Movg" 2 "RdrDetnSts_Staty" 3 "RdrDetnSts_Invalid";
VAL_ 313 FrntSideRdrRiDetn25RdrDetnSts 0 "RdrDetnSts_Ukwn" 1 "RdrDetnSts_Movg" 2 "RdrDetnSts_Staty" 3 "RdrDetnSts_Invalid";
VAL_ 313 FrntSideRdrRiDetn26RdrDetnSts 0 "RdrDetnSts_Ukwn" 1 "RdrDetnSts_Movg" 2 "RdrDetnSts_Staty" 3 "RdrDetnSts_Invalid";
VAL_ 313 FrntSideRdrRiDetn27RdrDetnSts 0 "RdrDetnSts_Ukwn" 1 "RdrDetnSts_Movg" 2 "RdrDetnSts_Staty" 3 "RdrDetnSts_Invalid";
VAL_ 313 FrntSideRdrRiDetn28RdrDetnSts 0 "RdrDetnSts_Ukwn" 1 "RdrDetnSts_Movg" 2 "RdrDetnSts_Staty" 3 "RdrDetnSts_Invalid";
VAL_ 313 FrntSideRdrRiDetn29RdrDetnSts 0 "RdrDetnSts_Ukwn" 1 "RdrDetnSts_Movg" 2 "RdrDetnSts_Staty" 3 "RdrDetnSts_Invalid";
VAL_ 313 FrntSideRdrRiDetn30RdrDetnSts 0 "RdrDetnSts_Ukwn" 1 "RdrDetnSts_Movg" 2 "RdrDetnSts_Staty" 3 "RdrDetnSts_Invalid";
VAL_ 315 FrntSideRdrRiDetn31RdrDetnSts 0 "RdrDetnSts_Ukwn" 1 "RdrDetnSts_Movg" 2 "RdrDetnSts_Staty" 3 "RdrDetnSts_Invalid";
VAL_ 315 FrntSideRdrRiDetn32RdrDetnSts 0 "RdrDetnSts_Ukwn" 1 "RdrDetnSts_Movg" 2 "RdrDetnSts_Staty" 3 "RdrDetnSts_Invalid";
VAL_ 315 FrntSideRdrRiDetn33RdrDetnSts 0 "RdrDetnSts_Ukwn" 1 "RdrDetnSts_Movg" 2 "RdrDetnSts_Staty" 3 "RdrDetnSts_Invalid";
VAL_ 315 FrntSideRdrRiDetn34RdrDetnSts 0 "RdrDetnSts_Ukwn" 1 "RdrDetnSts_Movg" 2 "RdrDetnSts_Staty" 3 "RdrDetnSts_Invalid";
VAL_ 315 FrntSideRdrRiDetn35RdrDetnSts 0 "RdrDetnSts_Ukwn" 1 "RdrDetnSts_Movg" 2 "RdrDetnSts_Staty" 3 "RdrDetnSts_Invalid";
VAL_ 315 FrntSideRdrRiDetn36RdrDetnSts 0 "RdrDetnSts_Ukwn" 1 "RdrDetnSts_Movg" 2 "RdrDetnSts_Staty" 3 "RdrDetnSts_Invalid";
VAL_ 317 FrntSideRdrRiDetn37RdrDetnSts 0 "RdrDetnSts_Ukwn" 1 "RdrDetnSts_Movg" 2 "RdrDetnSts_Staty" 3 "RdrDetnSts_Invalid";
VAL_ 317 FrntSideRdrRiDetn38RdrDetnSts 0 "RdrDetnSts_Ukwn" 1 "RdrDetnSts_Movg" 2 "RdrDetnSts_Staty" 3 "RdrDetnSts_Invalid";
VAL_ 317 FrntSideRdrRiDetn39RdrDetnSts 0 "RdrDetnSts_Ukwn" 1 "RdrDetnSts_Movg" 2 "RdrDetnSts_Staty" 3 "RdrDetnSts_Invalid";
VAL_ 317 FrntSideRdrRiDetn40RdrDetnSts 0 "RdrDetnSts_Ukwn" 1 "RdrDetnSts_Movg" 2 "RdrDetnSts_Staty" 3 "RdrDetnSts_Invalid";
VAL_ 317 FrntSideRdrRiDetn41RdrDetnSts 0 "RdrDetnSts_Ukwn" 1 "RdrDetnSts_Movg" 2 "RdrDetnSts_Staty" 3 "RdrDetnSts_Invalid";
VAL_ 317 FrntSideRdrRiDetn42RdrDetnSts 0 "RdrDetnSts_Ukwn" 1 "RdrDetnSts_Movg" 2 "RdrDetnSts_Staty" 3 "RdrDetnSts_Invalid";
VAL_ 319 FrntSideRdrRiDetn43RdrDetnSts 0 "RdrDetnSts_Ukwn" 1 "RdrDetnSts_Movg" 2 "RdrDetnSts_Staty" 3 "RdrDetnSts_Invalid";
VAL_ 319 FrntSideRdrRiDetn44RdrDetnSts 0 "RdrDetnSts_Ukwn" 1 "RdrDetnSts_Movg" 2 "RdrDetnSts_Staty" 3 "RdrDetnSts_Invalid";
VAL_ 319 FrntSideRdrRiDetn45RdrDetnSts 0 "RdrDetnSts_Ukwn" 1 "RdrDetnSts_Movg" 2 "RdrDetnSts_Staty" 3 "RdrDetnSts_Invalid";
VAL_ 319 FrntSideRdrRiDetn46RdrDetnSts 0 "RdrDetnSts_Ukwn" 1 "RdrDetnSts_Movg" 2 "RdrDetnSts_Staty" 3 "RdrDetnSts_Invalid";
VAL_ 319 FrntSideRdrRiDetn47RdrDetnSts 0 "RdrDetnSts_Ukwn" 1 "RdrDetnSts_Movg" 2 "RdrDetnSts_Staty" 3 "RdrDetnSts_Invalid";
VAL_ 319 FrntSideRdrRiDetn48RdrDetnSts 0 "RdrDetnSts_Ukwn" 1 "RdrDetnSts_Movg" 2 "RdrDetnSts_Staty" 3 "RdrDetnSts_Invalid";
SIG_GROUP_ 305 FrntSideRdrRiDetn1 1 : FrntSideRdrRiDetn1RdrDetnAzi FrntSideRdrRiDetn1RdrDetnChks FrntSideRdrRiDetn1RdrDetnCntr FrntSideRdrRiDetn1RdrDetnConf FrntSideRdrRiDetn1RdrDetnElevn FrntSideRdrRiDetn1RdrDetnPwr FrntSideRdrRiDetn1RdrDetnRng FrntSideRdrRiDetn1RdrDetnRngV FrntSideRdrRiDetn1RdrDetnSts;
SIG_GROUP_ 307 FrntSideRdrRiDetn10 1 : FrntSideRdrRiDetn10RdrDetnAzi FrntSideRdrRiDetn10RdrDetnChks FrntSideRdrRiDetn10RdrDetnCntr FrntSideRdrRiDetn10RdrDetnConf FrntSideRdrRiDetn10RdrDetnElevn FrntSideRdrRiDetn10RdrDetnPwr FrntSideRdrRiDetn10RdrDetnRng FrntSideRdrRiDetn10RdrDetnRngV FrntSideRdrRiDetn10RdrDetnSts;
SIG_GROUP_ 307 FrntSideRdrRiDetn11 1 : FrntSideRdrRiDetn11RdrDetnAzi FrntSideRdrRiDetn11RdrDetnChks FrntSideRdrRiDetn11RdrDetnCntr FrntSideRdrRiDetn11RdrDetnConf FrntSideRdrRiDetn11RdrDetnElevn FrntSideRdrRiDetn11RdrDetnPwr FrntSideRdrRiDetn11RdrDetnRng FrntSideRdrRiDetn11RdrDetnRngV FrntSideRdrRiDetn11RdrDetnSts;
SIG_GROUP_ 307 FrntSideRdrRiDetn12 1 : FrntSideRdrRiDetn12RdrDetnAzi FrntSideRdrRiDetn12RdrDetnChks FrntSideRdrRiDetn12RdrDetnCntr FrntSideRdrRiDetn12RdrDetnConf FrntSideRdrRiDetn12RdrDetnElevn FrntSideRdrRiDetn12RdrDetnPwr FrntSideRdrRiDetn12RdrDetnRng FrntSideRdrRiDetn12RdrDetnRngV FrntSideRdrRiDetn12RdrDetnSts;
SIG_GROUP_ 309 FrntSideRdrRiDetn13 1 : FrntSideRdrRiDetn13RdrDetnAzi FrntSideRdrRiDetn13RdrDetnChks FrntSideRdrRiDetn13RdrDetnCntr FrntSideRdrRiDetn13RdrDetnConf FrntSideRdrRiDetn13RdrDetnElevn FrntSideRdrRiDetn13RdrDetnPwr FrntSideRdrRiDetn13RdrDetnRng FrntSideRdrRiDetn13RdrDetnRngV FrntSideRdrRiDetn13RdrDetnSts;
SIG_GROUP_ 309 FrntSideRdrRiDetn14 1 : FrntSideRdrRiDetn14RdrDetnAzi FrntSideRdrRiDetn14RdrDetnChks FrntSideRdrRiDetn14RdrDetnCntr FrntSideRdrRiDetn14RdrDetnConf FrntSideRdrRiDetn14RdrDetnElevn FrntSideRdrRiDetn14RdrDetnPwr FrntSideRdrRiDetn14RdrDetnRng FrntSideRdrRiDetn14RdrDetnRngV FrntSideRdrRiDetn14RdrDetnSts;
SIG_GROUP_ 309 FrntSideRdrRiDetn15 1 : FrntSideRdrRiDetn15RdrDetnAzi FrntSideRdrRiDetn15RdrDetnChks FrntSideRdrRiDetn15RdrDetnCntr FrntSideRdrRiDetn15RdrDetnConf FrntSideRdrRiDetn15RdrDetnElevn FrntSideRdrRiDetn15RdrDetnPwr FrntSideRdrRiDetn15RdrDetnRng FrntSideRdrRiDetn15RdrDetnRngV FrntSideRdrRiDetn15RdrDetnSts;
SIG_GROUP_ 309 FrntSideRdrRiDetn16 1 : FrntSideRdrRiDetn16RdrDetnAzi FrntSideRdrRiDetn16RdrDetnChks FrntSideRdrRiDetn16RdrDetnCntr FrntSideRdrRiDetn16RdrDetnConf FrntSideRdrRiDetn16RdrDetnElevn FrntSideRdrRiDetn16RdrDetnPwr FrntSideRdrRiDetn16RdrDetnRng FrntSideRdrRiDetn16RdrDetnRngV FrntSideRdrRiDetn16RdrDetnSts;
SIG_GROUP_ 309 FrntSideRdrRiDetn17 1 : FrntSideRdrRiDetn17RdrDetnAzi FrntSideRdrRiDetn17RdrDetnChks FrntSideRdrRiDetn17RdrDetnCntr FrntSideRdrRiDetn17RdrDetnConf FrntSideRdrRiDetn17RdrDetnElevn FrntSideRdrRiDetn17RdrDetnPwr FrntSideRdrRiDetn17RdrDetnRng FrntSideRdrRiDetn17RdrDetnRngV FrntSideRdrRiDetn17RdrDetnSts;
SIG_GROUP_ 309 FrntSideRdrRiDetn18 1 : FrntSideRdrRiDetn18RdrDetnAzi FrntSideRdrRiDetn18RdrDetnChks FrntSideRdrRiDetn18RdrDetnCntr FrntSideRdrRiDetn18RdrDetnConf FrntSideRdrRiDetn18RdrDetnElevn FrntSideRdrRiDetn18RdrDetnPwr FrntSideRdrRiDetn18RdrDetnRng FrntSideRdrRiDetn18RdrDetnRngV FrntSideRdrRiDetn18RdrDetnSts;
SIG_GROUP_ 311 FrntSideRdrRiDetn19 1 : FrntSideRdrRiDetn19RdrDetnAzi FrntSideRdrRiDetn19RdrDetnChks FrntSideRdrRiDetn19RdrDetnCntr FrntSideRdrRiDetn19RdrDetnConf FrntSideRdrRiDetn19RdrDetnElevn FrntSideRdrRiDetn19RdrDetnPwr FrntSideRdrRiDetn19RdrDetnRng FrntSideRdrRiDetn19RdrDetnRngV FrntSideRdrRiDetn19RdrDetnSts;
SIG_GROUP_ 305 FrntSideRdrRiDetn2 1 : FrntSideRdrRiDetn2RdrDetnAzi FrntSideRdrRiDetn2RdrDetnChks FrntSideRdrRiDetn2RdrDetnCntr FrntSideRdrRiDetn2RdrDetnConf FrntSideRdrRiDetn2RdrDetnElevn FrntSideRdrRiDetn2RdrDetnPwr FrntSideRdrRiDetn2RdrDetnRng FrntSideRdrRiDetn2RdrDetnRngV FrntSideRdrRiDetn2RdrDetnSts;
SIG_GROUP_ 311 FrntSideRdrRiDetn20 1 : FrntSideRdrRiDetn20RdrDetnAzi FrntSideRdrRiDetn20RdrDetnChks FrntSideRdrRiDetn20RdrDetnCntr FrntSideRdrRiDetn20RdrDetnConf FrntSideRdrRiDetn20RdrDetnElevn FrntSideRdrRiDetn20RdrDetnPwr FrntSideRdrRiDetn20RdrDetnRng FrntSideRdrRiDetn20RdrDetnRngV FrntSideRdrRiDetn20RdrDetnSts;
SIG_GROUP_ 311 FrntSideRdrRiDetn21 1 : FrntSideRdrRiDetn21RdrDetnAzi FrntSideRdrRiDetn21RdrDetnChks FrntSideRdrRiDetn21RdrDetnCntr FrntSideRdrRiDetn21RdrDetnConf FrntSideRdrRiDetn21RdrDetnElevn FrntSideRdrRiDetn21RdrDetnPwr FrntSideRdrRiDetn21RdrDetnRng FrntSideRdrRiDetn21RdrDetnRngV FrntSideRdrRiDetn21RdrDetnSts;
SIG_GROUP_ 311 FrntSideRdrRiDetn22 1 : FrntSideRdrRiDetn22RdrDetnAzi FrntSideRdrRiDetn22RdrDetnChks FrntSideRdrRiDetn22RdrDetnCntr FrntSideRdrRiDetn22RdrDetnConf FrntSideRdrRiDetn22RdrDetnElevn FrntSideRdrRiDetn22RdrDetnPwr FrntSideRdrRiDetn22RdrDetnRng FrntSideRdrRiDetn22RdrDetnRngV FrntSideRdrRiDetn22RdrDetnSts;
SIG_GROUP_ 311 FrntSideRdrRiDetn23 1 : FrntSideRdrRiDetn23RdrDetnAzi FrntSideRdrRiDetn23RdrDetnChks FrntSideRdrRiDetn23RdrDetnCntr FrntSideRdrRiDetn23RdrDetnConf FrntSideRdrRiDetn23RdrDetnElevn FrntSideRdrRiDetn23RdrDetnPwr FrntSideRdrRiDetn23RdrDetnRng FrntSideRdrRiDetn23RdrDetnRngV FrntSideRdrRiDetn23RdrDetnSts;
SIG_GROUP_ 311 FrntSideRdrRiDetn24 1 : FrntSideRdrRiDetn24RdrDetnAzi FrntSideRdrRiDetn24RdrDetnChks FrntSideRdrRiDetn24RdrDetnCntr FrntSideRdrRiDetn24RdrDetnConf FrntSideRdrRiDetn24RdrDetnElevn FrntSideRdrRiDetn24RdrDetnPwr FrntSideRdrRiDetn24RdrDetnRng FrntSideRdrRiDetn24RdrDetnRngV FrntSideRdrRiDetn24RdrDetnSts;
SIG_GROUP_ 313 FrntSideRdrRiDetn25 1 : FrntSideRdrRiDetn25RdrDetnAzi FrntSideRdrRiDetn25RdrDetnChks FrntSideRdrRiDetn25RdrDetnCntr FrntSideRdrRiDetn25RdrDetnConf FrntSideRdrRiDetn25RdrDetnElevn FrntSideRdrRiDetn25RdrDetnPwr FrntSideRdrRiDetn25RdrDetnRng FrntSideRdrRiDetn25RdrDetnRngV FrntSideRdrRiDetn25RdrDetnSts;
SIG_GROUP_ 313 FrntSideRdrRiDetn26 1 : FrntSideRdrRiDetn26RdrDetnAzi FrntSideRdrRiDetn26RdrDetnChks FrntSideRdrRiDetn26RdrDetnCntr FrntSideRdrRiDetn26RdrDetnConf FrntSideRdrRiDetn26RdrDetnElevn FrntSideRdrRiDetn26RdrDetnPwr FrntSideRdrRiDetn26RdrDetnRng FrntSideRdrRiDetn26RdrDetnRngV FrntSideRdrRiDetn26RdrDetnSts;
SIG_GROUP_ 313 FrntSideRdrRiDetn27 1 : FrntSideRdrRiDetn27RdrDetnAzi FrntSideRdrRiDetn27RdrDetnChks FrntSideRdrRiDetn27RdrDetnCntr FrntSideRdrRiDetn27RdrDetnConf FrntSideRdrRiDetn27RdrDetnElevn FrntSideRdrRiDetn27RdrDetnPwr FrntSideRdrRiDetn27RdrDetnRng FrntSideRdrRiDetn27RdrDetnRngV FrntSideRdrRiDetn27RdrDetnSts;
SIG_GROUP_ 313 FrntSideRdrRiDetn28 1 : FrntSideRdrRiDetn28RdrDetnAzi FrntSideRdrRiDetn28RdrDetnChks FrntSideRdrRiDetn28RdrDetnCntr FrntSideRdrRiDetn28RdrDetnConf FrntSideRdrRiDetn28RdrDetnElevn FrntSideRdrRiDetn28RdrDetnPwr FrntSideRdrRiDetn28RdrDetnRng FrntSideRdrRiDetn28RdrDetnRngV FrntSideRdrRiDetn28RdrDetnSts;
SIG_GROUP_ 313 FrntSideRdrRiDetn29 1 : FrntSideRdrRiDetn29RdrDetnAzi FrntSideRdrRiDetn29RdrDetnChks FrntSideRdrRiDetn29RdrDetnCntr FrntSideRdrRiDetn29RdrDetnConf FrntSideRdrRiDetn29RdrDetnElevn FrntSideRdrRiDetn29RdrDetnPwr FrntSideRdrRiDetn29RdrDetnRng FrntSideRdrRiDetn29RdrDetnRngV FrntSideRdrRiDetn29RdrDetnSts;
SIG_GROUP_ 305 FrntSideRdrRiDetn3 1 : FrntSideRdrRiDetn3RdrDetnAzi FrntSideRdrRiDetn3RdrDetnChks FrntSideRdrRiDetn3RdrDetnCntr FrntSideRdrRiDetn3RdrDetnConf FrntSideRdrRiDetn3RdrDetnElevn FrntSideRdrRiDetn3RdrDetnPwr FrntSideRdrRiDetn3RdrDetnRng FrntSideRdrRiDetn3RdrDetnRngV FrntSideRdrRiDetn3RdrDetnSts;
SIG_GROUP_ 313 FrntSideRdrRiDetn30 1 : FrntSideRdrRiDetn30RdrDetnAzi FrntSideRdrRiDetn30RdrDetnChks FrntSideRdrRiDetn30RdrDetnCntr FrntSideRdrRiDetn30RdrDetnConf FrntSideRdrRiDetn30RdrDetnElevn FrntSideRdrRiDetn30RdrDetnPwr FrntSideRdrRiDetn30RdrDetnRng FrntSideRdrRiDetn30RdrDetnRngV FrntSideRdrRiDetn30RdrDetnSts;
SIG_GROUP_ 315 FrntSideRdrRiDetn31 1 : FrntSideRdrRiDetn31RdrDetnAzi FrntSideRdrRiDetn31RdrDetnChks FrntSideRdrRiDetn31RdrDetnCntr FrntSideRdrRiDetn31RdrDetnConf FrntSideRdrRiDetn31RdrDetnElevn FrntSideRdrRiDetn31RdrDetnPwr FrntSideRdrRiDetn31RdrDetnRng FrntSideRdrRiDetn31RdrDetnRngV FrntSideRdrRiDetn31RdrDetnSts;
SIG_GROUP_ 315 FrntSideRdrRiDetn32 1 : FrntSideRdrRiDetn32RdrDetnAzi FrntSideRdrRiDetn32RdrDetnChks FrntSideRdrRiDetn32RdrDetnCntr FrntSideRdrRiDetn32RdrDetnConf FrntSideRdrRiDetn32RdrDetnElevn FrntSideRdrRiDetn32RdrDetnPwr FrntSideRdrRiDetn32RdrDetnRng FrntSideRdrRiDetn32RdrDetnRngV FrntSideRdrRiDetn32RdrDetnSts;
SIG_GROUP_ 315 FrntSideRdrRiDetn33 1 : FrntSideRdrRiDetn33RdrDetnAzi FrntSideRdrRiDetn33RdrDetnChks FrntSideRdrRiDetn33RdrDetnCntr FrntSideRdrRiDetn33RdrDetnConf FrntSideRdrRiDetn33RdrDetnElevn FrntSideRdrRiDetn33RdrDetnPwr FrntSideRdrRiDetn33RdrDetnRng FrntSideRdrRiDetn33RdrDetnRngV FrntSideRdrRiDetn33RdrDetnSts;
SIG_GROUP_ 315 FrntSideRdrRiDetn34 1 : FrntSideRdrRiDetn34RdrDetnAzi FrntSideRdrRiDetn34RdrDetnChks FrntSideRdrRiDetn34RdrDetnCntr FrntSideRdrRiDetn34RdrDetnConf FrntSideRdrRiDetn34RdrDetnElevn FrntSideRdrRiDetn34RdrDetnPwr FrntSideRdrRiDetn34RdrDetnRng FrntSideRdrRiDetn34RdrDetnRngV FrntSideRdrRiDetn34RdrDetnSts;
SIG_GROUP_ 315 FrntSideRdrRiDetn35 1 : FrntSideRdrRiDetn35RdrDetnAzi FrntSideRdrRiDetn35RdrDetnChks FrntSideRdrRiDetn35RdrDetnCntr FrntSideRdrRiDetn35RdrDetnConf FrntSideRdrRiDetn35RdrDetnElevn FrntSideRdrRiDetn35RdrDetnPwr FrntSideRdrRiDetn35RdrDetnRng FrntSideRdrRiDetn35RdrDetnRngV FrntSideRdrRiDetn35RdrDetnSts;
SIG_GROUP_ 315 FrntSideRdrRiDetn36 1 : FrntSideRdrRiDetn36RdrDetnAzi FrntSideRdrRiDetn36RdrDetnChks FrntSideRdrRiDetn36RdrDetnCntr FrntSideRdrRiDetn36RdrDetnConf FrntSideRdrRiDetn36RdrDetnElevn FrntSideRdrRiDetn36RdrDetnPwr FrntSideRdrRiDetn36RdrDetnRng FrntSideRdrRiDetn36RdrDetnRngV FrntSideRdrRiDetn36RdrDetnSts;
SIG_GROUP_ 317 FrntSideRdrRiDetn37 1 : FrntSideRdrRiDetn37RdrDetnAzi FrntSideRdrRiDetn37RdrDetnChks FrntSideRdrRiDetn37RdrDetnCntr FrntSideRdrRiDetn37RdrDetnConf FrntSideRdrRiDetn37RdrDetnElevn FrntSideRdrRiDetn37RdrDetnPwr FrntSideRdrRiDetn37RdrDetnRng FrntSideRdrRiDetn37RdrDetnRngV FrntSideRdrRiDetn37RdrDetnSts;
SIG_GROUP_ 317 FrntSideRdrRiDetn38 1 : FrntSideRdrRiDetn38RdrDetnAzi FrntSideRdrRiDetn38RdrDetnChks FrntSideRdrRiDetn38RdrDetnCntr FrntSideRdrRiDetn38RdrDetnConf FrntSideRdrRiDetn38RdrDetnElevn FrntSideRdrRiDetn38RdrDetnPwr FrntSideRdrRiDetn38RdrDetnRng FrntSideRdrRiDetn38RdrDetnRngV FrntSideRdrRiDetn38RdrDetnSts;
SIG_GROUP_ 317 FrntSideRdrRiDetn39 1 : FrntSideRdrRiDetn39RdrDetnAzi FrntSideRdrRiDetn39RdrDetnChks FrntSideRdrRiDetn39RdrDetnCntr FrntSideRdrRiDetn39RdrDetnConf FrntSideRdrRiDetn39RdrDetnElevn FrntSideRdrRiDetn39RdrDetnPwr FrntSideRdrRiDetn39RdrDetnRng FrntSideRdrRiDetn39RdrDetnRngV FrntSideRdrRiDetn39RdrDetnSts;
SIG_GROUP_ 305 FrntSideRdrRiDetn4 1 : FrntSideRdrRiDetn4RdrDetnAzi FrntSideRdrRiDetn4RdrDetnChks FrntSideRdrRiDetn4RdrDetnCntr FrntSideRdrRiDetn4RdrDetnConf FrntSideRdrRiDetn4RdrDetnElevn FrntSideRdrRiDetn4RdrDetnPwr FrntSideRdrRiDetn4RdrDetnRng FrntSideRdrRiDetn4RdrDetnRngV FrntSideRdrRiDetn4RdrDetnSts;
SIG_GROUP_ 317 FrntSideRdrRiDetn40 1 : FrntSideRdrRiDetn40RdrDetnAzi FrntSideRdrRiDetn40RdrDetnChks FrntSideRdrRiDetn40RdrDetnCntr FrntSideRdrRiDetn40RdrDetnConf FrntSideRdrRiDetn40RdrDetnElevn FrntSideRdrRiDetn40RdrDetnPwr FrntSideRdrRiDetn40RdrDetnRng FrntSideRdrRiDetn40RdrDetnRngV FrntSideRdrRiDetn40RdrDetnSts;
SIG_GROUP_ 317 FrntSideRdrRiDetn41 1 : FrntSideRdrRiDetn41RdrDetnAzi FrntSideRdrRiDetn41RdrDetnChks FrntSideRdrRiDetn41RdrDetnCntr FrntSideRdrRiDetn41RdrDetnConf FrntSideRdrRiDetn41RdrDetnElevn FrntSideRdrRiDetn41RdrDetnPwr FrntSideRdrRiDetn41RdrDetnRng FrntSideRdrRiDetn41RdrDetnRngV FrntSideRdrRiDetn41RdrDetnSts;
SIG_GROUP_ 317 FrntSideRdrRiDetn42 1 : FrntSideRdrRiDetn42RdrDetnAzi FrntSideRdrRiDetn42RdrDetnChks FrntSideRdrRiDetn42RdrDetnCntr FrntSideRdrRiDetn42RdrDetnConf FrntSideRdrRiDetn42RdrDetnElevn FrntSideRdrRiDetn42RdrDetnPwr FrntSideRdrRiDetn42RdrDetnRng FrntSideRdrRiDetn42RdrDetnRngV FrntSideRdrRiDetn42RdrDetnSts;
SIG_GROUP_ 319 FrntSideRdrRiDetn43 1 : FrntSideRdrRiDetn43RdrDetnAzi FrntSideRdrRiDetn43RdrDetnChks FrntSideRdrRiDetn43RdrDetnCntr FrntSideRdrRiDetn43RdrDetnConf FrntSideRdrRiDetn43RdrDetnElevn FrntSideRdrRiDetn43RdrDetnPwr FrntSideRdrRiDetn43RdrDetnRng FrntSideRdrRiDetn43RdrDetnRngV FrntSideRdrRiDetn43RdrDetnSts;
SIG_GROUP_ 319 FrntSideRdrRiDetn44 1 : FrntSideRdrRiDetn44RdrDetnAzi FrntSideRdrRiDetn44RdrDetnChks FrntSideRdrRiDetn44RdrDetnCntr FrntSideRdrRiDetn44RdrDetnConf FrntSideRdrRiDetn44RdrDetnElevn FrntSideRdrRiDetn44RdrDetnPwr FrntSideRdrRiDetn44RdrDetnRng FrntSideRdrRiDetn44RdrDetnRngV FrntSideRdrRiDetn44RdrDetnSts;
SIG_GROUP_ 319 FrntSideRdrRiDetn45 1 : FrntSideRdrRiDetn45RdrDetnAzi FrntSideRdrRiDetn45RdrDetnChks FrntSideRdrRiDetn45RdrDetnCntr FrntSideRdrRiDetn45RdrDetnConf FrntSideRdrRiDetn45RdrDetnElevn FrntSideRdrRiDetn45RdrDetnPwr FrntSideRdrRiDetn45RdrDetnRng FrntSideRdrRiDetn45RdrDetnRngV FrntSideRdrRiDetn45RdrDetnSts;
SIG_GROUP_ 319 FrntSideRdrRiDetn46 1 : FrntSideRdrRiDetn46RdrDetnAzi FrntSideRdrRiDetn46RdrDetnChks FrntSideRdrRiDetn46RdrDetnCntr FrntSideRdrRiDetn46RdrDetnConf FrntSideRdrRiDetn46RdrDetnElevn FrntSideRdrRiDetn46RdrDetnPwr FrntSideRdrRiDetn46RdrDetnRng FrntSideRdrRiDetn46RdrDetnRngV FrntSideRdrRiDetn46RdrDetnSts;
SIG_GROUP_ 319 FrntSideRdrRiDetn47 1 : FrntSideRdrRiDetn47RdrDetnAzi FrntSideRdrRiDetn47RdrDetnChks FrntSideRdrRiDetn47RdrDetnCntr FrntSideRdrRiDetn47RdrDetnConf FrntSideRdrRiDetn47RdrDetnElevn FrntSideRdrRiDetn47RdrDetnPwr FrntSideRdrRiDetn47RdrDetnRng FrntSideRdrRiDetn47RdrDetnRngV FrntSideRdrRiDetn47RdrDetnSts;
SIG_GROUP_ 319 FrntSideRdrRiDetn48 1 : FrntSideRdrRiDetn48RdrDetnAzi FrntSideRdrRiDetn48RdrDetnChks FrntSideRdrRiDetn48RdrDetnCntr FrntSideRdrRiDetn48RdrDetnConf FrntSideRdrRiDetn48RdrDetnElevn FrntSideRdrRiDetn48RdrDetnPwr FrntSideRdrRiDetn48RdrDetnRng FrntSideRdrRiDetn48RdrDetnRngV FrntSideRdrRiDetn48RdrDetnSts;
SIG_GROUP_ 305 FrntSideRdrRiDetn5 1 : FrntSideRdrRiDetn5RdrDetnAzi FrntSideRdrRiDetn5RdrDetnChks FrntSideRdrRiDetn5RdrDetnCntr FrntSideRdrRiDetn5RdrDetnConf FrntSideRdrRiDetn5RdrDetnElevn FrntSideRdrRiDetn5RdrDetnPwr FrntSideRdrRiDetn5RdrDetnRng FrntSideRdrRiDetn5RdrDetnRngV FrntSideRdrRiDetn5RdrDetnSts;
SIG_GROUP_ 305 FrntSideRdrRiDetn6 1 : FrntSideRdrRiDetn6RdrDetnAzi FrntSideRdrRiDetn6RdrDetnChks FrntSideRdrRiDetn6RdrDetnCntr FrntSideRdrRiDetn6RdrDetnConf FrntSideRdrRiDetn6RdrDetnElevn FrntSideRdrRiDetn6RdrDetnPwr FrntSideRdrRiDetn6RdrDetnRng FrntSideRdrRiDetn6RdrDetnRngV FrntSideRdrRiDetn6RdrDetnSts;
SIG_GROUP_ 307 FrntSideRdrRiDetn7 1 : FrntSideRdrRiDetn7RdrDetnAzi FrntSideRdrRiDetn7RdrDetnChks FrntSideRdrRiDetn7RdrDetnCntr FrntSideRdrRiDetn7RdrDetnConf FrntSideRdrRiDetn7RdrDetnElevn FrntSideRdrRiDetn7RdrDetnPwr FrntSideRdrRiDetn7RdrDetnRng FrntSideRdrRiDetn7RdrDetnRngV FrntSideRdrRiDetn7RdrDetnSts;
SIG_GROUP_ 307 FrntSideRdrRiDetn8 1 : FrntSideRdrRiDetn8RdrDetnAzi FrntSideRdrRiDetn8RdrDetnChks FrntSideRdrRiDetn8RdrDetnCntr FrntSideRdrRiDetn8RdrDetnConf FrntSideRdrRiDetn8RdrDetnElevn FrntSideRdrRiDetn8RdrDetnPwr FrntSideRdrRiDetn8RdrDetnRng FrntSideRdrRiDetn8RdrDetnRngV FrntSideRdrRiDetn8RdrDetnSts;
SIG_GROUP_ 307 FrntSideRdrRiDetn9 1 : FrntSideRdrRiDetn9RdrDetnAzi FrntSideRdrRiDetn9RdrDetnChks FrntSideRdrRiDetn9RdrDetnCntr FrntSideRdrRiDetn9RdrDetnConf FrntSideRdrRiDetn9RdrDetnElevn FrntSideRdrRiDetn9RdrDetnPwr FrntSideRdrRiDetn9RdrDetnRng FrntSideRdrRiDetn9RdrDetnRngV FrntSideRdrRiDetn9RdrDetnSts;
SIG_GROUP_ 302 FrntSideRdrRiSts 1 : FrntSideRdrRiStsRdrNrDetn FrntSideRdrRiStsRdrNrObj FrntSideRdrRiStsRdrStsBlkd0bin FrntSideRdrRiStsRdrStsBlkdConf FrntSideRdrRiStsRdrStsChks FrntSideRdrRiStsRdrStsCntr FrntSideRdrRiStsRdrStsDstbc FrntSideRdrRiStsRdrStsEna FrntSideRdrRiStsRdrStsFaulty FrntSideRdrRiStsRdrStsIfVersMajor FrntSideRdrRiStsRdrStsIfVersMinor FrntSideRdrRiStsRdrStsLatency FrntSideRdrRiStsRdrStsMisAlign FrntSideRdrRiStsRdrStsMissCom FrntSideRdrRiStsRdrStsSftyFlt FrntSideRdrRiStsRdrStsTiStamp FrntSideRdrRiStsRdrStsTiStampStsGlbTiBas FrntSideRdrRiStsRdrStsTiStampStsSyncToGatewy FrntSideRdrRiStsRdrStsTiStampStsTiLeap FrntSideRdrRiStsRdrStsTiStampStsTiOut FrntSideRdrRiStsRdrStsWhlSpdCmpFac;

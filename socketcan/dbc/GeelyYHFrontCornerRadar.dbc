// *************************************************************************** *
// *                                                                           *
// * Description:         CANDB File                                           *
// * Generated at:        2023-03-04 22:47                                     *
// * System:              SDB23100                                             *
// * Variant:             DX11_VDDM_CDD3_ADCU3                                 *
// * Network:             SafetyCANFD1                                         *
// *                                                                           *
// *************************************************************************** *
VERSION "SafetyCANFD1"

NS_ :

BS_ :

BU_ :  ASDM ETC FSRL FSRR

BO_ 337 FSRRSafetyCANFD1Frame17 : 64 FSRR
 SG_ FrntSideRdrRiDetn100_UB : 314|1@0+ (1,0) [0|1] "" ASDM
 SG_ FrntSideRdrRiDetn100RdrDetnAzi : 287|11@0+ (0.1,-90.0) [-90.0|90.0] "Deg" ASDM
 SG_ FrntSideRdrRiDetn100RdrDetnChks : 247|8@0+ (1.0,0.0) [0.0|255.0] "Unitless" ASDM
 SG_ FrntSideRdrRiDetn100RdrDetnCntr : 255|4@0+ (1.0,0.0) [0.0|15.0] "Unitless" ASDM
 SG_ FrntSideRdrRiDetn100RdrDetnConf : 311|7@0+ (1.0,0.0) [0.0|100.0] "%" ASDM
 SG_ FrntSideRdrRiDetn100RdrDetnElevn : 319|5@0+ (1.0,-15.0) [-15.0|15.0] "Deg" ASDM
 SG_ FrntSideRdrRiDetn100RdrDetnPwr : 249|9@0+ (0.1,0.0) [0.0|51.1] "dB" ASDM
 SG_ FrntSideRdrRiDetn100RdrDetnRng : 271|14@0+ (0.02,-1.0) [-1.0|200.0] "m" ASDM
 SG_ FrntSideRdrRiDetn100RdrDetnRngV : 292|13@0+ (0.02,-80.0) [-80.0|80.0] "m/s" ASDM
 SG_ FrntSideRdrRiDetn100RdrDetnSts : 251|2@0+ (1,0) [0|3] "" ASDM
 SG_ FrntSideRdrRiDetn101_UB : 394|1@0+ (1,0) [0|1] "" ASDM
 SG_ FrntSideRdrRiDetn101RdrDetnAzi : 367|11@0+ (0.1,-90.0) [-90.0|90.0] "Deg" ASDM
 SG_ FrntSideRdrRiDetn101RdrDetnChks : 327|8@0+ (1.0,0.0) [0.0|255.0] "Unitless" ASDM
 SG_ FrntSideRdrRiDetn101RdrDetnCntr : 335|4@0+ (1.0,0.0) [0.0|15.0] "Unitless" ASDM
 SG_ FrntSideRdrRiDetn101RdrDetnConf : 391|7@0+ (1.0,0.0) [0.0|100.0] "%" ASDM
 SG_ FrntSideRdrRiDetn101RdrDetnElevn : 399|5@0+ (1.0,-15.0) [-15.0|15.0] "Deg" ASDM
 SG_ FrntSideRdrRiDetn101RdrDetnPwr : 329|9@0+ (0.1,0.0) [0.0|51.1] "dB" ASDM
 SG_ FrntSideRdrRiDetn101RdrDetnRng : 351|14@0+ (0.02,-1.0) [-1.0|200.0] "m" ASDM
 SG_ FrntSideRdrRiDetn101RdrDetnRngV : 372|13@0+ (0.02,-80.0) [-80.0|80.0] "m/s" ASDM
 SG_ FrntSideRdrRiDetn101RdrDetnSts : 331|2@0+ (1,0) [0|3] "" ASDM
 SG_ FrntSideRdrRiDetn102_UB : 474|1@0+ (1,0) [0|1] "" ASDM
 SG_ FrntSideRdrRiDetn102RdrDetnAzi : 447|11@0+ (0.1,-90.0) [-90.0|90.0] "Deg" ASDM
 SG_ FrntSideRdrRiDetn102RdrDetnChks : 407|8@0+ (1.0,0.0) [0.0|255.0] "Unitless" ASDM
 SG_ FrntSideRdrRiDetn102RdrDetnCntr : 415|4@0+ (1.0,0.0) [0.0|15.0] "Unitless" ASDM
 SG_ FrntSideRdrRiDetn102RdrDetnConf : 471|7@0+ (1.0,0.0) [0.0|100.0] "%" ASDM
 SG_ FrntSideRdrRiDetn102RdrDetnElevn : 479|5@0+ (1.0,-15.0) [-15.0|15.0] "Deg" ASDM
 SG_ FrntSideRdrRiDetn102RdrDetnPwr : 409|9@0+ (0.1,0.0) [0.0|51.1] "dB" ASDM
 SG_ FrntSideRdrRiDetn102RdrDetnRng : 431|14@0+ (0.02,-1.0) [-1.0|200.0] "m" ASDM
 SG_ FrntSideRdrRiDetn102RdrDetnRngV : 452|13@0+ (0.02,-80.0) [-80.0|80.0] "m/s" ASDM
 SG_ FrntSideRdrRiDetn102RdrDetnSts : 411|2@0+ (1,0) [0|3] "" ASDM
 SG_ FrntSideRdrRiDetn97_UB : 74|1@0+ (1,0) [0|1] "" ASDM
 SG_ FrntSideRdrRiDetn97RdrDetnAzi : 31|11@0+ (0.1,-90.0) [-90.0|90.0] "Deg" ASDM
 SG_ FrntSideRdrRiDetn97RdrDetnChks : 7|8@0+ (1.0,0.0) [0.0|255.0] "Unitless" ASDM
 SG_ FrntSideRdrRiDetn97RdrDetnCntr : 15|4@0+ (1.0,0.0) [0.0|15.0] "Unitless" ASDM
 SG_ FrntSideRdrRiDetn97RdrDetnConf : 71|7@0+ (1.0,0.0) [0.0|100.0] "%" ASDM
 SG_ FrntSideRdrRiDetn97RdrDetnElevn : 79|5@0+ (1.0,-15.0) [-15.0|15.0] "Deg" ASDM
 SG_ FrntSideRdrRiDetn97RdrDetnPwr : 8|9@0+ (0.1,0.0) [0.0|51.1] "dB" ASDM
 SG_ FrntSideRdrRiDetn97RdrDetnRng : 55|14@0+ (0.02,-1.0) [-1.0|200.0] "m" ASDM
 SG_ FrntSideRdrRiDetn97RdrDetnRngV : 36|13@0+ (0.02,-80.0) [-80.0|80.0] "m/s" ASDM
 SG_ FrntSideRdrRiDetn97RdrDetnSts : 11|2@0+ (1,0) [0|3] "" ASDM
 SG_ FrntSideRdrRiDetn98_UB : 154|1@0+ (1,0) [0|1] "" ASDM
 SG_ FrntSideRdrRiDetn98RdrDetnAzi : 119|11@0+ (0.1,-90.0) [-90.0|90.0] "Deg" ASDM
 SG_ FrntSideRdrRiDetn98RdrDetnChks : 87|8@0+ (1.0,0.0) [0.0|255.0] "Unitless" ASDM
 SG_ FrntSideRdrRiDetn98RdrDetnCntr : 95|4@0+ (1.0,0.0) [0.0|15.0] "Unitless" ASDM
 SG_ FrntSideRdrRiDetn98RdrDetnConf : 111|7@0+ (1.0,0.0) [0.0|100.0] "%" ASDM
 SG_ FrntSideRdrRiDetn98RdrDetnElevn : 159|5@0+ (1.0,-15.0) [-15.0|15.0] "Deg" ASDM
 SG_ FrntSideRdrRiDetn98RdrDetnPwr : 89|9@0+ (0.1,0.0) [0.0|51.1] "dB" ASDM
 SG_ FrntSideRdrRiDetn98RdrDetnRng : 143|14@0+ (0.02,-1.0) [-1.0|200.0] "m" ASDM
 SG_ FrntSideRdrRiDetn98RdrDetnRngV : 124|13@0+ (0.02,-80.0) [-80.0|80.0] "m/s" ASDM
 SG_ FrntSideRdrRiDetn98RdrDetnSts : 91|2@0+ (1,0) [0|3] "" ASDM
 SG_ FrntSideRdrRiDetn99_UB : 234|1@0+ (1,0) [0|1] "" ASDM
 SG_ FrntSideRdrRiDetn99RdrDetnAzi : 199|11@0+ (0.1,-90.0) [-90.0|90.0] "Deg" ASDM
 SG_ FrntSideRdrRiDetn99RdrDetnChks : 167|8@0+ (1.0,0.0) [0.0|255.0] "Unitless" ASDM
 SG_ FrntSideRdrRiDetn99RdrDetnCntr : 175|4@0+ (1.0,0.0) [0.0|15.0] "Unitless" ASDM
 SG_ FrntSideRdrRiDetn99RdrDetnConf : 191|7@0+ (1.0,0.0) [0.0|100.0] "%" ASDM
 SG_ FrntSideRdrRiDetn99RdrDetnElevn : 239|5@0+ (1.0,-15.0) [-15.0|15.0] "Deg" ASDM
 SG_ FrntSideRdrRiDetn99RdrDetnPwr : 169|9@0+ (0.1,0.0) [0.0|51.1] "dB" ASDM
 SG_ FrntSideRdrRiDetn99RdrDetnRng : 223|14@0+ (0.02,-1.0) [-1.0|200.0] "m" ASDM
 SG_ FrntSideRdrRiDetn99RdrDetnRngV : 204|13@0+ (0.02,-80.0) [-80.0|80.0] "m/s" ASDM
 SG_ FrntSideRdrRiDetn99RdrDetnSts : 171|2@0+ (1,0) [0|3] "" ASDM

BO_ 339 FSRRSafetyCANFD1Frame18 : 64 FSRR
 SG_ FrntSideRdrRiDetn103_UB : 74|1@0+ (1,0) [0|1] "" ASDM
 SG_ FrntSideRdrRiDetn103RdrDetnAzi : 31|11@0+ (0.1,-90.0) [-90.0|90.0] "Deg" ASDM
 SG_ FrntSideRdrRiDetn103RdrDetnChks : 7|8@0+ (1.0,0.0) [0.0|255.0] "Unitless" ASDM
 SG_ FrntSideRdrRiDetn103RdrDetnCntr : 15|4@0+ (1.0,0.0) [0.0|15.0] "Unitless" ASDM
 SG_ FrntSideRdrRiDetn103RdrDetnConf : 71|7@0+ (1.0,0.0) [0.0|100.0] "%" ASDM
 SG_ FrntSideRdrRiDetn103RdrDetnElevn : 79|5@0+ (1.0,-15.0) [-15.0|15.0] "Deg" ASDM
 SG_ FrntSideRdrRiDetn103RdrDetnPwr : 8|9@0+ (0.1,0.0) [0.0|51.1] "dB" ASDM
 SG_ FrntSideRdrRiDetn103RdrDetnRng : 55|14@0+ (0.02,-1.0) [-1.0|200.0] "m" ASDM
 SG_ FrntSideRdrRiDetn103RdrDetnRngV : 36|13@0+ (0.02,-80.0) [-80.0|80.0] "m/s" ASDM
 SG_ FrntSideRdrRiDetn103RdrDetnSts : 11|2@0+ (1,0) [0|3] "" ASDM
 SG_ FrntSideRdrRiDetn104_UB : 154|1@0+ (1,0) [0|1] "" ASDM
 SG_ FrntSideRdrRiDetn104RdrDetnAzi : 119|11@0+ (0.1,-90.0) [-90.0|90.0] "Deg" ASDM
 SG_ FrntSideRdrRiDetn104RdrDetnChks : 87|8@0+ (1.0,0.0) [0.0|255.0] "Unitless" ASDM
 SG_ FrntSideRdrRiDetn104RdrDetnCntr : 95|4@0+ (1.0,0.0) [0.0|15.0] "Unitless" ASDM
 SG_ FrntSideRdrRiDetn104RdrDetnConf : 111|7@0+ (1.0,0.0) [0.0|100.0] "%" ASDM
 SG_ FrntSideRdrRiDetn104RdrDetnElevn : 159|5@0+ (1.0,-15.0) [-15.0|15.0] "Deg" ASDM
 SG_ FrntSideRdrRiDetn104RdrDetnPwr : 89|9@0+ (0.1,0.0) [0.0|51.1] "dB" ASDM
 SG_ FrntSideRdrRiDetn104RdrDetnRng : 143|14@0+ (0.02,-1.0) [-1.0|200.0] "m" ASDM
 SG_ FrntSideRdrRiDetn104RdrDetnRngV : 124|13@0+ (0.02,-80.0) [-80.0|80.0] "m/s" ASDM
 SG_ FrntSideRdrRiDetn104RdrDetnSts : 91|2@0+ (1,0) [0|3] "" ASDM
 SG_ FrntSideRdrRiDetn105_UB : 234|1@0+ (1,0) [0|1] "" ASDM
 SG_ FrntSideRdrRiDetn105RdrDetnAzi : 199|11@0+ (0.1,-90.0) [-90.0|90.0] "Deg" ASDM
 SG_ FrntSideRdrRiDetn105RdrDetnChks : 167|8@0+ (1.0,0.0) [0.0|255.0] "Unitless" ASDM
 SG_ FrntSideRdrRiDetn105RdrDetnCntr : 175|4@0+ (1.0,0.0) [0.0|15.0] "Unitless" ASDM
 SG_ FrntSideRdrRiDetn105RdrDetnConf : 191|7@0+ (1.0,0.0) [0.0|100.0] "%" ASDM
 SG_ FrntSideRdrRiDetn105RdrDetnElevn : 239|5@0+ (1.0,-15.0) [-15.0|15.0] "Deg" ASDM
 SG_ FrntSideRdrRiDetn105RdrDetnPwr : 169|9@0+ (0.1,0.0) [0.0|51.1] "dB" ASDM
 SG_ FrntSideRdrRiDetn105RdrDetnRng : 223|14@0+ (0.02,-1.0) [-1.0|200.0] "m" ASDM
 SG_ FrntSideRdrRiDetn105RdrDetnRngV : 204|13@0+ (0.02,-80.0) [-80.0|80.0] "m/s" ASDM
 SG_ FrntSideRdrRiDetn105RdrDetnSts : 171|2@0+ (1,0) [0|3] "" ASDM
 SG_ FrntSideRdrRiDetn106_UB : 314|1@0+ (1,0) [0|1] "" ASDM
 SG_ FrntSideRdrRiDetn106RdrDetnAzi : 287|11@0+ (0.1,-90.0) [-90.0|90.0] "Deg" ASDM
 SG_ FrntSideRdrRiDetn106RdrDetnChks : 247|8@0+ (1.0,0.0) [0.0|255.0] "Unitless" ASDM
 SG_ FrntSideRdrRiDetn106RdrDetnCntr : 255|4@0+ (1.0,0.0) [0.0|15.0] "Unitless" ASDM
 SG_ FrntSideRdrRiDetn106RdrDetnConf : 311|7@0+ (1.0,0.0) [0.0|100.0] "%" ASDM
 SG_ FrntSideRdrRiDetn106RdrDetnElevn : 319|5@0+ (1.0,-15.0) [-15.0|15.0] "Deg" ASDM
 SG_ FrntSideRdrRiDetn106RdrDetnPwr : 249|9@0+ (0.1,0.0) [0.0|51.1] "dB" ASDM
 SG_ FrntSideRdrRiDetn106RdrDetnRng : 271|14@0+ (0.02,-1.0) [-1.0|200.0] "m" ASDM
 SG_ FrntSideRdrRiDetn106RdrDetnRngV : 292|13@0+ (0.02,-80.0) [-80.0|80.0] "m/s" ASDM
 SG_ FrntSideRdrRiDetn106RdrDetnSts : 251|2@0+ (1,0) [0|3] "" ASDM
 SG_ FrntSideRdrRiDetn107_UB : 394|1@0+ (1,0) [0|1] "" ASDM
 SG_ FrntSideRdrRiDetn107RdrDetnAzi : 367|11@0+ (0.1,-90.0) [-90.0|90.0] "Deg" ASDM
 SG_ FrntSideRdrRiDetn107RdrDetnChks : 327|8@0+ (1.0,0.0) [0.0|255.0] "Unitless" ASDM
 SG_ FrntSideRdrRiDetn107RdrDetnCntr : 335|4@0+ (1.0,0.0) [0.0|15.0] "Unitless" ASDM
 SG_ FrntSideRdrRiDetn107RdrDetnConf : 391|7@0+ (1.0,0.0) [0.0|100.0] "%" ASDM
 SG_ FrntSideRdrRiDetn107RdrDetnElevn : 399|5@0+ (1.0,-15.0) [-15.0|15.0] "Deg" ASDM
 SG_ FrntSideRdrRiDetn107RdrDetnPwr : 329|9@0+ (0.1,0.0) [0.0|51.1] "dB" ASDM
 SG_ FrntSideRdrRiDetn107RdrDetnRng : 351|14@0+ (0.02,-1.0) [-1.0|200.0] "m" ASDM
 SG_ FrntSideRdrRiDetn107RdrDetnRngV : 372|13@0+ (0.02,-80.0) [-80.0|80.0] "m/s" ASDM
 SG_ FrntSideRdrRiDetn107RdrDetnSts : 331|2@0+ (1,0) [0|3] "" ASDM
 SG_ FrntSideRdrRiDetn108_UB : 474|1@0+ (1,0) [0|1] "" ASDM
 SG_ FrntSideRdrRiDetn108RdrDetnAzi : 447|11@0+ (0.1,-90.0) [-90.0|90.0] "Deg" ASDM
 SG_ FrntSideRdrRiDetn108RdrDetnChks : 407|8@0+ (1.0,0.0) [0.0|255.0] "Unitless" ASDM
 SG_ FrntSideRdrRiDetn108RdrDetnCntr : 415|4@0+ (1.0,0.0) [0.0|15.0] "Unitless" ASDM
 SG_ FrntSideRdrRiDetn108RdrDetnConf : 471|7@0+ (1.0,0.0) [0.0|100.0] "%" ASDM
 SG_ FrntSideRdrRiDetn108RdrDetnElevn : 479|5@0+ (1.0,-15.0) [-15.0|15.0] "Deg" ASDM
 SG_ FrntSideRdrRiDetn108RdrDetnPwr : 409|9@0+ (0.1,0.0) [0.0|51.1] "dB" ASDM
 SG_ FrntSideRdrRiDetn108RdrDetnRng : 431|14@0+ (0.02,-1.0) [-1.0|200.0] "m" ASDM
 SG_ FrntSideRdrRiDetn108RdrDetnRngV : 452|13@0+ (0.02,-80.0) [-80.0|80.0] "m/s" ASDM
 SG_ FrntSideRdrRiDetn108RdrDetnSts : 411|2@0+ (1,0) [0|3] "" ASDM

BO_ 341 FSRRSafetyCANFD1Frame19 : 64 FSRR
 SG_ FrntSideRdrRiDetn109_UB : 74|1@0+ (1,0) [0|1] "" ASDM
 SG_ FrntSideRdrRiDetn109RdrDetnAzi : 31|11@0+ (0.1,-90.0) [-90.0|90.0] "Deg" ASDM
 SG_ FrntSideRdrRiDetn109RdrDetnChks : 7|8@0+ (1.0,0.0) [0.0|255.0] "Unitless" ASDM
 SG_ FrntSideRdrRiDetn109RdrDetnCntr : 15|4@0+ (1.0,0.0) [0.0|15.0] "Unitless" ASDM
 SG_ FrntSideRdrRiDetn109RdrDetnConf : 71|7@0+ (1.0,0.0) [0.0|100.0] "%" ASDM
 SG_ FrntSideRdrRiDetn109RdrDetnElevn : 79|5@0+ (1.0,-15.0) [-15.0|15.0] "Deg" ASDM
 SG_ FrntSideRdrRiDetn109RdrDetnPwr : 8|9@0+ (0.1,0.0) [0.0|51.1] "dB" ASDM
 SG_ FrntSideRdrRiDetn109RdrDetnRng : 55|14@0+ (0.02,-1.0) [-1.0|200.0] "m" ASDM
 SG_ FrntSideRdrRiDetn109RdrDetnRngV : 36|13@0+ (0.02,-80.0) [-80.0|80.0] "m/s" ASDM
 SG_ FrntSideRdrRiDetn109RdrDetnSts : 11|2@0+ (1,0) [0|3] "" ASDM
 SG_ FrntSideRdrRiDetn110_UB : 154|1@0+ (1,0) [0|1] "" ASDM
 SG_ FrntSideRdrRiDetn110RdrDetnAzi : 119|11@0+ (0.1,-90.0) [-90.0|90.0] "Deg" ASDM
 SG_ FrntSideRdrRiDetn110RdrDetnChks : 87|8@0+ (1.0,0.0) [0.0|255.0] "Unitless" ASDM
 SG_ FrntSideRdrRiDetn110RdrDetnCntr : 95|4@0+ (1.0,0.0) [0.0|15.0] "Unitless" ASDM
 SG_ FrntSideRdrRiDetn110RdrDetnConf : 111|7@0+ (1.0,0.0) [0.0|100.0] "%" ASDM
 SG_ FrntSideRdrRiDetn110RdrDetnElevn : 159|5@0+ (1.0,-15.0) [-15.0|15.0] "Deg" ASDM
 SG_ FrntSideRdrRiDetn110RdrDetnPwr : 89|9@0+ (0.1,0.0) [0.0|51.1] "dB" ASDM
 SG_ FrntSideRdrRiDetn110RdrDetnRng : 143|14@0+ (0.02,-1.0) [-1.0|200.0] "m" ASDM
 SG_ FrntSideRdrRiDetn110RdrDetnRngV : 124|13@0+ (0.02,-80.0) [-80.0|80.0] "m/s" ASDM
 SG_ FrntSideRdrRiDetn110RdrDetnSts : 91|2@0+ (1,0) [0|3] "" ASDM
 SG_ FrntSideRdrRiDetn111_UB : 234|1@0+ (1,0) [0|1] "" ASDM
 SG_ FrntSideRdrRiDetn111RdrDetnAzi : 199|11@0+ (0.1,-90.0) [-90.0|90.0] "Deg" ASDM
 SG_ FrntSideRdrRiDetn111RdrDetnChks : 167|8@0+ (1.0,0.0) [0.0|255.0] "Unitless" ASDM
 SG_ FrntSideRdrRiDetn111RdrDetnCntr : 175|4@0+ (1.0,0.0) [0.0|15.0] "Unitless" ASDM
 SG_ FrntSideRdrRiDetn111RdrDetnConf : 191|7@0+ (1.0,0.0) [0.0|100.0] "%" ASDM
 SG_ FrntSideRdrRiDetn111RdrDetnElevn : 239|5@0+ (1.0,-15.0) [-15.0|15.0] "Deg" ASDM
 SG_ FrntSideRdrRiDetn111RdrDetnPwr : 169|9@0+ (0.1,0.0) [0.0|51.1] "dB" ASDM
 SG_ FrntSideRdrRiDetn111RdrDetnRng : 223|14@0+ (0.02,-1.0) [-1.0|200.0] "m" ASDM
 SG_ FrntSideRdrRiDetn111RdrDetnRngV : 204|13@0+ (0.02,-80.0) [-80.0|80.0] "m/s" ASDM
 SG_ FrntSideRdrRiDetn111RdrDetnSts : 171|2@0+ (1,0) [0|3] "" ASDM
 SG_ FrntSideRdrRiDetn112_UB : 314|1@0+ (1,0) [0|1] "" ASDM
 SG_ FrntSideRdrRiDetn112RdrDetnAzi : 287|11@0+ (0.1,-90.0) [-90.0|90.0] "Deg" ASDM
 SG_ FrntSideRdrRiDetn112RdrDetnChks : 247|8@0+ (1.0,0.0) [0.0|255.0] "Unitless" ASDM
 SG_ FrntSideRdrRiDetn112RdrDetnCntr : 255|4@0+ (1.0,0.0) [0.0|15.0] "Unitless" ASDM
 SG_ FrntSideRdrRiDetn112RdrDetnConf : 311|7@0+ (1.0,0.0) [0.0|100.0] "%" ASDM
 SG_ FrntSideRdrRiDetn112RdrDetnElevn : 319|5@0+ (1.0,-15.0) [-15.0|15.0] "Deg" ASDM
 SG_ FrntSideRdrRiDetn112RdrDetnPwr : 249|9@0+ (0.1,0.0) [0.0|51.1] "dB" ASDM
 SG_ FrntSideRdrRiDetn112RdrDetnRng : 271|14@0+ (0.02,-1.0) [-1.0|200.0] "m" ASDM
 SG_ FrntSideRdrRiDetn112RdrDetnRngV : 292|13@0+ (0.02,-80.0) [-80.0|80.0] "m/s" ASDM
 SG_ FrntSideRdrRiDetn112RdrDetnSts : 251|2@0+ (1,0) [0|3] "" ASDM
 SG_ FrntSideRdrRiDetn113_UB : 394|1@0+ (1,0) [0|1] "" ASDM
 SG_ FrntSideRdrRiDetn113RdrDetnAzi : 367|11@0+ (0.1,-90.0) [-90.0|90.0] "Deg" ASDM
 SG_ FrntSideRdrRiDetn113RdrDetnChks : 327|8@0+ (1.0,0.0) [0.0|255.0] "Unitless" ASDM
 SG_ FrntSideRdrRiDetn113RdrDetnCntr : 335|4@0+ (1.0,0.0) [0.0|15.0] "Unitless" ASDM
 SG_ FrntSideRdrRiDetn113RdrDetnConf : 391|7@0+ (1.0,0.0) [0.0|100.0] "%" ASDM
 SG_ FrntSideRdrRiDetn113RdrDetnElevn : 399|5@0+ (1.0,-15.0) [-15.0|15.0] "Deg" ASDM
 SG_ FrntSideRdrRiDetn113RdrDetnPwr : 329|9@0+ (0.1,0.0) [0.0|51.1] "dB" ASDM
 SG_ FrntSideRdrRiDetn113RdrDetnRng : 351|14@0+ (0.02,-1.0) [-1.0|200.0] "m" ASDM
 SG_ FrntSideRdrRiDetn113RdrDetnRngV : 372|13@0+ (0.02,-80.0) [-80.0|80.0] "m/s" ASDM
 SG_ FrntSideRdrRiDetn113RdrDetnSts : 331|2@0+ (1,0) [0|3] "" ASDM
 SG_ FrntSideRdrRiDetn114_UB : 474|1@0+ (1,0) [0|1] "" ASDM
 SG_ FrntSideRdrRiDetn114RdrDetnAzi : 447|11@0+ (0.1,-90.0) [-90.0|90.0] "Deg" ASDM
 SG_ FrntSideRdrRiDetn114RdrDetnChks : 407|8@0+ (1.0,0.0) [0.0|255.0] "Unitless" ASDM
 SG_ FrntSideRdrRiDetn114RdrDetnCntr : 415|4@0+ (1.0,0.0) [0.0|15.0] "Unitless" ASDM
 SG_ FrntSideRdrRiDetn114RdrDetnConf : 471|7@0+ (1.0,0.0) [0.0|100.0] "%" ASDM
 SG_ FrntSideRdrRiDetn114RdrDetnElevn : 479|5@0+ (1.0,-15.0) [-15.0|15.0] "Deg" ASDM
 SG_ FrntSideRdrRiDetn114RdrDetnPwr : 409|9@0+ (0.1,0.0) [0.0|51.1] "dB" ASDM
 SG_ FrntSideRdrRiDetn114RdrDetnRng : 431|14@0+ (0.02,-1.0) [-1.0|200.0] "m" ASDM
 SG_ FrntSideRdrRiDetn114RdrDetnRngV : 452|13@0+ (0.02,-80.0) [-80.0|80.0] "m/s" ASDM
 SG_ FrntSideRdrRiDetn114RdrDetnSts : 411|2@0+ (1,0) [0|3] "" ASDM

BO_ 343 FSRRSafetyCANFD1Frame20 : 64 FSRR
 SG_ FrntSideRdrRiDetn115_UB : 74|1@0+ (1,0) [0|1] "" ASDM
 SG_ FrntSideRdrRiDetn115RdrDetnAzi : 31|11@0+ (0.1,-90.0) [-90.0|90.0] "Deg" ASDM
 SG_ FrntSideRdrRiDetn115RdrDetnChks : 7|8@0+ (1.0,0.0) [0.0|255.0] "Unitless" ASDM
 SG_ FrntSideRdrRiDetn115RdrDetnCntr : 15|4@0+ (1.0,0.0) [0.0|15.0] "Unitless" ASDM
 SG_ FrntSideRdrRiDetn115RdrDetnConf : 71|7@0+ (1.0,0.0) [0.0|100.0] "%" ASDM
 SG_ FrntSideRdrRiDetn115RdrDetnElevn : 79|5@0+ (1.0,-15.0) [-15.0|15.0] "Deg" ASDM
 SG_ FrntSideRdrRiDetn115RdrDetnPwr : 8|9@0+ (0.1,0.0) [0.0|51.1] "dB" ASDM
 SG_ FrntSideRdrRiDetn115RdrDetnRng : 55|14@0+ (0.02,-1.0) [-1.0|200.0] "m" ASDM
 SG_ FrntSideRdrRiDetn115RdrDetnRngV : 36|13@0+ (0.02,-80.0) [-80.0|80.0] "m/s" ASDM
 SG_ FrntSideRdrRiDetn115RdrDetnSts : 11|2@0+ (1,0) [0|3] "" ASDM
 SG_ FrntSideRdrRiDetn116_UB : 154|1@0+ (1,0) [0|1] "" ASDM
 SG_ FrntSideRdrRiDetn116RdrDetnAzi : 119|11@0+ (0.1,-90.0) [-90.0|90.0] "Deg" ASDM
 SG_ FrntSideRdrRiDetn116RdrDetnChks : 87|8@0+ (1.0,0.0) [0.0|255.0] "Unitless" ASDM
 SG_ FrntSideRdrRiDetn116RdrDetnCntr : 95|4@0+ (1.0,0.0) [0.0|15.0] "Unitless" ASDM
 SG_ FrntSideRdrRiDetn116RdrDetnConf : 111|7@0+ (1.0,0.0) [0.0|100.0] "%" ASDM
 SG_ FrntSideRdrRiDetn116RdrDetnElevn : 159|5@0+ (1.0,-15.0) [-15.0|15.0] "Deg" ASDM
 SG_ FrntSideRdrRiDetn116RdrDetnPwr : 89|9@0+ (0.1,0.0) [0.0|51.1] "dB" ASDM
 SG_ FrntSideRdrRiDetn116RdrDetnRng : 143|14@0+ (0.02,-1.0) [-1.0|200.0] "m" ASDM
 SG_ FrntSideRdrRiDetn116RdrDetnRngV : 124|13@0+ (0.02,-80.0) [-80.0|80.0] "m/s" ASDM
 SG_ FrntSideRdrRiDetn116RdrDetnSts : 91|2@0+ (1,0) [0|3] "" ASDM
 SG_ FrntSideRdrRiDetn117_UB : 234|1@0+ (1,0) [0|1] "" ASDM
 SG_ FrntSideRdrRiDetn117RdrDetnAzi : 199|11@0+ (0.1,-90.0) [-90.0|90.0] "Deg" ASDM
 SG_ FrntSideRdrRiDetn117RdrDetnChks : 167|8@0+ (1.0,0.0) [0.0|255.0] "Unitless" ASDM
 SG_ FrntSideRdrRiDetn117RdrDetnCntr : 175|4@0+ (1.0,0.0) [0.0|15.0] "Unitless" ASDM
 SG_ FrntSideRdrRiDetn117RdrDetnConf : 191|7@0+ (1.0,0.0) [0.0|100.0] "%" ASDM
 SG_ FrntSideRdrRiDetn117RdrDetnElevn : 239|5@0+ (1.0,-15.0) [-15.0|15.0] "Deg" ASDM
 SG_ FrntSideRdrRiDetn117RdrDetnPwr : 169|9@0+ (0.1,0.0) [0.0|51.1] "dB" ASDM
 SG_ FrntSideRdrRiDetn117RdrDetnRng : 223|14@0+ (0.02,-1.0) [-1.0|200.0] "m" ASDM
 SG_ FrntSideRdrRiDetn117RdrDetnRngV : 204|13@0+ (0.02,-80.0) [-80.0|80.0] "m/s" ASDM
 SG_ FrntSideRdrRiDetn117RdrDetnSts : 171|2@0+ (1,0) [0|3] "" ASDM
 SG_ FrntSideRdrRiDetn118_UB : 314|1@0+ (1,0) [0|1] "" ASDM
 SG_ FrntSideRdrRiDetn118RdrDetnAzi : 287|11@0+ (0.1,-90.0) [-90.0|90.0] "Deg" ASDM
 SG_ FrntSideRdrRiDetn118RdrDetnChks : 247|8@0+ (1.0,0.0) [0.0|255.0] "Unitless" ASDM
 SG_ FrntSideRdrRiDetn118RdrDetnCntr : 255|4@0+ (1.0,0.0) [0.0|15.0] "Unitless" ASDM
 SG_ FrntSideRdrRiDetn118RdrDetnConf : 311|7@0+ (1.0,0.0) [0.0|100.0] "%" ASDM
 SG_ FrntSideRdrRiDetn118RdrDetnElevn : 319|5@0+ (1.0,-15.0) [-15.0|15.0] "Deg" ASDM
 SG_ FrntSideRdrRiDetn118RdrDetnPwr : 249|9@0+ (0.1,0.0) [0.0|51.1] "dB" ASDM
 SG_ FrntSideRdrRiDetn118RdrDetnRng : 271|14@0+ (0.02,-1.0) [-1.0|200.0] "m" ASDM
 SG_ FrntSideRdrRiDetn118RdrDetnRngV : 292|13@0+ (0.02,-80.0) [-80.0|80.0] "m/s" ASDM
 SG_ FrntSideRdrRiDetn118RdrDetnSts : 251|2@0+ (1,0) [0|3] "" ASDM
 SG_ FrntSideRdrRiDetn119_UB : 394|1@0+ (1,0) [0|1] "" ASDM
 SG_ FrntSideRdrRiDetn119RdrDetnAzi : 367|11@0+ (0.1,-90.0) [-90.0|90.0] "Deg" ASDM
 SG_ FrntSideRdrRiDetn119RdrDetnChks : 327|8@0+ (1.0,0.0) [0.0|255.0] "Unitless" ASDM
 SG_ FrntSideRdrRiDetn119RdrDetnCntr : 335|4@0+ (1.0,0.0) [0.0|15.0] "Unitless" ASDM
 SG_ FrntSideRdrRiDetn119RdrDetnConf : 391|7@0+ (1.0,0.0) [0.0|100.0] "%" ASDM
 SG_ FrntSideRdrRiDetn119RdrDetnElevn : 399|5@0+ (1.0,-15.0) [-15.0|15.0] "Deg" ASDM
 SG_ FrntSideRdrRiDetn119RdrDetnPwr : 329|9@0+ (0.1,0.0) [0.0|51.1] "dB" ASDM
 SG_ FrntSideRdrRiDetn119RdrDetnRng : 351|14@0+ (0.02,-1.0) [-1.0|200.0] "m" ASDM
 SG_ FrntSideRdrRiDetn119RdrDetnRngV : 372|13@0+ (0.02,-80.0) [-80.0|80.0] "m/s" ASDM
 SG_ FrntSideRdrRiDetn119RdrDetnSts : 331|2@0+ (1,0) [0|3] "" ASDM
 SG_ FrntSideRdrRiDetn120_UB : 474|1@0+ (1,0) [0|1] "" ASDM
 SG_ FrntSideRdrRiDetn120RdrDetnAzi : 447|11@0+ (0.1,-90.0) [-90.0|90.0] "Deg" ASDM
 SG_ FrntSideRdrRiDetn120RdrDetnChks : 407|8@0+ (1.0,0.0) [0.0|255.0] "Unitless" ASDM
 SG_ FrntSideRdrRiDetn120RdrDetnCntr : 415|4@0+ (1.0,0.0) [0.0|15.0] "Unitless" ASDM
 SG_ FrntSideRdrRiDetn120RdrDetnConf : 471|7@0+ (1.0,0.0) [0.0|100.0] "%" ASDM
 SG_ FrntSideRdrRiDetn120RdrDetnElevn : 479|5@0+ (1.0,-15.0) [-15.0|15.0] "Deg" ASDM
 SG_ FrntSideRdrRiDetn120RdrDetnPwr : 409|9@0+ (0.1,0.0) [0.0|51.1] "dB" ASDM
 SG_ FrntSideRdrRiDetn120RdrDetnRng : 431|14@0+ (0.02,-1.0) [-1.0|200.0] "m" ASDM
 SG_ FrntSideRdrRiDetn120RdrDetnRngV : 452|13@0+ (0.02,-80.0) [-80.0|80.0] "m/s" ASDM
 SG_ FrntSideRdrRiDetn120RdrDetnSts : 411|2@0+ (1,0) [0|3] "" ASDM

BO_ 345 FSRRSafetyCANFD1Frame21 : 64 FSRR
 SG_ FrntSideRdrRiDetn121_UB : 74|1@0+ (1,0) [0|1] "" ASDM
 SG_ FrntSideRdrRiDetn121RdrDetnAzi : 31|11@0+ (0.1,-90.0) [-90.0|90.0] "Deg" ASDM
 SG_ FrntSideRdrRiDetn121RdrDetnChks : 7|8@0+ (1.0,0.0) [0.0|255.0] "Unitless" ASDM
 SG_ FrntSideRdrRiDetn121RdrDetnCntr : 15|4@0+ (1.0,0.0) [0.0|15.0] "Unitless" ASDM
 SG_ FrntSideRdrRiDetn121RdrDetnConf : 71|7@0+ (1.0,0.0) [0.0|100.0] "%" ASDM
 SG_ FrntSideRdrRiDetn121RdrDetnElevn : 79|5@0+ (1.0,-15.0) [-15.0|15.0] "Deg" ASDM
 SG_ FrntSideRdrRiDetn121RdrDetnPwr : 8|9@0+ (0.1,0.0) [0.0|51.1] "dB" ASDM
 SG_ FrntSideRdrRiDetn121RdrDetnRng : 55|14@0+ (0.02,-1.0) [-1.0|200.0] "m" ASDM
 SG_ FrntSideRdrRiDetn121RdrDetnRngV : 36|13@0+ (0.02,-80.0) [-80.0|80.0] "m/s" ASDM
 SG_ FrntSideRdrRiDetn121RdrDetnSts : 11|2@0+ (1,0) [0|3] "" ASDM
 SG_ FrntSideRdrRiDetn122_UB : 154|1@0+ (1,0) [0|1] "" ASDM
 SG_ FrntSideRdrRiDetn122RdrDetnAzi : 119|11@0+ (0.1,-90.0) [-90.0|90.0] "Deg" ASDM
 SG_ FrntSideRdrRiDetn122RdrDetnChks : 87|8@0+ (1.0,0.0) [0.0|255.0] "Unitless" ASDM
 SG_ FrntSideRdrRiDetn122RdrDetnCntr : 95|4@0+ (1.0,0.0) [0.0|15.0] "Unitless" ASDM
 SG_ FrntSideRdrRiDetn122RdrDetnConf : 111|7@0+ (1.0,0.0) [0.0|100.0] "%" ASDM
 SG_ FrntSideRdrRiDetn122RdrDetnElevn : 159|5@0+ (1.0,-15.0) [-15.0|15.0] "Deg" ASDM
 SG_ FrntSideRdrRiDetn122RdrDetnPwr : 89|9@0+ (0.1,0.0) [0.0|51.1] "dB" ASDM
 SG_ FrntSideRdrRiDetn122RdrDetnRng : 143|14@0+ (0.02,-1.0) [-1.0|200.0] "m" ASDM
 SG_ FrntSideRdrRiDetn122RdrDetnRngV : 124|13@0+ (0.02,-80.0) [-80.0|80.0] "m/s" ASDM
 SG_ FrntSideRdrRiDetn122RdrDetnSts : 91|2@0+ (1,0) [0|3] "" ASDM
 SG_ FrntSideRdrRiDetn123_UB : 234|1@0+ (1,0) [0|1] "" ASDM
 SG_ FrntSideRdrRiDetn123RdrDetnAzi : 199|11@0+ (0.1,-90.0) [-90.0|90.0] "Deg" ASDM
 SG_ FrntSideRdrRiDetn123RdrDetnChks : 167|8@0+ (1.0,0.0) [0.0|255.0] "Unitless" ASDM
 SG_ FrntSideRdrRiDetn123RdrDetnCntr : 175|4@0+ (1.0,0.0) [0.0|15.0] "Unitless" ASDM
 SG_ FrntSideRdrRiDetn123RdrDetnConf : 191|7@0+ (1.0,0.0) [0.0|100.0] "%" ASDM
 SG_ FrntSideRdrRiDetn123RdrDetnElevn : 239|5@0+ (1.0,-15.0) [-15.0|15.0] "Deg" ASDM
 SG_ FrntSideRdrRiDetn123RdrDetnPwr : 169|9@0+ (0.1,0.0) [0.0|51.1] "dB" ASDM
 SG_ FrntSideRdrRiDetn123RdrDetnRng : 223|14@0+ (0.02,-1.0) [-1.0|200.0] "m" ASDM
 SG_ FrntSideRdrRiDetn123RdrDetnRngV : 204|13@0+ (0.02,-80.0) [-80.0|80.0] "m/s" ASDM
 SG_ FrntSideRdrRiDetn123RdrDetnSts : 171|2@0+ (1,0) [0|3] "" ASDM
 SG_ FrntSideRdrRiDetn124_UB : 314|1@0+ (1,0) [0|1] "" ASDM
 SG_ FrntSideRdrRiDetn124RdrDetnAzi : 287|11@0+ (0.1,-90.0) [-90.0|90.0] "Deg" ASDM
 SG_ FrntSideRdrRiDetn124RdrDetnChks : 247|8@0+ (1.0,0.0) [0.0|255.0] "Unitless" ASDM
 SG_ FrntSideRdrRiDetn124RdrDetnCntr : 255|4@0+ (1.0,0.0) [0.0|15.0] "Unitless" ASDM
 SG_ FrntSideRdrRiDetn124RdrDetnConf : 311|7@0+ (1.0,0.0) [0.0|100.0] "%" ASDM
 SG_ FrntSideRdrRiDetn124RdrDetnElevn : 319|5@0+ (1.0,-15.0) [-15.0|15.0] "Deg" ASDM
 SG_ FrntSideRdrRiDetn124RdrDetnPwr : 249|9@0+ (0.1,0.0) [0.0|51.1] "dB" ASDM
 SG_ FrntSideRdrRiDetn124RdrDetnRng : 271|14@0+ (0.02,-1.0) [-1.0|200.0] "m" ASDM
 SG_ FrntSideRdrRiDetn124RdrDetnRngV : 292|13@0+ (0.02,-80.0) [-80.0|80.0] "m/s" ASDM
 SG_ FrntSideRdrRiDetn124RdrDetnSts : 251|2@0+ (1,0) [0|3] "" ASDM
 SG_ FrntSideRdrRiDetn125_UB : 394|1@0+ (1,0) [0|1] "" ASDM
 SG_ FrntSideRdrRiDetn125RdrDetnAzi : 351|11@0+ (0.1,-90.0) [-90.0|90.0] "Deg" ASDM
 SG_ FrntSideRdrRiDetn125RdrDetnChks : 327|8@0+ (1.0,0.0) [0.0|255.0] "Unitless" ASDM
 SG_ FrntSideRdrRiDetn125RdrDetnCntr : 335|4@0+ (1.0,0.0) [0.0|15.0] "Unitless" ASDM
 SG_ FrntSideRdrRiDetn125RdrDetnConf : 391|7@0+ (1.0,0.0) [0.0|100.0] "%" ASDM
 SG_ FrntSideRdrRiDetn125RdrDetnElevn : 399|5@0+ (1.0,-15.0) [-15.0|15.0] "Deg" ASDM
 SG_ FrntSideRdrRiDetn125RdrDetnPwr : 329|9@0+ (0.1,0.0) [0.0|51.1] "dB" ASDM
 SG_ FrntSideRdrRiDetn125RdrDetnRng : 375|14@0+ (0.02,-1.0) [-1.0|200.0] "m" ASDM
 SG_ FrntSideRdrRiDetn125RdrDetnRngV : 356|13@0+ (0.02,-80.0) [-80.0|80.0] "m/s" ASDM
 SG_ FrntSideRdrRiDetn125RdrDetnSts : 331|2@0+ (1,0) [0|3] "" ASDM
 SG_ FrntSideRdrRiDetn126_UB : 474|1@0+ (1,0) [0|1] "" ASDM
 SG_ FrntSideRdrRiDetn126RdrDetnAzi : 447|11@0+ (0.1,-90.0) [-90.0|90.0] "Deg" ASDM
 SG_ FrntSideRdrRiDetn126RdrDetnChks : 407|8@0+ (1.0,0.0) [0.0|255.0] "Unitless" ASDM
 SG_ FrntSideRdrRiDetn126RdrDetnCntr : 415|4@0+ (1.0,0.0) [0.0|15.0] "Unitless" ASDM
 SG_ FrntSideRdrRiDetn126RdrDetnConf : 471|7@0+ (1.0,0.0) [0.0|100.0] "%" ASDM
 SG_ FrntSideRdrRiDetn126RdrDetnElevn : 479|5@0+ (1.0,-15.0) [-15.0|15.0] "Deg" ASDM
 SG_ FrntSideRdrRiDetn126RdrDetnPwr : 409|9@0+ (0.1,0.0) [0.0|51.1] "dB" ASDM
 SG_ FrntSideRdrRiDetn126RdrDetnRng : 431|14@0+ (0.02,-1.0) [-1.0|200.0] "m" ASDM
 SG_ FrntSideRdrRiDetn126RdrDetnRngV : 452|13@0+ (0.02,-80.0) [-80.0|80.0] "m/s" ASDM
 SG_ FrntSideRdrRiDetn126RdrDetnSts : 411|2@0+ (1,0) [0|3] "" ASDM

BO_ 347 FSRRSafetyCANFD1Frame22 : 64 FSRR
 SG_ FrntSideRdrRiDetn127_UB : 74|1@0+ (1,0) [0|1] "" ASDM
 SG_ FrntSideRdrRiDetn127RdrDetnAzi : 31|11@0+ (0.1,-90.0) [-90.0|90.0] "Deg" ASDM
 SG_ FrntSideRdrRiDetn127RdrDetnChks : 7|8@0+ (1.0,0.0) [0.0|255.0] "Unitless" ASDM
 SG_ FrntSideRdrRiDetn127RdrDetnCntr : 15|4@0+ (1.0,0.0) [0.0|15.0] "Unitless" ASDM
 SG_ FrntSideRdrRiDetn127RdrDetnConf : 71|7@0+ (1.0,0.0) [0.0|100.0] "%" ASDM
 SG_ FrntSideRdrRiDetn127RdrDetnElevn : 79|5@0+ (1.0,-15.0) [-15.0|15.0] "Deg" ASDM
 SG_ FrntSideRdrRiDetn127RdrDetnPwr : 8|9@0+ (0.1,0.0) [0.0|51.1] "dB" ASDM
 SG_ FrntSideRdrRiDetn127RdrDetnRng : 55|14@0+ (0.02,-1.0) [-1.0|200.0] "m" ASDM
 SG_ FrntSideRdrRiDetn127RdrDetnRngV : 36|13@0+ (0.02,-80.0) [-80.0|80.0] "m/s" ASDM
 SG_ FrntSideRdrRiDetn127RdrDetnSts : 11|2@0+ (1,0) [0|3] "" ASDM
 SG_ FrntSideRdrRiDetn128_UB : 154|1@0+ (1,0) [0|1] "" ASDM
 SG_ FrntSideRdrRiDetn128RdrDetnAzi : 119|11@0+ (0.1,-90.0) [-90.0|90.0] "Deg" ASDM
 SG_ FrntSideRdrRiDetn128RdrDetnChks : 87|8@0+ (1.0,0.0) [0.0|255.0] "Unitless" ASDM
 SG_ FrntSideRdrRiDetn128RdrDetnCntr : 95|4@0+ (1.0,0.0) [0.0|15.0] "Unitless" ASDM
 SG_ FrntSideRdrRiDetn128RdrDetnConf : 111|7@0+ (1.0,0.0) [0.0|100.0] "%" ASDM
 SG_ FrntSideRdrRiDetn128RdrDetnElevn : 159|5@0+ (1.0,-15.0) [-15.0|15.0] "Deg" ASDM
 SG_ FrntSideRdrRiDetn128RdrDetnPwr : 89|9@0+ (0.1,0.0) [0.0|51.1] "dB" ASDM
 SG_ FrntSideRdrRiDetn128RdrDetnRng : 143|14@0+ (0.02,-1.0) [-1.0|200.0] "m" ASDM
 SG_ FrntSideRdrRiDetn128RdrDetnRngV : 124|13@0+ (0.02,-80.0) [-80.0|80.0] "m/s" ASDM
 SG_ FrntSideRdrRiDetn128RdrDetnSts : 91|2@0+ (1,0) [0|3] "" ASDM

BO_ 349 FSRRSafetyCANFD1Frame23 : 64 FSRR
 SG_ FrntSideRdrRiObj1_UB : 319|1@0+ (1,0) [0|1] "" ASDM
 SG_ FrntSideRdrRiObj1Heading : 287|12@0+ (0.1,-180.0) [-180.0|180.0] "Deg" ASDM
 SG_ FrntSideRdrRiObj1ObjBoxCenterLat : 23|9@0+ (0.1,-25.0) [-25.0|25.0] "m" ASDM
 SG_ FrntSideRdrRiObj1ObjBoxCenterLgt : 30|9@0+ (0.1,-25.0) [-25.0|25.0] "m" ASDM
 SG_ FrntSideRdrRiObj1ObservationHist : 63|32@0+ (1.0,0.0) [0.0|4294967295.0] "Unitless" ASDM
 SG_ FrntSideRdrRiObj1QualityBits : 289|18@0+ (1.0,0.0) [0.0|262143.0] "Unitless" ASDM
 SG_ FrntSideRdrRiObj1RdrObjAx : 7|8@0- (0.1,0.0) [-12.8|12.700000000000001] "m/s^2" ASDM
 SG_ FrntSideRdrRiObj1RdrObjAy : 15|8@0- (0.1,0.0) [-12.8|12.700000000000001] "m/s^2" ASDM
 SG_ FrntSideRdrRiObj1RdrObjBoxLength : 37|9@0+ (0.1,0.0) [0.0|50.0] "m" ASDM
 SG_ FrntSideRdrRiObj1RdrObjBoxWidth : 44|9@0+ (0.1,0.0) [0.0|50.0] "m" ASDM
 SG_ FrntSideRdrRiObj1RdrObjChks : 95|8@0+ (1.0,0.0) [0.0|255.0] "Unitless" ASDM
 SG_ FrntSideRdrRiObj1RdrObjCntr : 103|4@0+ (1.0,0.0) [0.0|15.0] "Unitless" ASDM
 SG_ FrntSideRdrRiObj1RdrObjCoastCnt : 279|5@0+ (1.0,0.0) [0.0|31.0] "Unitless" ASDM
 SG_ FrntSideRdrRiObj1RdrObjConf : 99|4@0+ (7.0,0.0) [0.0|105.0] "%" ASDM
 SG_ FrntSideRdrRiObj1RdrObjDx : 191|13@0+ (0.05,-200.0) [-200.0|200.0] "m" ASDM
 SG_ FrntSideRdrRiObj1RdrObjDxStdDe : 111|8@0+ (0.05,0.0) [0.0|12.700000000000001] "m" ASDM
 SG_ FrntSideRdrRiObj1RdrObjDy : 119|13@0+ (0.05,-200.0) [-200.0|200.0] "m" ASDM
 SG_ FrntSideRdrRiObj1RdrObjDyStdDe : 183|8@0+ (0.05,0.0) [0.0|12.700000000000001] "m" ASDM
 SG_ FrntSideRdrRiObj1RdrObjElevnConf : 223|4@0+ (7.0,0.0) [0.0|105.0] "%" ASDM
 SG_ FrntSideRdrRiObj1RdrObjElevnSts : 153|2@0+ (1,0) [0|3] "" ASDM
 SG_ FrntSideRdrRiObj1RdrObjID : 167|8@0+ (1.0,0.0) [0.0|255.0] "Unitless" ASDM
 SG_ FrntSideRdrRiObj1RdrObjIsInFreeSpace : 192|1@0+ (1,0) [0|1] "" ASDM
 SG_ FrntSideRdrRiObj1RdrObjMirrProblty : 219|4@0+ (7.0,0.0) [0.0|105.0] "%" ASDM
 SG_ FrntSideRdrRiObj1RdrObjMtnPat : 122|3@0+ (1,0) [0|7] "" ASDM
 SG_ FrntSideRdrRiObj1RdrObjNotRealProblty : 231|4@0+ (7.0,0.0) [0.0|105.0] "%" ASDM
 SG_ FrntSideRdrRiObj1RdrObjStatyCnt : 239|7@0+ (1.0,0.0) [0.0|127.0] "Unitless" ASDM
 SG_ FrntSideRdrRiObj1RdrObjTiAlv : 247|7@0+ (1.0,0.0) [0.0|127.0] "Unitless" ASDM
 SG_ FrntSideRdrRiObj1RdrObjTrackSts : 194|2@0+ (1,0) [0|3] "" ASDM
 SG_ FrntSideRdrRiObj1RdrObjTyp : 51|4@0+ (1,0) [0|15] "" ASDM
 SG_ FrntSideRdrRiObj1RdrObjTypConfBike : 175|4@0+ (7.0,0.0) [0.0|105.0] "%" ASDM
 SG_ FrntSideRdrRiObj1RdrObjTypConfPed : 171|4@0+ (7.0,0.0) [0.0|105.0] "%" ASDM
 SG_ FrntSideRdrRiObj1RdrObjTypConfVeh : 227|4@0+ (7.0,0.0) [0.0|105.0] "%" ASDM
 SG_ FrntSideRdrRiObj1RdrObjUsedTracker : 291|2@0+ (1,0) [0|3] "" ASDM
 SG_ FrntSideRdrRiObj1RdrObjVx : 255|14@0+ (0.02,-128.0) [-128.0|128.0] "m/s" ASDM
 SG_ FrntSideRdrRiObj1RdrObjVxStdDe : 271|6@0+ (0.05,0.0) [0.0|2.0] "m/s" ASDM
 SG_ FrntSideRdrRiObj1RdrObjVy : 207|14@0+ (0.02,-128.0) [-128.0|128.0] "m/s" ASDM
 SG_ FrntSideRdrRiObj1RdrObjVyStdDe : 159|6@0+ (0.05,0.0) [0.0|2.0] "m/s" ASDM
 SG_ FrntSideRdrRiObj1RelVx : 135|12@0+ (0.02,-35.6) [-35.6|35.6] "m/s" ASDM
 SG_ FrntSideRdrRiObj1RelVy : 139|12@0+ (0.02,-35.6) [-35.6|35.6] "m/s" ASDM

BO_ 351 FSRRSafetyCANFD1Frame24 : 64 FSRR
 SG_ FrntSideRdrRiObj2_UB : 319|1@0+ (1,0) [0|1] "" ASDM
 SG_ FrntSideRdrRiObj2Heading : 287|12@0+ (0.1,-180.0) [-180.0|180.0] "Deg" ASDM
 SG_ FrntSideRdrRiObj2ObjBoxCenterLat : 23|9@0+ (0.1,-25.0) [-25.0|25.0] "m" ASDM
 SG_ FrntSideRdrRiObj2ObjBoxCenterLgt : 30|9@0+ (0.1,-25.0) [-25.0|25.0] "m" ASDM
 SG_ FrntSideRdrRiObj2ObservationHist : 63|32@0+ (1.0,0.0) [0.0|4294967295.0] "Unitless" ASDM
 SG_ FrntSideRdrRiObj2QualityBits : 289|18@0+ (1.0,0.0) [0.0|262143.0] "Unitless" ASDM
 SG_ FrntSideRdrRiObj2RdrObjAx : 7|8@0- (0.1,0.0) [-12.8|12.700000000000001] "m/s^2" ASDM
 SG_ FrntSideRdrRiObj2RdrObjAy : 15|8@0- (0.1,0.0) [-12.8|12.700000000000001] "m/s^2" ASDM
 SG_ FrntSideRdrRiObj2RdrObjBoxLength : 37|9@0+ (0.1,0.0) [0.0|50.0] "m" ASDM
 SG_ FrntSideRdrRiObj2RdrObjBoxWidth : 44|9@0+ (0.1,0.0) [0.0|50.0] "m" ASDM
 SG_ FrntSideRdrRiObj2RdrObjChks : 95|8@0+ (1.0,0.0) [0.0|255.0] "Unitless" ASDM
 SG_ FrntSideRdrRiObj2RdrObjCntr : 103|4@0+ (1.0,0.0) [0.0|15.0] "Unitless" ASDM
 SG_ FrntSideRdrRiObj2RdrObjCoastCnt : 279|5@0+ (1.0,0.0) [0.0|31.0] "Unitless" ASDM
 SG_ FrntSideRdrRiObj2RdrObjConf : 99|4@0+ (7.0,0.0) [0.0|105.0] "%" ASDM
 SG_ FrntSideRdrRiObj2RdrObjDx : 191|13@0+ (0.05,-200.0) [-200.0|200.0] "m" ASDM
 SG_ FrntSideRdrRiObj2RdrObjDxStdDe : 111|8@0+ (0.05,0.0) [0.0|12.700000000000001] "m" ASDM
 SG_ FrntSideRdrRiObj2RdrObjDy : 119|13@0+ (0.05,-200.0) [-200.0|200.0] "m" ASDM
 SG_ FrntSideRdrRiObj2RdrObjDyStdDe : 183|8@0+ (0.05,0.0) [0.0|12.700000000000001] "m" ASDM
 SG_ FrntSideRdrRiObj2RdrObjElevnConf : 223|4@0+ (7.0,0.0) [0.0|105.0] "%" ASDM
 SG_ FrntSideRdrRiObj2RdrObjElevnSts : 153|2@0+ (1,0) [0|3] "" ASDM
 SG_ FrntSideRdrRiObj2RdrObjID : 167|8@0+ (1.0,0.0) [0.0|255.0] "Unitless" ASDM
 SG_ FrntSideRdrRiObj2RdrObjIsInFreeSpace : 192|1@0+ (1,0) [0|1] "" ASDM
 SG_ FrntSideRdrRiObj2RdrObjMirrProblty : 219|4@0+ (7.0,0.0) [0.0|105.0] "%" ASDM
 SG_ FrntSideRdrRiObj2RdrObjMtnPat : 122|3@0+ (1,0) [0|7] "" ASDM
 SG_ FrntSideRdrRiObj2RdrObjNotRealProblty : 231|4@0+ (7.0,0.0) [0.0|105.0] "%" ASDM
 SG_ FrntSideRdrRiObj2RdrObjStatyCnt : 239|7@0+ (1.0,0.0) [0.0|127.0] "Unitless" ASDM
 SG_ FrntSideRdrRiObj2RdrObjTiAlv : 247|7@0+ (1.0,0.0) [0.0|127.0] "Unitless" ASDM
 SG_ FrntSideRdrRiObj2RdrObjTrackSts : 194|2@0+ (1,0) [0|3] "" ASDM
 SG_ FrntSideRdrRiObj2RdrObjTyp : 51|4@0+ (1,0) [0|15] "" ASDM
 SG_ FrntSideRdrRiObj2RdrObjTypConfBike : 175|4@0+ (7.0,0.0) [0.0|105.0] "%" ASDM
 SG_ FrntSideRdrRiObj2RdrObjTypConfPed : 171|4@0+ (7.0,0.0) [0.0|105.0] "%" ASDM
 SG_ FrntSideRdrRiObj2RdrObjTypConfVeh : 227|4@0+ (7.0,0.0) [0.0|105.0] "%" ASDM
 SG_ FrntSideRdrRiObj2RdrObjUsedTracker : 291|2@0+ (1,0) [0|3] "" ASDM
 SG_ FrntSideRdrRiObj2RdrObjVx : 255|14@0+ (0.02,-128.0) [-128.0|128.0] "m/s" ASDM
 SG_ FrntSideRdrRiObj2RdrObjVxStdDe : 271|6@0+ (0.05,0.0) [0.0|2.0] "m/s" ASDM
 SG_ FrntSideRdrRiObj2RdrObjVy : 207|14@0+ (0.02,-128.0) [-128.0|128.0] "m/s" ASDM
 SG_ FrntSideRdrRiObj2RdrObjVyStdDe : 159|6@0+ (0.05,0.0) [0.0|2.0] "m/s" ASDM
 SG_ FrntSideRdrRiObj2RelVx : 135|12@0+ (0.02,-35.6) [-35.6|35.6] "m/s" ASDM
 SG_ FrntSideRdrRiObj2RelVy : 139|12@0+ (0.02,-35.6) [-35.6|35.6] "m/s" ASDM

BO_ 353 FSRRSafetyCANFD1Frame25 : 64 FSRR
 SG_ FrntSideRdrRiObj3_UB : 319|1@0+ (1,0) [0|1] "" ASDM
 SG_ FrntSideRdrRiObj3Heading : 287|12@0+ (0.1,-180.0) [-180.0|180.0] "Deg" ASDM
 SG_ FrntSideRdrRiObj3ObjBoxCenterLat : 23|9@0+ (0.1,-25.0) [-25.0|25.0] "m" ASDM
 SG_ FrntSideRdrRiObj3ObjBoxCenterLgt : 30|9@0+ (0.1,-25.0) [-25.0|25.0] "m" ASDM
 SG_ FrntSideRdrRiObj3ObservationHist : 63|32@0+ (1.0,0.0) [0.0|4294967295.0] "Unitless" ASDM
 SG_ FrntSideRdrRiObj3QualityBits : 289|18@0+ (1.0,0.0) [0.0|262143.0] "Unitless" ASDM
 SG_ FrntSideRdrRiObj3RdrObjAx : 7|8@0- (0.1,0.0) [-12.8|12.700000000000001] "m/s^2" ASDM
 SG_ FrntSideRdrRiObj3RdrObjAy : 15|8@0- (0.1,0.0) [-12.8|12.700000000000001] "m/s^2" ASDM
 SG_ FrntSideRdrRiObj3RdrObjBoxLength : 37|9@0+ (0.1,0.0) [0.0|50.0] "m" ASDM
 SG_ FrntSideRdrRiObj3RdrObjBoxWidth : 44|9@0+ (0.1,0.0) [0.0|50.0] "m" ASDM
 SG_ FrntSideRdrRiObj3RdrObjChks : 95|8@0+ (1.0,0.0) [0.0|255.0] "Unitless" ASDM
 SG_ FrntSideRdrRiObj3RdrObjCntr : 103|4@0+ (1.0,0.0) [0.0|15.0] "Unitless" ASDM
 SG_ FrntSideRdrRiObj3RdrObjCoastCnt : 279|5@0+ (1.0,0.0) [0.0|31.0] "Unitless" ASDM
 SG_ FrntSideRdrRiObj3RdrObjConf : 99|4@0+ (7.0,0.0) [0.0|105.0] "%" ASDM
 SG_ FrntSideRdrRiObj3RdrObjDx : 191|13@0+ (0.05,-200.0) [-200.0|200.0] "m" ASDM
 SG_ FrntSideRdrRiObj3RdrObjDxStdDe : 111|8@0+ (0.05,0.0) [0.0|12.700000000000001] "m" ASDM
 SG_ FrntSideRdrRiObj3RdrObjDy : 119|13@0+ (0.05,-200.0) [-200.0|200.0] "m" ASDM
 SG_ FrntSideRdrRiObj3RdrObjDyStdDe : 183|8@0+ (0.05,0.0) [0.0|12.700000000000001] "m" ASDM
 SG_ FrntSideRdrRiObj3RdrObjElevnConf : 223|4@0+ (7.0,0.0) [0.0|105.0] "%" ASDM
 SG_ FrntSideRdrRiObj3RdrObjElevnSts : 153|2@0+ (1,0) [0|3] "" ASDM
 SG_ FrntSideRdrRiObj3RdrObjID : 167|8@0+ (1.0,0.0) [0.0|255.0] "Unitless" ASDM
 SG_ FrntSideRdrRiObj3RdrObjIsInFreeSpace : 192|1@0+ (1,0) [0|1] "" ASDM
 SG_ FrntSideRdrRiObj3RdrObjMirrProblty : 219|4@0+ (7.0,0.0) [0.0|105.0] "%" ASDM
 SG_ FrntSideRdrRiObj3RdrObjMtnPat : 122|3@0+ (1,0) [0|7] "" ASDM
 SG_ FrntSideRdrRiObj3RdrObjNotRealProblty : 231|4@0+ (7.0,0.0) [0.0|105.0] "%" ASDM
 SG_ FrntSideRdrRiObj3RdrObjStatyCnt : 239|7@0+ (1.0,0.0) [0.0|127.0] "Unitless" ASDM
 SG_ FrntSideRdrRiObj3RdrObjTiAlv : 247|7@0+ (1.0,0.0) [0.0|127.0] "Unitless" ASDM
 SG_ FrntSideRdrRiObj3RdrObjTrackSts : 194|2@0+ (1,0) [0|3] "" ASDM
 SG_ FrntSideRdrRiObj3RdrObjTyp : 51|4@0+ (1,0) [0|15] "" ASDM
 SG_ FrntSideRdrRiObj3RdrObjTypConfBike : 175|4@0+ (7.0,0.0) [0.0|105.0] "%" ASDM
 SG_ FrntSideRdrRiObj3RdrObjTypConfPed : 171|4@0+ (7.0,0.0) [0.0|105.0] "%" ASDM
 SG_ FrntSideRdrRiObj3RdrObjTypConfVeh : 227|4@0+ (7.0,0.0) [0.0|105.0] "%" ASDM
 SG_ FrntSideRdrRiObj3RdrObjUsedTracker : 291|2@0+ (1,0) [0|3] "" ASDM
 SG_ FrntSideRdrRiObj3RdrObjVx : 255|14@0+ (0.02,-128.0) [-128.0|128.0] "m/s" ASDM
 SG_ FrntSideRdrRiObj3RdrObjVxStdDe : 271|6@0+ (0.05,0.0) [0.0|2.0] "m/s" ASDM
 SG_ FrntSideRdrRiObj3RdrObjVy : 207|14@0+ (0.02,-128.0) [-128.0|128.0] "m/s" ASDM
 SG_ FrntSideRdrRiObj3RdrObjVyStdDe : 159|6@0+ (0.05,0.0) [0.0|2.0] "m/s" ASDM
 SG_ FrntSideRdrRiObj3RelVx : 135|12@0+ (0.02,-35.6) [-35.6|35.6] "m/s" ASDM
 SG_ FrntSideRdrRiObj3RelVy : 139|12@0+ (0.02,-35.6) [-35.6|35.6] "m/s" ASDM

BO_ 355 FSRRSafetyCANFD1Frame26 : 64 FSRR
 SG_ FrntSideRdrRiObj4_UB : 319|1@0+ (1,0) [0|1] "" ASDM
 SG_ FrntSideRdrRiObj4Heading : 287|12@0+ (0.1,-180.0) [-180.0|180.0] "Deg" ASDM
 SG_ FrntSideRdrRiObj4ObjBoxCenterLat : 23|9@0+ (0.1,-25.0) [-25.0|25.0] "m" ASDM
 SG_ FrntSideRdrRiObj4ObjBoxCenterLgt : 30|9@0+ (0.1,-25.0) [-25.0|25.0] "m" ASDM
 SG_ FrntSideRdrRiObj4ObservationHist : 63|32@0+ (1.0,0.0) [0.0|4294967295.0] "Unitless" ASDM
 SG_ FrntSideRdrRiObj4QualityBits : 289|18@0+ (1.0,0.0) [0.0|262143.0] "Unitless" ASDM
 SG_ FrntSideRdrRiObj4RdrObjAx : 7|8@0- (0.1,0.0) [-12.8|12.700000000000001] "m/s^2" ASDM
 SG_ FrntSideRdrRiObj4RdrObjAy : 15|8@0- (0.1,0.0) [-12.8|12.700000000000001] "m/s^2" ASDM
 SG_ FrntSideRdrRiObj4RdrObjBoxLength : 37|9@0+ (0.1,0.0) [0.0|50.0] "m" ASDM
 SG_ FrntSideRdrRiObj4RdrObjBoxWidth : 44|9@0+ (0.1,0.0) [0.0|50.0] "m" ASDM
 SG_ FrntSideRdrRiObj4RdrObjChks : 95|8@0+ (1.0,0.0) [0.0|255.0] "Unitless" ASDM
 SG_ FrntSideRdrRiObj4RdrObjCntr : 103|4@0+ (1.0,0.0) [0.0|15.0] "Unitless" ASDM
 SG_ FrntSideRdrRiObj4RdrObjCoastCnt : 279|5@0+ (1.0,0.0) [0.0|31.0] "Unitless" ASDM
 SG_ FrntSideRdrRiObj4RdrObjConf : 99|4@0+ (7.0,0.0) [0.0|105.0] "%" ASDM
 SG_ FrntSideRdrRiObj4RdrObjDx : 191|13@0+ (0.05,-200.0) [-200.0|200.0] "m" ASDM
 SG_ FrntSideRdrRiObj4RdrObjDxStdDe : 111|8@0+ (0.05,0.0) [0.0|12.700000000000001] "m" ASDM
 SG_ FrntSideRdrRiObj4RdrObjDy : 119|13@0+ (0.05,-200.0) [-200.0|200.0] "m" ASDM
 SG_ FrntSideRdrRiObj4RdrObjDyStdDe : 183|8@0+ (0.05,0.0) [0.0|12.700000000000001] "m" ASDM
 SG_ FrntSideRdrRiObj4RdrObjElevnConf : 223|4@0+ (7.0,0.0) [0.0|105.0] "%" ASDM
 SG_ FrntSideRdrRiObj4RdrObjElevnSts : 153|2@0+ (1,0) [0|3] "" ASDM
 SG_ FrntSideRdrRiObj4RdrObjID : 167|8@0+ (1.0,0.0) [0.0|255.0] "Unitless" ASDM
 SG_ FrntSideRdrRiObj4RdrObjIsInFreeSpace : 192|1@0+ (1,0) [0|1] "" ASDM
 SG_ FrntSideRdrRiObj4RdrObjMirrProblty : 219|4@0+ (7.0,0.0) [0.0|105.0] "%" ASDM
 SG_ FrntSideRdrRiObj4RdrObjMtnPat : 122|3@0+ (1,0) [0|7] "" ASDM
 SG_ FrntSideRdrRiObj4RdrObjNotRealProblty : 231|4@0+ (7.0,0.0) [0.0|105.0] "%" ASDM
 SG_ FrntSideRdrRiObj4RdrObjStatyCnt : 239|7@0+ (1.0,0.0) [0.0|127.0] "Unitless" ASDM
 SG_ FrntSideRdrRiObj4RdrObjTiAlv : 247|7@0+ (1.0,0.0) [0.0|127.0] "Unitless" ASDM
 SG_ FrntSideRdrRiObj4RdrObjTrackSts : 194|2@0+ (1,0) [0|3] "" ASDM
 SG_ FrntSideRdrRiObj4RdrObjTyp : 51|4@0+ (1,0) [0|15] "" ASDM
 SG_ FrntSideRdrRiObj4RdrObjTypConfBike : 175|4@0+ (7.0,0.0) [0.0|105.0] "%" ASDM
 SG_ FrntSideRdrRiObj4RdrObjTypConfPed : 171|4@0+ (7.0,0.0) [0.0|105.0] "%" ASDM
 SG_ FrntSideRdrRiObj4RdrObjTypConfVeh : 227|4@0+ (7.0,0.0) [0.0|105.0] "%" ASDM
 SG_ FrntSideRdrRiObj4RdrObjUsedTracker : 291|2@0+ (1,0) [0|3] "" ASDM
 SG_ FrntSideRdrRiObj4RdrObjVx : 255|14@0+ (0.02,-128.0) [-128.0|128.0] "m/s" ASDM
 SG_ FrntSideRdrRiObj4RdrObjVxStdDe : 271|6@0+ (0.05,0.0) [0.0|2.0] "m/s" ASDM
 SG_ FrntSideRdrRiObj4RdrObjVy : 207|14@0+ (0.02,-128.0) [-128.0|128.0] "m/s" ASDM
 SG_ FrntSideRdrRiObj4RdrObjVyStdDe : 159|6@0+ (0.05,0.0) [0.0|2.0] "m/s" ASDM
 SG_ FrntSideRdrRiObj4RelVx : 135|12@0+ (0.02,-35.6) [-35.6|35.6] "m/s" ASDM
 SG_ FrntSideRdrRiObj4RelVy : 139|12@0+ (0.02,-35.6) [-35.6|35.6] "m/s" ASDM

BO_ 357 FSRRSafetyCANFD1Frame27 : 64 FSRR
 SG_ FrntSideRdrRiObj5_UB : 319|1@0+ (1,0) [0|1] "" ASDM
 SG_ FrntSideRdrRiObj5Heading : 287|12@0+ (0.1,-180.0) [-180.0|180.0] "Deg" ASDM
 SG_ FrntSideRdrRiObj5ObjBoxCenterLat : 23|9@0+ (0.1,-25.0) [-25.0|25.0] "m" ASDM
 SG_ FrntSideRdrRiObj5ObjBoxCenterLgt : 30|9@0+ (0.1,-25.0) [-25.0|25.0] "m" ASDM
 SG_ FrntSideRdrRiObj5ObservationHist : 63|32@0+ (1.0,0.0) [0.0|4294967295.0] "Unitless" ASDM
 SG_ FrntSideRdrRiObj5QualityBits : 289|18@0+ (1.0,0.0) [0.0|262143.0] "Unitless" ASDM
 SG_ FrntSideRdrRiObj5RdrObjAx : 7|8@0- (0.1,0.0) [-12.8|12.700000000000001] "m/s^2" ASDM
 SG_ FrntSideRdrRiObj5RdrObjAy : 15|8@0- (0.1,0.0) [-12.8|12.700000000000001] "m/s^2" ASDM
 SG_ FrntSideRdrRiObj5RdrObjBoxLength : 37|9@0+ (0.1,0.0) [0.0|50.0] "m" ASDM
 SG_ FrntSideRdrRiObj5RdrObjBoxWidth : 44|9@0+ (0.1,0.0) [0.0|50.0] "m" ASDM
 SG_ FrntSideRdrRiObj5RdrObjChks : 95|8@0+ (1.0,0.0) [0.0|255.0] "Unitless" ASDM
 SG_ FrntSideRdrRiObj5RdrObjCntr : 103|4@0+ (1.0,0.0) [0.0|15.0] "Unitless" ASDM
 SG_ FrntSideRdrRiObj5RdrObjCoastCnt : 279|5@0+ (1.0,0.0) [0.0|31.0] "Unitless" ASDM
 SG_ FrntSideRdrRiObj5RdrObjConf : 99|4@0+ (7.0,0.0) [0.0|105.0] "%" ASDM
 SG_ FrntSideRdrRiObj5RdrObjDx : 191|13@0+ (0.05,-200.0) [-200.0|200.0] "m" ASDM
 SG_ FrntSideRdrRiObj5RdrObjDxStdDe : 111|8@0+ (0.05,0.0) [0.0|12.700000000000001] "m" ASDM
 SG_ FrntSideRdrRiObj5RdrObjDy : 119|13@0+ (0.05,-200.0) [-200.0|200.0] "m" ASDM
 SG_ FrntSideRdrRiObj5RdrObjDyStdDe : 183|8@0+ (0.05,0.0) [0.0|12.700000000000001] "m" ASDM
 SG_ FrntSideRdrRiObj5RdrObjElevnConf : 223|4@0+ (7.0,0.0) [0.0|105.0] "%" ASDM
 SG_ FrntSideRdrRiObj5RdrObjElevnSts : 153|2@0+ (1,0) [0|3] "" ASDM
 SG_ FrntSideRdrRiObj5RdrObjID : 167|8@0+ (1.0,0.0) [0.0|255.0] "Unitless" ASDM
 SG_ FrntSideRdrRiObj5RdrObjIsInFreeSpace : 192|1@0+ (1,0) [0|1] "" ASDM
 SG_ FrntSideRdrRiObj5RdrObjMirrProblty : 219|4@0+ (7.0,0.0) [0.0|105.0] "%" ASDM
 SG_ FrntSideRdrRiObj5RdrObjMtnPat : 122|3@0+ (1,0) [0|7] "" ASDM
 SG_ FrntSideRdrRiObj5RdrObjNotRealProblty : 231|4@0+ (7.0,0.0) [0.0|105.0] "%" ASDM
 SG_ FrntSideRdrRiObj5RdrObjStatyCnt : 239|7@0+ (1.0,0.0) [0.0|127.0] "Unitless" ASDM
 SG_ FrntSideRdrRiObj5RdrObjTiAlv : 247|7@0+ (1.0,0.0) [0.0|127.0] "Unitless" ASDM
 SG_ FrntSideRdrRiObj5RdrObjTrackSts : 194|2@0+ (1,0) [0|3] "" ASDM
 SG_ FrntSideRdrRiObj5RdrObjTyp : 51|4@0+ (1,0) [0|15] "" ASDM
 SG_ FrntSideRdrRiObj5RdrObjTypConfBike : 175|4@0+ (7.0,0.0) [0.0|105.0] "%" ASDM
 SG_ FrntSideRdrRiObj5RdrObjTypConfPed : 171|4@0+ (7.0,0.0) [0.0|105.0] "%" ASDM
 SG_ FrntSideRdrRiObj5RdrObjTypConfVeh : 227|4@0+ (7.0,0.0) [0.0|105.0] "%" ASDM
 SG_ FrntSideRdrRiObj5RdrObjUsedTracker : 291|2@0+ (1,0) [0|3] "" ASDM
 SG_ FrntSideRdrRiObj5RdrObjVx : 255|14@0+ (0.02,-128.0) [-128.0|128.0] "m/s" ASDM
 SG_ FrntSideRdrRiObj5RdrObjVxStdDe : 271|6@0+ (0.05,0.0) [0.0|2.0] "m/s" ASDM
 SG_ FrntSideRdrRiObj5RdrObjVy : 207|14@0+ (0.02,-128.0) [-128.0|128.0] "m/s" ASDM
 SG_ FrntSideRdrRiObj5RdrObjVyStdDe : 159|6@0+ (0.05,0.0) [0.0|2.0] "m/s" ASDM
 SG_ FrntSideRdrRiObj5RelVx : 135|12@0+ (0.02,-35.6) [-35.6|35.6] "m/s" ASDM
 SG_ FrntSideRdrRiObj5RelVy : 139|12@0+ (0.02,-35.6) [-35.6|35.6] "m/s" ASDM

CM_ SG_ 337 FrntSideRdrRiDetn100RdrDetnAzi "Refer to the data element description in FrntSideRdrLeDetn1 with the same data element name.";
CM_ SG_ 337 FrntSideRdrRiDetn100RdrDetnChks "Refer to the data element description in FrntSideRdrLeDetn1 with the same data element name.";
CM_ SG_ 337 FrntSideRdrRiDetn100RdrDetnCntr "Refer to the data element description in FrntSideRdrLeDetn1 with the same data element name.";
CM_ SG_ 337 FrntSideRdrRiDetn100RdrDetnConf "Refer to the data element description in FrntSideRdrLeDetn1 with the same data element name.";
CM_ SG_ 337 FrntSideRdrRiDetn100RdrDetnElevn "Refer to the data element description in FrntSideRdrLeDetn1 with the same data element name.";
CM_ SG_ 337 FrntSideRdrRiDetn100RdrDetnPwr "Refer to the data element description in FrntSideRdrLeDetn1 with the same data element name.";
CM_ SG_ 337 FrntSideRdrRiDetn100RdrDetnRng "Refer to the data element description in FrntSideRdrLeDetn1 with the same data element name.";
CM_ SG_ 337 FrntSideRdrRiDetn100RdrDetnRngV "Range Velocity";
CM_ SG_ 337 FrntSideRdrRiDetn100RdrDetnSts "Refer to the data element description in FrntSideRdrLeDetn1 with the same data element name.";
CM_ SG_ 337 FrntSideRdrRiDetn101RdrDetnAzi "Refer to the data element description in FrntSideRdrLeDetn1 with the same data element name.";
CM_ SG_ 337 FrntSideRdrRiDetn101RdrDetnChks "Refer to the data element description in FrntSideRdrLeDetn1 with the same data element name.";
CM_ SG_ 337 FrntSideRdrRiDetn101RdrDetnCntr "Refer to the data element description in FrntSideRdrLeDetn1 with the same data element name.";
CM_ SG_ 337 FrntSideRdrRiDetn101RdrDetnConf "Refer to the data element description in FrntSideRdrLeDetn1 with the same data element name.";
CM_ SG_ 337 FrntSideRdrRiDetn101RdrDetnElevn "Refer to the data element description in FrntSideRdrLeDetn1 with the same data element name.";
CM_ SG_ 337 FrntSideRdrRiDetn101RdrDetnPwr "Refer to the data element description in FrntSideRdrLeDetn1 with the same data element name.";
CM_ SG_ 337 FrntSideRdrRiDetn101RdrDetnRng "Refer to the data element description in FrntSideRdrLeDetn1 with the same data element name.";
CM_ SG_ 337 FrntSideRdrRiDetn101RdrDetnRngV "Range Velocity";
CM_ SG_ 337 FrntSideRdrRiDetn101RdrDetnSts "Refer to the data element description in FrntSideRdrLeDetn1 with the same data element name.";
CM_ SG_ 337 FrntSideRdrRiDetn102RdrDetnAzi "Refer to the data element description in FrntSideRdrLeDetn1 with the same data element name.";
CM_ SG_ 337 FrntSideRdrRiDetn102RdrDetnChks "Refer to the data element description in FrntSideRdrLeDetn1 with the same data element name.";
CM_ SG_ 337 FrntSideRdrRiDetn102RdrDetnCntr "Refer to the data element description in FrntSideRdrLeDetn1 with the same data element name.";
CM_ SG_ 337 FrntSideRdrRiDetn102RdrDetnConf "Refer to the data element description in FrntSideRdrLeDetn1 with the same data element name.";
CM_ SG_ 337 FrntSideRdrRiDetn102RdrDetnElevn "Refer to the data element description in FrntSideRdrLeDetn1 with the same data element name.";
CM_ SG_ 337 FrntSideRdrRiDetn102RdrDetnPwr "Refer to the data element description in FrntSideRdrLeDetn1 with the same data element name.";
CM_ SG_ 337 FrntSideRdrRiDetn102RdrDetnRng "Refer to the data element description in FrntSideRdrLeDetn1 with the same data element name.";
CM_ SG_ 337 FrntSideRdrRiDetn102RdrDetnRngV "Range Velocity";
CM_ SG_ 337 FrntSideRdrRiDetn102RdrDetnSts "Refer to the data element description in FrntSideRdrLeDetn1 with the same data element name.";
CM_ SG_ 337 FrntSideRdrRiDetn97RdrDetnAzi "Refer to the data element description in FrntSideRdrLeDetn1 with the same data element name.";
CM_ SG_ 337 FrntSideRdrRiDetn97RdrDetnChks "Refer to the data element description in FrntSideRdrLeDetn1 with the same data element name.";
CM_ SG_ 337 FrntSideRdrRiDetn97RdrDetnCntr "Refer to the data element description in FrntSideRdrLeDetn1 with the same data element name.";
CM_ SG_ 337 FrntSideRdrRiDetn97RdrDetnConf "Refer to the data element description in FrntSideRdrLeDetn1 with the same data element name.";
CM_ SG_ 337 FrntSideRdrRiDetn97RdrDetnElevn "Refer to the data element description in FrntSideRdrLeDetn1 with the same data element name.";
CM_ SG_ 337 FrntSideRdrRiDetn97RdrDetnPwr "Refer to the data element description in FrntSideRdrLeDetn1 with the same data element name.";
CM_ SG_ 337 FrntSideRdrRiDetn97RdrDetnRng "Refer to the data element description in FrntSideRdrLeDetn1 with the same data element name.";
CM_ SG_ 337 FrntSideRdrRiDetn97RdrDetnRngV "Range Velocity";
CM_ SG_ 337 FrntSideRdrRiDetn97RdrDetnSts "Refer to the data element description in FrntSideRdrLeDetn1 with the same data element name.";
CM_ SG_ 337 FrntSideRdrRiDetn98RdrDetnAzi "Refer to the data element description in FrntSideRdrLeDetn1 with the same data element name.";
CM_ SG_ 337 FrntSideRdrRiDetn98RdrDetnChks "Refer to the data element description in FrntSideRdrLeDetn1 with the same data element name.";
CM_ SG_ 337 FrntSideRdrRiDetn98RdrDetnCntr "Refer to the data element description in FrntSideRdrLeDetn1 with the same data element name.";
CM_ SG_ 337 FrntSideRdrRiDetn98RdrDetnConf "Refer to the data element description in FrntSideRdrLeDetn1 with the same data element name.";
CM_ SG_ 337 FrntSideRdrRiDetn98RdrDetnElevn "Refer to the data element description in FrntSideRdrLeDetn1 with the same data element name.";
CM_ SG_ 337 FrntSideRdrRiDetn98RdrDetnPwr "Refer to the data element description in FrntSideRdrLeDetn1 with the same data element name.";
CM_ SG_ 337 FrntSideRdrRiDetn98RdrDetnRng "Refer to the data element description in FrntSideRdrLeDetn1 with the same data element name.";
CM_ SG_ 337 FrntSideRdrRiDetn98RdrDetnRngV "Range Velocity";
CM_ SG_ 337 FrntSideRdrRiDetn98RdrDetnSts "Refer to the data element description in FrntSideRdrLeDetn1 with the same data element name.";
CM_ SG_ 337 FrntSideRdrRiDetn99RdrDetnAzi "Refer to the data element description in FrntSideRdrLeDetn1 with the same data element name.";
CM_ SG_ 337 FrntSideRdrRiDetn99RdrDetnChks "Refer to the data element description in FrntSideRdrLeDetn1 with the same data element name.";
CM_ SG_ 337 FrntSideRdrRiDetn99RdrDetnCntr "Refer to the data element description in FrntSideRdrLeDetn1 with the same data element name.";
CM_ SG_ 337 FrntSideRdrRiDetn99RdrDetnConf "Refer to the data element description in FrntSideRdrLeDetn1 with the same data element name.";
CM_ SG_ 337 FrntSideRdrRiDetn99RdrDetnElevn "Refer to the data element description in FrntSideRdrLeDetn1 with the same data element name.";
CM_ SG_ 337 FrntSideRdrRiDetn99RdrDetnPwr "Refer to the data element description in FrntSideRdrLeDetn1 with the same data element name.";
CM_ SG_ 337 FrntSideRdrRiDetn99RdrDetnRng "Refer to the data element description in FrntSideRdrLeDetn1 with the same data element name.";
CM_ SG_ 337 FrntSideRdrRiDetn99RdrDetnRngV "Range Velocity";
CM_ SG_ 337 FrntSideRdrRiDetn99RdrDetnSts "Refer to the data element description in FrntSideRdrLeDetn1 with the same data element name.";
CM_ SG_ 339 FrntSideRdrRiDetn103RdrDetnAzi "Refer to the data element description in FrntSideRdrLeDetn1 with the same data element name.";
CM_ SG_ 339 FrntSideRdrRiDetn103RdrDetnChks "Refer to the data element description in FrntSideRdrLeDetn1 with the same data element name.";
CM_ SG_ 339 FrntSideRdrRiDetn103RdrDetnCntr "Refer to the data element description in FrntSideRdrLeDetn1 with the same data element name.";
CM_ SG_ 339 FrntSideRdrRiDetn103RdrDetnConf "Refer to the data element description in FrntSideRdrLeDetn1 with the same data element name.";
CM_ SG_ 339 FrntSideRdrRiDetn103RdrDetnElevn "Refer to the data element description in FrntSideRdrLeDetn1 with the same data element name.";
CM_ SG_ 339 FrntSideRdrRiDetn103RdrDetnPwr "Refer to the data element description in FrntSideRdrLeDetn1 with the same data element name.";
CM_ SG_ 339 FrntSideRdrRiDetn103RdrDetnRng "Refer to the data element description in FrntSideRdrLeDetn1 with the same data element name.";
CM_ SG_ 339 FrntSideRdrRiDetn103RdrDetnRngV "Range Velocity";
CM_ SG_ 339 FrntSideRdrRiDetn103RdrDetnSts "Refer to the data element description in FrntSideRdrLeDetn1 with the same data element name.";
CM_ SG_ 339 FrntSideRdrRiDetn104RdrDetnAzi "Refer to the data element description in FrntSideRdrLeDetn1 with the same data element name.";
CM_ SG_ 339 FrntSideRdrRiDetn104RdrDetnChks "Refer to the data element description in FrntSideRdrLeDetn1 with the same data element name.";
CM_ SG_ 339 FrntSideRdrRiDetn104RdrDetnCntr "Refer to the data element description in FrntSideRdrLeDetn1 with the same data element name.";
CM_ SG_ 339 FrntSideRdrRiDetn104RdrDetnConf "Refer to the data element description in FrntSideRdrLeDetn1 with the same data element name.";
CM_ SG_ 339 FrntSideRdrRiDetn104RdrDetnElevn "Refer to the data element description in FrntSideRdrLeDetn1 with the same data element name.";
CM_ SG_ 339 FrntSideRdrRiDetn104RdrDetnPwr "Refer to the data element description in FrntSideRdrLeDetn1 with the same data element name.";
CM_ SG_ 339 FrntSideRdrRiDetn104RdrDetnRng "Refer to the data element description in FrntSideRdrLeDetn1 with the same data element name.";
CM_ SG_ 339 FrntSideRdrRiDetn104RdrDetnRngV "Range Velocity";
CM_ SG_ 339 FrntSideRdrRiDetn104RdrDetnSts "Refer to the data element description in FrntSideRdrLeDetn1 with the same data element name.";
CM_ SG_ 339 FrntSideRdrRiDetn105RdrDetnAzi "Refer to the data element description in FrntSideRdrLeDetn1 with the same data element name.";
CM_ SG_ 339 FrntSideRdrRiDetn105RdrDetnChks "Refer to the data element description in FrntSideRdrLeDetn1 with the same data element name.";
CM_ SG_ 339 FrntSideRdrRiDetn105RdrDetnCntr "Refer to the data element description in FrntSideRdrLeDetn1 with the same data element name.";
CM_ SG_ 339 FrntSideRdrRiDetn105RdrDetnConf "Refer to the data element description in FrntSideRdrLeDetn1 with the same data element name.";
CM_ SG_ 339 FrntSideRdrRiDetn105RdrDetnElevn "Refer to the data element description in FrntSideRdrLeDetn1 with the same data element name.";
CM_ SG_ 339 FrntSideRdrRiDetn105RdrDetnPwr "Refer to the data element description in FrntSideRdrLeDetn1 with the same data element name.";
CM_ SG_ 339 FrntSideRdrRiDetn105RdrDetnRng "Refer to the data element description in FrntSideRdrLeDetn1 with the same data element name.";
CM_ SG_ 339 FrntSideRdrRiDetn105RdrDetnRngV "Range Velocity";
CM_ SG_ 339 FrntSideRdrRiDetn105RdrDetnSts "Refer to the data element description in FrntSideRdrLeDetn1 with the same data element name.";
CM_ SG_ 339 FrntSideRdrRiDetn106RdrDetnAzi "Refer to the data element description in FrntSideRdrLeDetn1 with the same data element name.";
CM_ SG_ 339 FrntSideRdrRiDetn106RdrDetnChks "Refer to the data element description in FrntSideRdrLeDetn1 with the same data element name.";
CM_ SG_ 339 FrntSideRdrRiDetn106RdrDetnCntr "Refer to the data element description in FrntSideRdrLeDetn1 with the same data element name.";
CM_ SG_ 339 FrntSideRdrRiDetn106RdrDetnConf "Refer to the data element description in FrntSideRdrLeDetn1 with the same data element name.";
CM_ SG_ 339 FrntSideRdrRiDetn106RdrDetnElevn "Refer to the data element description in FrntSideRdrLeDetn1 with the same data element name.";
CM_ SG_ 339 FrntSideRdrRiDetn106RdrDetnPwr "Refer to the data element description in FrntSideRdrLeDetn1 with the same data element name.";
CM_ SG_ 339 FrntSideRdrRiDetn106RdrDetnRng "Refer to the data element description in FrntSideRdrLeDetn1 with the same data element name.";
CM_ SG_ 339 FrntSideRdrRiDetn106RdrDetnRngV "Range Velocity";
CM_ SG_ 339 FrntSideRdrRiDetn106RdrDetnSts "Refer to the data element description in FrntSideRdrLeDetn1 with the same data element name.";
CM_ SG_ 339 FrntSideRdrRiDetn107RdrDetnAzi "Refer to the data element description in FrntSideRdrLeDetn1 with the same data element name.";
CM_ SG_ 339 FrntSideRdrRiDetn107RdrDetnChks "Refer to the data element description in FrntSideRdrLeDetn1 with the same data element name.";
CM_ SG_ 339 FrntSideRdrRiDetn107RdrDetnCntr "Refer to the data element description in FrntSideRdrLeDetn1 with the same data element name.";
CM_ SG_ 339 FrntSideRdrRiDetn107RdrDetnConf "Refer to the data element description in FrntSideRdrLeDetn1 with the same data element name.";
CM_ SG_ 339 FrntSideRdrRiDetn107RdrDetnElevn "Refer to the data element description in FrntSideRdrLeDetn1 with the same data element name.";
CM_ SG_ 339 FrntSideRdrRiDetn107RdrDetnPwr "Refer to the data element description in FrntSideRdrLeDetn1 with the same data element name.";
CM_ SG_ 339 FrntSideRdrRiDetn107RdrDetnRng "Refer to the data element description in FrntSideRdrLeDetn1 with the same data element name.";
CM_ SG_ 339 FrntSideRdrRiDetn107RdrDetnRngV "Range Velocity";
CM_ SG_ 339 FrntSideRdrRiDetn107RdrDetnSts "Refer to the data element description in FrntSideRdrLeDetn1 with the same data element name.";
CM_ SG_ 339 FrntSideRdrRiDetn108RdrDetnAzi "Refer to the data element description in FrntSideRdrLeDetn1 with the same data element name.";
CM_ SG_ 339 FrntSideRdrRiDetn108RdrDetnChks "Refer to the data element description in FrntSideRdrLeDetn1 with the same data element name.";
CM_ SG_ 339 FrntSideRdrRiDetn108RdrDetnCntr "Refer to the data element description in FrntSideRdrLeDetn1 with the same data element name.";
CM_ SG_ 339 FrntSideRdrRiDetn108RdrDetnConf "Refer to the data element description in FrntSideRdrLeDetn1 with the same data element name.";
CM_ SG_ 339 FrntSideRdrRiDetn108RdrDetnElevn "Refer to the data element description in FrntSideRdrLeDetn1 with the same data element name.";
CM_ SG_ 339 FrntSideRdrRiDetn108RdrDetnPwr "Refer to the data element description in FrntSideRdrLeDetn1 with the same data element name.";
CM_ SG_ 339 FrntSideRdrRiDetn108RdrDetnRng "Refer to the data element description in FrntSideRdrLeDetn1 with the same data element name.";
CM_ SG_ 339 FrntSideRdrRiDetn108RdrDetnRngV "Range Velocity";
CM_ SG_ 339 FrntSideRdrRiDetn108RdrDetnSts "Refer to the data element description in FrntSideRdrLeDetn1 with the same data element name.";
CM_ SG_ 341 FrntSideRdrRiDetn109RdrDetnAzi "Refer to the data element description in FrntSideRdrLeDetn1 with the same data element name.";
CM_ SG_ 341 FrntSideRdrRiDetn109RdrDetnChks "Refer to the data element description in FrntSideRdrLeDetn1 with the same data element name.";
CM_ SG_ 341 FrntSideRdrRiDetn109RdrDetnCntr "Refer to the data element description in FrntSideRdrLeDetn1 with the same data element name.";
CM_ SG_ 341 FrntSideRdrRiDetn109RdrDetnConf "Refer to the data element description in FrntSideRdrLeDetn1 with the same data element name.";
CM_ SG_ 341 FrntSideRdrRiDetn109RdrDetnElevn "Refer to the data element description in FrntSideRdrLeDetn1 with the same data element name.";
CM_ SG_ 341 FrntSideRdrRiDetn109RdrDetnPwr "Refer to the data element description in FrntSideRdrLeDetn1 with the same data element name.";
CM_ SG_ 341 FrntSideRdrRiDetn109RdrDetnRng "Refer to the data element description in FrntSideRdrLeDetn1 with the same data element name.";
CM_ SG_ 341 FrntSideRdrRiDetn109RdrDetnRngV "Range Velocity";
CM_ SG_ 341 FrntSideRdrRiDetn109RdrDetnSts "Refer to the data element description in FrntSideRdrLeDetn1 with the same data element name.";
CM_ SG_ 341 FrntSideRdrRiDetn110RdrDetnAzi "Refer to the data element description in FrntSideRdrLeDetn1 with the same data element name.";
CM_ SG_ 341 FrntSideRdrRiDetn110RdrDetnChks "Refer to the data element description in FrntSideRdrLeDetn1 with the same data element name.";
CM_ SG_ 341 FrntSideRdrRiDetn110RdrDetnCntr "Refer to the data element description in FrntSideRdrLeDetn1 with the same data element name.";
CM_ SG_ 341 FrntSideRdrRiDetn110RdrDetnConf "Refer to the data element description in FrntSideRdrLeDetn1 with the same data element name.";
CM_ SG_ 341 FrntSideRdrRiDetn110RdrDetnElevn "Refer to the data element description in FrntSideRdrLeDetn1 with the same data element name.";
CM_ SG_ 341 FrntSideRdrRiDetn110RdrDetnPwr "Refer to the data element description in FrntSideRdrLeDetn1 with the same data element name.";
CM_ SG_ 341 FrntSideRdrRiDetn110RdrDetnRng "Refer to the data element description in FrntSideRdrLeDetn1 with the same data element name.";
CM_ SG_ 341 FrntSideRdrRiDetn110RdrDetnRngV "Range Velocity";
CM_ SG_ 341 FrntSideRdrRiDetn110RdrDetnSts "Refer to the data element description in FrntSideRdrLeDetn1 with the same data element name.";
CM_ SG_ 341 FrntSideRdrRiDetn111RdrDetnAzi "Refer to the data element description in FrntSideRdrLeDetn1 with the same data element name.";
CM_ SG_ 341 FrntSideRdrRiDetn111RdrDetnChks "Refer to the data element description in FrntSideRdrLeDetn1 with the same data element name.";
CM_ SG_ 341 FrntSideRdrRiDetn111RdrDetnCntr "Refer to the data element description in FrntSideRdrLeDetn1 with the same data element name.";
CM_ SG_ 341 FrntSideRdrRiDetn111RdrDetnConf "Refer to the data element description in FrntSideRdrLeDetn1 with the same data element name.";
CM_ SG_ 341 FrntSideRdrRiDetn111RdrDetnElevn "Refer to the data element description in FrntSideRdrLeDetn1 with the same data element name.";
CM_ SG_ 341 FrntSideRdrRiDetn111RdrDetnPwr "Refer to the data element description in FrntSideRdrLeDetn1 with the same data element name.";
CM_ SG_ 341 FrntSideRdrRiDetn111RdrDetnRng "Refer to the data element description in FrntSideRdrLeDetn1 with the same data element name.";
CM_ SG_ 341 FrntSideRdrRiDetn111RdrDetnRngV "Range Velocity";
CM_ SG_ 341 FrntSideRdrRiDetn111RdrDetnSts "Refer to the data element description in FrntSideRdrLeDetn1 with the same data element name.";
CM_ SG_ 341 FrntSideRdrRiDetn112RdrDetnAzi "Refer to the data element description in FrntSideRdrLeDetn1 with the same data element name.";
CM_ SG_ 341 FrntSideRdrRiDetn112RdrDetnChks "Refer to the data element description in FrntSideRdrLeDetn1 with the same data element name.";
CM_ SG_ 341 FrntSideRdrRiDetn112RdrDetnCntr "Refer to the data element description in FrntSideRdrLeDetn1 with the same data element name.";
CM_ SG_ 341 FrntSideRdrRiDetn112RdrDetnConf "Refer to the data element description in FrntSideRdrLeDetn1 with the same data element name.";
CM_ SG_ 341 FrntSideRdrRiDetn112RdrDetnElevn "Refer to the data element description in FrntSideRdrLeDetn1 with the same data element name.";
CM_ SG_ 341 FrntSideRdrRiDetn112RdrDetnPwr "Refer to the data element description in FrntSideRdrLeDetn1 with the same data element name.";
CM_ SG_ 341 FrntSideRdrRiDetn112RdrDetnRng "Refer to the data element description in FrntSideRdrLeDetn1 with the same data element name.";
CM_ SG_ 341 FrntSideRdrRiDetn112RdrDetnRngV "Range Velocity";
CM_ SG_ 341 FrntSideRdrRiDetn112RdrDetnSts "Refer to the data element description in FrntSideRdrLeDetn1 with the same data element name.";
CM_ SG_ 341 FrntSideRdrRiDetn113RdrDetnAzi "Refer to the data element description in FrntSideRdrLeDetn1 with the same data element name.";
CM_ SG_ 341 FrntSideRdrRiDetn113RdrDetnChks "Refer to the data element description in FrntSideRdrLeDetn1 with the same data element name.";
CM_ SG_ 341 FrntSideRdrRiDetn113RdrDetnCntr "Refer to the data element description in FrntSideRdrLeDetn1 with the same data element name.";
CM_ SG_ 341 FrntSideRdrRiDetn113RdrDetnConf "Refer to the data element description in FrntSideRdrLeDetn1 with the same data element name.";
CM_ SG_ 341 FrntSideRdrRiDetn113RdrDetnElevn "Refer to the data element description in FrntSideRdrLeDetn1 with the same data element name.";
CM_ SG_ 341 FrntSideRdrRiDetn113RdrDetnPwr "Refer to the data element description in FrntSideRdrLeDetn1 with the same data element name.";
CM_ SG_ 341 FrntSideRdrRiDetn113RdrDetnRng "Refer to the data element description in FrntSideRdrLeDetn1 with the same data element name.";
CM_ SG_ 341 FrntSideRdrRiDetn113RdrDetnRngV "Range Velocity";
CM_ SG_ 341 FrntSideRdrRiDetn113RdrDetnSts "Refer to the data element description in FrntSideRdrLeDetn1 with the same data element name.";
CM_ SG_ 341 FrntSideRdrRiDetn114RdrDetnAzi "Refer to the data element description in FrntSideRdrLeDetn1 with the same data element name.";
CM_ SG_ 341 FrntSideRdrRiDetn114RdrDetnChks "Refer to the data element description in FrntSideRdrLeDetn1 with the same data element name.";
CM_ SG_ 341 FrntSideRdrRiDetn114RdrDetnCntr "Refer to the data element description in FrntSideRdrLeDetn1 with the same data element name.";
CM_ SG_ 341 FrntSideRdrRiDetn114RdrDetnConf "Refer to the data element description in FrntSideRdrLeDetn1 with the same data element name.";
CM_ SG_ 341 FrntSideRdrRiDetn114RdrDetnElevn "Refer to the data element description in FrntSideRdrLeDetn1 with the same data element name.";
CM_ SG_ 341 FrntSideRdrRiDetn114RdrDetnPwr "Refer to the data element description in FrntSideRdrLeDetn1 with the same data element name.";
CM_ SG_ 341 FrntSideRdrRiDetn114RdrDetnRng "Refer to the data element description in FrntSideRdrLeDetn1 with the same data element name.";
CM_ SG_ 341 FrntSideRdrRiDetn114RdrDetnRngV "Range Velocity";
CM_ SG_ 341 FrntSideRdrRiDetn114RdrDetnSts "Refer to the data element description in FrntSideRdrLeDetn1 with the same data element name.";
CM_ SG_ 343 FrntSideRdrRiDetn115RdrDetnAzi "Refer to the data element description in FrntSideRdrLeDetn1 with the same data element name.";
CM_ SG_ 343 FrntSideRdrRiDetn115RdrDetnChks "Refer to the data element description in FrntSideRdrLeDetn1 with the same data element name.";
CM_ SG_ 343 FrntSideRdrRiDetn115RdrDetnCntr "Refer to the data element description in FrntSideRdrLeDetn1 with the same data element name.";
CM_ SG_ 343 FrntSideRdrRiDetn115RdrDetnConf "Refer to the data element description in FrntSideRdrLeDetn1 with the same data element name.";
CM_ SG_ 343 FrntSideRdrRiDetn115RdrDetnElevn "Refer to the data element description in FrntSideRdrLeDetn1 with the same data element name.";
CM_ SG_ 343 FrntSideRdrRiDetn115RdrDetnPwr "Refer to the data element description in FrntSideRdrLeDetn1 with the same data element name.";
CM_ SG_ 343 FrntSideRdrRiDetn115RdrDetnRng "Refer to the data element description in FrntSideRdrLeDetn1 with the same data element name.";
CM_ SG_ 343 FrntSideRdrRiDetn115RdrDetnRngV "Range Velocity";
CM_ SG_ 343 FrntSideRdrRiDetn115RdrDetnSts "Refer to the data element description in FrntSideRdrLeDetn1 with the same data element name.";
CM_ SG_ 343 FrntSideRdrRiDetn116RdrDetnAzi "Refer to the data element description in FrntSideRdrLeDetn1 with the same data element name.";
CM_ SG_ 343 FrntSideRdrRiDetn116RdrDetnChks "Refer to the data element description in FrntSideRdrLeDetn1 with the same data element name.";
CM_ SG_ 343 FrntSideRdrRiDetn116RdrDetnCntr "Refer to the data element description in FrntSideRdrLeDetn1 with the same data element name.";
CM_ SG_ 343 FrntSideRdrRiDetn116RdrDetnConf "Refer to the data element description in FrntSideRdrLeDetn1 with the same data element name.";
CM_ SG_ 343 FrntSideRdrRiDetn116RdrDetnElevn "Refer to the data element description in FrntSideRdrLeDetn1 with the same data element name.";
CM_ SG_ 343 FrntSideRdrRiDetn116RdrDetnPwr "Refer to the data element description in FrntSideRdrLeDetn1 with the same data element name.";
CM_ SG_ 343 FrntSideRdrRiDetn116RdrDetnRng "Refer to the data element description in FrntSideRdrLeDetn1 with the same data element name.";
CM_ SG_ 343 FrntSideRdrRiDetn116RdrDetnRngV "Range Velocity";
CM_ SG_ 343 FrntSideRdrRiDetn116RdrDetnSts "Refer to the data element description in FrntSideRdrLeDetn1 with the same data element name.";
CM_ SG_ 343 FrntSideRdrRiDetn117RdrDetnAzi "Refer to the data element description in FrntSideRdrLeDetn1 with the same data element name.";
CM_ SG_ 343 FrntSideRdrRiDetn117RdrDetnChks "Refer to the data element description in FrntSideRdrLeDetn1 with the same data element name.";
CM_ SG_ 343 FrntSideRdrRiDetn117RdrDetnCntr "Refer to the data element description in FrntSideRdrLeDetn1 with the same data element name.";
CM_ SG_ 343 FrntSideRdrRiDetn117RdrDetnConf "Refer to the data element description in FrntSideRdrLeDetn1 with the same data element name.";
CM_ SG_ 343 FrntSideRdrRiDetn117RdrDetnElevn "Refer to the data element description in FrntSideRdrLeDetn1 with the same data element name.";
CM_ SG_ 343 FrntSideRdrRiDetn117RdrDetnPwr "Refer to the data element description in FrntSideRdrLeDetn1 with the same data element name.";
CM_ SG_ 343 FrntSideRdrRiDetn117RdrDetnRng "Refer to the data element description in FrntSideRdrLeDetn1 with the same data element name.";
CM_ SG_ 343 FrntSideRdrRiDetn117RdrDetnRngV "Range Velocity";
CM_ SG_ 343 FrntSideRdrRiDetn117RdrDetnSts "Refer to the data element description in FrntSideRdrLeDetn1 with the same data element name.";
CM_ SG_ 343 FrntSideRdrRiDetn118RdrDetnAzi "Refer to the data element description in FrntSideRdrLeDetn1 with the same data element name.";
CM_ SG_ 343 FrntSideRdrRiDetn118RdrDetnChks "Refer to the data element description in FrntSideRdrLeDetn1 with the same data element name.";
CM_ SG_ 343 FrntSideRdrRiDetn118RdrDetnCntr "Refer to the data element description in FrntSideRdrLeDetn1 with the same data element name.";
CM_ SG_ 343 FrntSideRdrRiDetn118RdrDetnConf "Refer to the data element description in FrntSideRdrLeDetn1 with the same data element name.";
CM_ SG_ 343 FrntSideRdrRiDetn118RdrDetnElevn "Refer to the data element description in FrntSideRdrLeDetn1 with the same data element name.";
CM_ SG_ 343 FrntSideRdrRiDetn118RdrDetnPwr "Refer to the data element description in FrntSideRdrLeDetn1 with the same data element name.";
CM_ SG_ 343 FrntSideRdrRiDetn118RdrDetnRng "Refer to the data element description in FrntSideRdrLeDetn1 with the same data element name.";
CM_ SG_ 343 FrntSideRdrRiDetn118RdrDetnRngV "Range Velocity";
CM_ SG_ 343 FrntSideRdrRiDetn118RdrDetnSts "Refer to the data element description in FrntSideRdrLeDetn1 with the same data element name.";
CM_ SG_ 343 FrntSideRdrRiDetn119RdrDetnAzi "Refer to the data element description in FrntSideRdrLeDetn1 with the same data element name.";
CM_ SG_ 343 FrntSideRdrRiDetn119RdrDetnChks "Refer to the data element description in FrntSideRdrLeDetn1 with the same data element name.";
CM_ SG_ 343 FrntSideRdrRiDetn119RdrDetnCntr "Refer to the data element description in FrntSideRdrLeDetn1 with the same data element name.";
CM_ SG_ 343 FrntSideRdrRiDetn119RdrDetnConf "Refer to the data element description in FrntSideRdrLeDetn1 with the same data element name.";
CM_ SG_ 343 FrntSideRdrRiDetn119RdrDetnElevn "Refer to the data element description in FrntSideRdrLeDetn1 with the same data element name.";
CM_ SG_ 343 FrntSideRdrRiDetn119RdrDetnPwr "Refer to the data element description in FrntSideRdrLeDetn1 with the same data element name.";
CM_ SG_ 343 FrntSideRdrRiDetn119RdrDetnRng "Refer to the data element description in FrntSideRdrLeDetn1 with the same data element name.";
CM_ SG_ 343 FrntSideRdrRiDetn119RdrDetnRngV "Range Velocity";
CM_ SG_ 343 FrntSideRdrRiDetn119RdrDetnSts "Refer to the data element description in FrntSideRdrLeDetn1 with the same data element name.";
CM_ SG_ 343 FrntSideRdrRiDetn120RdrDetnAzi "Refer to the data element description in FrntSideRdrLeDetn1 with the same data element name.";
CM_ SG_ 343 FrntSideRdrRiDetn120RdrDetnChks "Refer to the data element description in FrntSideRdrLeDetn1 with the same data element name.";
CM_ SG_ 343 FrntSideRdrRiDetn120RdrDetnCntr "Refer to the data element description in FrntSideRdrLeDetn1 with the same data element name.";
CM_ SG_ 343 FrntSideRdrRiDetn120RdrDetnConf "Refer to the data element description in FrntSideRdrLeDetn1 with the same data element name.";
CM_ SG_ 343 FrntSideRdrRiDetn120RdrDetnElevn "Refer to the data element description in FrntSideRdrLeDetn1 with the same data element name.";
CM_ SG_ 343 FrntSideRdrRiDetn120RdrDetnPwr "Refer to the data element description in FrntSideRdrLeDetn1 with the same data element name.";
CM_ SG_ 343 FrntSideRdrRiDetn120RdrDetnRng "Refer to the data element description in FrntSideRdrLeDetn1 with the same data element name.";
CM_ SG_ 343 FrntSideRdrRiDetn120RdrDetnRngV "Range Velocity";
CM_ SG_ 343 FrntSideRdrRiDetn120RdrDetnSts "Refer to the data element description in FrntSideRdrLeDetn1 with the same data element name.";
CM_ SG_ 345 FrntSideRdrRiDetn121RdrDetnAzi "Refer to the data element description in FrntSideRdrLeDetn1 with the same data element name.";
CM_ SG_ 345 FrntSideRdrRiDetn121RdrDetnChks "Refer to the data element description in FrntSideRdrLeDetn1 with the same data element name.";
CM_ SG_ 345 FrntSideRdrRiDetn121RdrDetnCntr "Refer to the data element description in FrntSideRdrLeDetn1 with the same data element name.";
CM_ SG_ 345 FrntSideRdrRiDetn121RdrDetnConf "Refer to the data element description in FrntSideRdrLeDetn1 with the same data element name.";
CM_ SG_ 345 FrntSideRdrRiDetn121RdrDetnElevn "Refer to the data element description in FrntSideRdrLeDetn1 with the same data element name.";
CM_ SG_ 345 FrntSideRdrRiDetn121RdrDetnPwr "Refer to the data element description in FrntSideRdrLeDetn1 with the same data element name.";
CM_ SG_ 345 FrntSideRdrRiDetn121RdrDetnRng "Refer to the data element description in FrntSideRdrLeDetn1 with the same data element name.";
CM_ SG_ 345 FrntSideRdrRiDetn121RdrDetnRngV "Range Velocity";
CM_ SG_ 345 FrntSideRdrRiDetn121RdrDetnSts "Refer to the data element description in FrntSideRdrLeDetn1 with the same data element name.";
CM_ SG_ 345 FrntSideRdrRiDetn122RdrDetnAzi "Refer to the data element description in FrntSideRdrLeDetn1 with the same data element name.";
CM_ SG_ 345 FrntSideRdrRiDetn122RdrDetnChks "Refer to the data element description in FrntSideRdrLeDetn1 with the same data element name.";
CM_ SG_ 345 FrntSideRdrRiDetn122RdrDetnCntr "Refer to the data element description in FrntSideRdrLeDetn1 with the same data element name.";
CM_ SG_ 345 FrntSideRdrRiDetn122RdrDetnConf "Refer to the data element description in FrntSideRdrLeDetn1 with the same data element name.";
CM_ SG_ 345 FrntSideRdrRiDetn122RdrDetnElevn "Refer to the data element description in FrntSideRdrLeDetn1 with the same data element name.";
CM_ SG_ 345 FrntSideRdrRiDetn122RdrDetnPwr "Refer to the data element description in FrntSideRdrLeDetn1 with the same data element name.";
CM_ SG_ 345 FrntSideRdrRiDetn122RdrDetnRng "Refer to the data element description in FrntSideRdrLeDetn1 with the same data element name.";
CM_ SG_ 345 FrntSideRdrRiDetn122RdrDetnRngV "Range Velocity";
CM_ SG_ 345 FrntSideRdrRiDetn122RdrDetnSts "Refer to the data element description in FrntSideRdrLeDetn1 with the same data element name.";
CM_ SG_ 345 FrntSideRdrRiDetn123RdrDetnAzi "Refer to the data element description in FrntSideRdrLeDetn1 with the same data element name.";
CM_ SG_ 345 FrntSideRdrRiDetn123RdrDetnChks "Refer to the data element description in FrntSideRdrLeDetn1 with the same data element name.";
CM_ SG_ 345 FrntSideRdrRiDetn123RdrDetnCntr "Refer to the data element description in FrntSideRdrLeDetn1 with the same data element name.";
CM_ SG_ 345 FrntSideRdrRiDetn123RdrDetnConf "Refer to the data element description in FrntSideRdrLeDetn1 with the same data element name.";
CM_ SG_ 345 FrntSideRdrRiDetn123RdrDetnElevn "Refer to the data element description in FrntSideRdrLeDetn1 with the same data element name.";
CM_ SG_ 345 FrntSideRdrRiDetn123RdrDetnPwr "Refer to the data element description in FrntSideRdrLeDetn1 with the same data element name.";
CM_ SG_ 345 FrntSideRdrRiDetn123RdrDetnRng "Refer to the data element description in FrntSideRdrLeDetn1 with the same data element name.";
CM_ SG_ 345 FrntSideRdrRiDetn123RdrDetnRngV "Range Velocity";
CM_ SG_ 345 FrntSideRdrRiDetn123RdrDetnSts "Refer to the data element description in FrntSideRdrLeDetn1 with the same data element name.";
CM_ SG_ 345 FrntSideRdrRiDetn124RdrDetnAzi "Refer to the data element description in FrntSideRdrLeDetn1 with the same data element name.";
CM_ SG_ 345 FrntSideRdrRiDetn124RdrDetnChks "Refer to the data element description in FrntSideRdrLeDetn1 with the same data element name.";
CM_ SG_ 345 FrntSideRdrRiDetn124RdrDetnCntr "Refer to the data element description in FrntSideRdrLeDetn1 with the same data element name.";
CM_ SG_ 345 FrntSideRdrRiDetn124RdrDetnConf "Refer to the data element description in FrntSideRdrLeDetn1 with the same data element name.";
CM_ SG_ 345 FrntSideRdrRiDetn124RdrDetnElevn "Refer to the data element description in FrntSideRdrLeDetn1 with the same data element name.";
CM_ SG_ 345 FrntSideRdrRiDetn124RdrDetnPwr "Refer to the data element description in FrntSideRdrLeDetn1 with the same data element name.";
CM_ SG_ 345 FrntSideRdrRiDetn124RdrDetnRng "Refer to the data element description in FrntSideRdrLeDetn1 with the same data element name.";
CM_ SG_ 345 FrntSideRdrRiDetn124RdrDetnRngV "Range Velocity";
CM_ SG_ 345 FrntSideRdrRiDetn124RdrDetnSts "Refer to the data element description in FrntSideRdrLeDetn1 with the same data element name.";
CM_ SG_ 345 FrntSideRdrRiDetn125RdrDetnAzi "Refer to the data element description in FrntSideRdrLeDetn1 with the same data element name.";
CM_ SG_ 345 FrntSideRdrRiDetn125RdrDetnChks "Refer to the data element description in FrntSideRdrLeDetn1 with the same data element name.";
CM_ SG_ 345 FrntSideRdrRiDetn125RdrDetnCntr "Refer to the data element description in FrntSideRdrLeDetn1 with the same data element name.";
CM_ SG_ 345 FrntSideRdrRiDetn125RdrDetnConf "Refer to the data element description in FrntSideRdrLeDetn1 with the same data element name.";
CM_ SG_ 345 FrntSideRdrRiDetn125RdrDetnElevn "Refer to the data element description in FrntSideRdrLeDetn1 with the same data element name.";
CM_ SG_ 345 FrntSideRdrRiDetn125RdrDetnPwr "Refer to the data element description in FrntSideRdrLeDetn1 with the same data element name.";
CM_ SG_ 345 FrntSideRdrRiDetn125RdrDetnRng "Refer to the data element description in FrntSideRdrLeDetn1 with the same data element name.";
CM_ SG_ 345 FrntSideRdrRiDetn125RdrDetnRngV "Range Velocity";
CM_ SG_ 345 FrntSideRdrRiDetn125RdrDetnSts "Refer to the data element description in FrntSideRdrLeDetn1 with the same data element name.";
CM_ SG_ 345 FrntSideRdrRiDetn126RdrDetnAzi "Refer to the data element description in FrntSideRdrLeDetn1 with the same data element name.";
CM_ SG_ 345 FrntSideRdrRiDetn126RdrDetnChks "Refer to the data element description in FrntSideRdrLeDetn1 with the same data element name.";
CM_ SG_ 345 FrntSideRdrRiDetn126RdrDetnCntr "Refer to the data element description in FrntSideRdrLeDetn1 with the same data element name.";
CM_ SG_ 345 FrntSideRdrRiDetn126RdrDetnConf "Refer to the data element description in FrntSideRdrLeDetn1 with the same data element name.";
CM_ SG_ 345 FrntSideRdrRiDetn126RdrDetnElevn "Refer to the data element description in FrntSideRdrLeDetn1 with the same data element name.";
CM_ SG_ 345 FrntSideRdrRiDetn126RdrDetnPwr "Refer to the data element description in FrntSideRdrLeDetn1 with the same data element name.";
CM_ SG_ 345 FrntSideRdrRiDetn126RdrDetnRng "Refer to the data element description in FrntSideRdrLeDetn1 with the same data element name.";
CM_ SG_ 345 FrntSideRdrRiDetn126RdrDetnRngV "Range Velocity";
CM_ SG_ 345 FrntSideRdrRiDetn126RdrDetnSts "Refer to the data element description in FrntSideRdrLeDetn1 with the same data element name.";
CM_ SG_ 347 FrntSideRdrRiDetn127RdrDetnAzi "Refer to the data element description in FrntSideRdrLeDetn1 with the same data element name.";
CM_ SG_ 347 FrntSideRdrRiDetn127RdrDetnChks "Refer to the data element description in FrntSideRdrLeDetn1 with the same data element name.";
CM_ SG_ 347 FrntSideRdrRiDetn127RdrDetnCntr "Refer to the data element description in FrntSideRdrLeDetn1 with the same data element name.";
CM_ SG_ 347 FrntSideRdrRiDetn127RdrDetnConf "Refer to the data element description in FrntSideRdrLeDetn1 with the same data element name.";
CM_ SG_ 347 FrntSideRdrRiDetn127RdrDetnElevn "Refer to the data element description in FrntSideRdrLeDetn1 with the same data element name.";
CM_ SG_ 347 FrntSideRdrRiDetn127RdrDetnPwr "Refer to the data element description in FrntSideRdrLeDetn1 with the same data element name.";
CM_ SG_ 347 FrntSideRdrRiDetn127RdrDetnRng "Refer to the data element description in FrntSideRdrLeDetn1 with the same data element name.";
CM_ SG_ 347 FrntSideRdrRiDetn127RdrDetnRngV "Range Velocity";
CM_ SG_ 347 FrntSideRdrRiDetn127RdrDetnSts "Refer to the data element description in FrntSideRdrLeDetn1 with the same data element name.";
CM_ SG_ 347 FrntSideRdrRiDetn128RdrDetnAzi "Refer to the data element description in FrntSideRdrLeDetn1 with the same data element name.";
CM_ SG_ 347 FrntSideRdrRiDetn128RdrDetnChks "Refer to the data element description in FrntSideRdrLeDetn1 with the same data element name.";
CM_ SG_ 347 FrntSideRdrRiDetn128RdrDetnCntr "Refer to the data element description in FrntSideRdrLeDetn1 with the same data element name.";
CM_ SG_ 347 FrntSideRdrRiDetn128RdrDetnConf "Refer to the data element description in FrntSideRdrLeDetn1 with the same data element name.";
CM_ SG_ 347 FrntSideRdrRiDetn128RdrDetnElevn "Refer to the data element description in FrntSideRdrLeDetn1 with the same data element name.";
CM_ SG_ 347 FrntSideRdrRiDetn128RdrDetnPwr "Refer to the data element description in FrntSideRdrLeDetn1 with the same data element name.";
CM_ SG_ 347 FrntSideRdrRiDetn128RdrDetnRng "Refer to the data element description in FrntSideRdrLeDetn1 with the same data element name.";
CM_ SG_ 347 FrntSideRdrRiDetn128RdrDetnRngV "Range Velocity";
CM_ SG_ 347 FrntSideRdrRiDetn128RdrDetnSts "Refer to the data element description in FrntSideRdrLeDetn1 with the same data element name.";
CM_ SG_ 349 FrntSideRdrRiObj1Heading "Heading angle
";
CM_ SG_ 349 FrntSideRdrRiObj1ObjBoxCenterLat "Box center y coordinate (relative closest point)";
CM_ SG_ 349 FrntSideRdrRiObj1ObjBoxCenterLgt "Box center x coordinate (relative closest point)";
CM_ SG_ 349 FrntSideRdrRiObj1ObservationHist "The result of target association in each cycle, if target is associated,the bit value should be 1, if not,the bit value should be 0.there are 32 bits
";
CM_ SG_ 349 FrntSideRdrRiObj1QualityBits "Reserved. If this signal is needed, it means: Signal to illustrate radar object detailed status.";
CM_ SG_ 349 FrntSideRdrRiObj1RdrObjAx "Longitudinal acceleration";
CM_ SG_ 349 FrntSideRdrRiObj1RdrObjAy "Lateral acceleration";
CM_ SG_ 349 FrntSideRdrRiObj1RdrObjBoxLength "Box length (box extent that is parallel to objects heading angle)";
CM_ SG_ 349 FrntSideRdrRiObj1RdrObjBoxWidth "Box width (box extent that is perpendicular to objects heading angle)";
CM_ SG_ 349 FrntSideRdrRiObj1RdrObjChks "CRC";
CM_ SG_ 349 FrntSideRdrRiObj1RdrObjCntr "Counter";
CM_ SG_ 349 FrntSideRdrRiObj1RdrObjCoastCnt "Number of cycles during which the object is not associated to anything";
CM_ SG_ 349 FrntSideRdrRiObj1RdrObjConf "Confidence";
CM_ SG_ 349 FrntSideRdrRiObj1RdrObjDx "Longitudinal position";
CM_ SG_ 349 FrntSideRdrRiObj1RdrObjDxStdDe " Standard deviation longitudinal position";
CM_ SG_ 349 FrntSideRdrRiObj1RdrObjDy "Lateral position";
CM_ SG_ 349 FrntSideRdrRiObj1RdrObjDyStdDe " Standard deviation lateral position";
CM_ SG_ 349 FrntSideRdrRiObj1RdrObjElevnConf "Elevation confidence";
CM_ SG_ 349 FrntSideRdrRiObj1RdrObjElevnSts "Elevation Status";
CM_ SG_ 349 FrntSideRdrRiObj1RdrObjID "Object ID";
CM_ SG_ 349 FrntSideRdrRiObj1RdrObjIsInFreeSpace "Indication if the object is inside freespace";
CM_ SG_ 349 FrntSideRdrRiObj1RdrObjMirrProblty "Indication if the object is inside freespace";
CM_ SG_ 349 FrntSideRdrRiObj1RdrObjMtnPat "Object Motion Pattern (crossing, receding and oncoming) is not used here, as reserved)";
CM_ SG_ 349 FrntSideRdrRiObj1RdrObjNotRealProblty "Probability of ghost track";
CM_ SG_ 349 FrntSideRdrRiObj1RdrObjStatyCnt "Stationary Count";
CM_ SG_ 349 FrntSideRdrRiObj1RdrObjTiAlv "Lifetime";
CM_ SG_ 349 FrntSideRdrRiObj1RdrObjTrackSts "Track Status 0. it is not a valid track 1. the track has been updated 2. the track is new 3. the track is coasted (means the result is a prediction and that there was no detected measurement in the current look interval";
CM_ SG_ 349 FrntSideRdrRiObj1RdrObjTyp "Classification object (Only 0 Unkown, 4 Pedestrain, 9 Bicycle and 10 Vehicle of unknown class are used actually in radar, the other types are not used but the datatype is designed so that it can be reused with camera";
CM_ SG_ 349 FrntSideRdrRiObj1RdrObjTypConfBike "Confidence of tracked object type classification bike";
CM_ SG_ 349 FrntSideRdrRiObj1RdrObjTypConfPed "Confidence of tracked object type classification pedestrian";
CM_ SG_ 349 FrntSideRdrRiObj1RdrObjTypConfVeh "Confidence of tracked object type classification vehicle";
CM_ SG_ 349 FrntSideRdrRiObj1RdrObjUsedTracker "Reserved. If this signal is needed, it means: Assist to identify motion pattern. Better solution for stationary object.";
CM_ SG_ 349 FrntSideRdrRiObj1RdrObjVx "Longitudinal velocity";
CM_ SG_ 349 FrntSideRdrRiObj1RdrObjVxStdDe " Standard deviation longitudinal velocity";
CM_ SG_ 349 FrntSideRdrRiObj1RdrObjVy "Lateral velocity";
CM_ SG_ 349 FrntSideRdrRiObj1RdrObjVyStdDe " Standard deviation lateral velocity";
CM_ SG_ 349 FrntSideRdrRiObj1RelVx "Relative velocity in X
";
CM_ SG_ 349 FrntSideRdrRiObj1RelVy "Relative velocity in Y
";
CM_ SG_ 351 FrntSideRdrRiObj2Heading "Refer to the data element description in ReSideRdrRiObj1 with the same data element name";
CM_ SG_ 351 FrntSideRdrRiObj2ObjBoxCenterLat "Box center y coordinate (relative closest point)";
CM_ SG_ 351 FrntSideRdrRiObj2ObjBoxCenterLgt "Box center x coordinate (relative closest point)";
CM_ SG_ 351 FrntSideRdrRiObj2ObservationHist "Refer to the data element description in ReSideRdrRiObj1 with the same data element name";
CM_ SG_ 351 FrntSideRdrRiObj2QualityBits "Refer to the data element description in FrntSideRdrLeObj1 with the same data element name.";
CM_ SG_ 351 FrntSideRdrRiObj2RdrObjAx "Refer to the data element description in FrntSideRdrLeObj1 with the same data element name.";
CM_ SG_ 351 FrntSideRdrRiObj2RdrObjAy "Refer to the data element description in FrntSideRdrLeObj1 with the same data element name.";
CM_ SG_ 351 FrntSideRdrRiObj2RdrObjBoxLength "Box length (box extent that is parallel to objects heading angle)";
CM_ SG_ 351 FrntSideRdrRiObj2RdrObjBoxWidth "Box width (box extent that is perpendicular to objects heading angle)";
CM_ SG_ 351 FrntSideRdrRiObj2RdrObjChks "Refer to the data element description in FrntSideRdrLeObj1 with the same data element name.";
CM_ SG_ 351 FrntSideRdrRiObj2RdrObjCntr "Refer to the data element description in FrntSideRdrLeObj1 with the same data element name.";
CM_ SG_ 351 FrntSideRdrRiObj2RdrObjCoastCnt "Refer to the data element description in FrntSideRdrLeObj1 with the same data element name.";
CM_ SG_ 351 FrntSideRdrRiObj2RdrObjConf "Refer to the data element description in FrntSideRdrLeObj1 with the same data element name.";
CM_ SG_ 351 FrntSideRdrRiObj2RdrObjDx "Refer to the data element description in FrntSideRdrLeObj1 with the same data element name.";
CM_ SG_ 351 FrntSideRdrRiObj2RdrObjDxStdDe "Refer to the data element description in FrntSideRdrLeObj1 with the same data element name.";
CM_ SG_ 351 FrntSideRdrRiObj2RdrObjDy "Refer to the data element description in FrntSideRdrLeObj1 with the same data element name.";
CM_ SG_ 351 FrntSideRdrRiObj2RdrObjDyStdDe "Refer to the data element description in FrntSideRdrLeObj1 with the same data element name.";
CM_ SG_ 351 FrntSideRdrRiObj2RdrObjElevnConf "Refer to the data element description in FrntSideRdrLeObj1 with the same data element name.";
CM_ SG_ 351 FrntSideRdrRiObj2RdrObjElevnSts "Refer to the data element description in FrntSideRdrLeObj1 with the same data element name.";
CM_ SG_ 351 FrntSideRdrRiObj2RdrObjID "Refer to the data element description in FrntSideRdrLeObj1 with the same data element name.";
CM_ SG_ 351 FrntSideRdrRiObj2RdrObjIsInFreeSpace "Refer to the data element description in FrntSideRdrLeObj1 with the same data element name.";
CM_ SG_ 351 FrntSideRdrRiObj2RdrObjMirrProblty "Refer to the data element description in FrntSideRdrLeObj1 with the same data element name.";
CM_ SG_ 351 FrntSideRdrRiObj2RdrObjMtnPat "Refer to the data element description in FrntSideRdrLeObj1 with the same data element name.";
CM_ SG_ 351 FrntSideRdrRiObj2RdrObjNotRealProblty "Refer to the data element description in FrntSideRdrLeObj1 with the same data element name.";
CM_ SG_ 351 FrntSideRdrRiObj2RdrObjStatyCnt "Refer to the data element description in FrntSideRdrLeObj1 with the same data element name.";
CM_ SG_ 351 FrntSideRdrRiObj2RdrObjTiAlv "Refer to the data element description in FrntSideRdrLeObj1 with the same data element name.";
CM_ SG_ 351 FrntSideRdrRiObj2RdrObjTrackSts "Refer to the data element description in FrntSideRdrLeObj1 with the same data element name.";
CM_ SG_ 351 FrntSideRdrRiObj2RdrObjTyp "Refer to the data element description in FrntSideRdrLeObj1 with the same data element name.";
CM_ SG_ 351 FrntSideRdrRiObj2RdrObjTypConfBike "Refer to the data element description in FrntSideRdrLeObj1 with the same data element name.";
CM_ SG_ 351 FrntSideRdrRiObj2RdrObjTypConfPed "Refer to the data element description in FrntSideRdrLeObj1 with the same data element name.";
CM_ SG_ 351 FrntSideRdrRiObj2RdrObjTypConfVeh "Refer to the data element description in FrntSideRdrLeObj1 with the same data element name.";
CM_ SG_ 351 FrntSideRdrRiObj2RdrObjUsedTracker "Refer to the data element description in FrntSideRdrLeObj1 with the same data element name.";
CM_ SG_ 351 FrntSideRdrRiObj2RdrObjVx "Refer to the data element description in FrntSideRdrLeObj1 with the same data element name.";
CM_ SG_ 351 FrntSideRdrRiObj2RdrObjVxStdDe "Refer to the data element description in FrntSideRdrLeObj1 with the same data element name.";
CM_ SG_ 351 FrntSideRdrRiObj2RdrObjVy "Refer to the data element description in FrntSideRdrLeObj1 with the same data element name.";
CM_ SG_ 351 FrntSideRdrRiObj2RdrObjVyStdDe "Refer to the data element description in FrntSideRdrLeObj1 with the same data element name.";
CM_ SG_ 351 FrntSideRdrRiObj2RelVx "Refer to the data element description in ReSideRdrRiObj1 with the same data element name";
CM_ SG_ 351 FrntSideRdrRiObj2RelVy "Refer to the data element description in ReSideRdrRiObj1 with the same data element name";
CM_ SG_ 353 FrntSideRdrRiObj3Heading "Refer to the data element description in ReSideRdrRiObj1 with the same data element name";
CM_ SG_ 353 FrntSideRdrRiObj3ObjBoxCenterLat "Box center y coordinate (relative closest point)";
CM_ SG_ 353 FrntSideRdrRiObj3ObjBoxCenterLgt "Box center x coordinate (relative closest point)";
CM_ SG_ 353 FrntSideRdrRiObj3ObservationHist "Refer to the data element description in ReSideRdrRiObj1 with the same data element name";
CM_ SG_ 353 FrntSideRdrRiObj3QualityBits "Refer to the data element description in FrntSideRdrLeObj1 with the same data element name.";
CM_ SG_ 353 FrntSideRdrRiObj3RdrObjAx "Refer to the data element description in FrntSideRdrLeObj1 with the same data element name.";
CM_ SG_ 353 FrntSideRdrRiObj3RdrObjAy "Refer to the data element description in FrntSideRdrLeObj1 with the same data element name.";
CM_ SG_ 353 FrntSideRdrRiObj3RdrObjBoxLength "Box length (box extent that is parallel to objects heading angle)";
CM_ SG_ 353 FrntSideRdrRiObj3RdrObjBoxWidth "Box width (box extent that is perpendicular to objects heading angle)";
CM_ SG_ 353 FrntSideRdrRiObj3RdrObjChks "Refer to the data element description in FrntSideRdrLeObj1 with the same data element name.";
CM_ SG_ 353 FrntSideRdrRiObj3RdrObjCntr "Refer to the data element description in FrntSideRdrLeObj1 with the same data element name.";
CM_ SG_ 353 FrntSideRdrRiObj3RdrObjCoastCnt "Refer to the data element description in FrntSideRdrLeObj1 with the same data element name.";
CM_ SG_ 353 FrntSideRdrRiObj3RdrObjConf "Refer to the data element description in FrntSideRdrLeObj1 with the same data element name.";
CM_ SG_ 353 FrntSideRdrRiObj3RdrObjDx "Refer to the data element description in FrntSideRdrLeObj1 with the same data element name.";
CM_ SG_ 353 FrntSideRdrRiObj3RdrObjDxStdDe "Refer to the data element description in FrntSideRdrLeObj1 with the same data element name.";
CM_ SG_ 353 FrntSideRdrRiObj3RdrObjDy "Refer to the data element description in FrntSideRdrLeObj1 with the same data element name.";
CM_ SG_ 353 FrntSideRdrRiObj3RdrObjDyStdDe "Refer to the data element description in FrntSideRdrLeObj1 with the same data element name.";
CM_ SG_ 353 FrntSideRdrRiObj3RdrObjElevnConf "Refer to the data element description in FrntSideRdrLeObj1 with the same data element name.";
CM_ SG_ 353 FrntSideRdrRiObj3RdrObjElevnSts "Refer to the data element description in FrntSideRdrLeObj1 with the same data element name.";
CM_ SG_ 353 FrntSideRdrRiObj3RdrObjID "Refer to the data element description in FrntSideRdrLeObj1 with the same data element name.";
CM_ SG_ 353 FrntSideRdrRiObj3RdrObjIsInFreeSpace "Refer to the data element description in FrntSideRdrLeObj1 with the same data element name.";
CM_ SG_ 353 FrntSideRdrRiObj3RdrObjMirrProblty "Refer to the data element description in FrntSideRdrLeObj1 with the same data element name.";
CM_ SG_ 353 FrntSideRdrRiObj3RdrObjMtnPat "Refer to the data element description in FrntSideRdrLeObj1 with the same data element name.";
CM_ SG_ 353 FrntSideRdrRiObj3RdrObjNotRealProblty "Refer to the data element description in FrntSideRdrLeObj1 with the same data element name.";
CM_ SG_ 353 FrntSideRdrRiObj3RdrObjStatyCnt "Refer to the data element description in FrntSideRdrLeObj1 with the same data element name.";
CM_ SG_ 353 FrntSideRdrRiObj3RdrObjTiAlv "Refer to the data element description in FrntSideRdrLeObj1 with the same data element name.";
CM_ SG_ 353 FrntSideRdrRiObj3RdrObjTrackSts "Refer to the data element description in FrntSideRdrLeObj1 with the same data element name.";
CM_ SG_ 353 FrntSideRdrRiObj3RdrObjTyp "Refer to the data element description in FrntSideRdrLeObj1 with the same data element name.";
CM_ SG_ 353 FrntSideRdrRiObj3RdrObjTypConfBike "Refer to the data element description in FrntSideRdrLeObj1 with the same data element name.";
CM_ SG_ 353 FrntSideRdrRiObj3RdrObjTypConfPed "Refer to the data element description in FrntSideRdrLeObj1 with the same data element name.";
CM_ SG_ 353 FrntSideRdrRiObj3RdrObjTypConfVeh "Refer to the data element description in FrntSideRdrLeObj1 with the same data element name.";
CM_ SG_ 353 FrntSideRdrRiObj3RdrObjUsedTracker "Refer to the data element description in FrntSideRdrLeObj1 with the same data element name.";
CM_ SG_ 353 FrntSideRdrRiObj3RdrObjVx "Refer to the data element description in FrntSideRdrLeObj1 with the same data element name.";
CM_ SG_ 353 FrntSideRdrRiObj3RdrObjVxStdDe "Refer to the data element description in FrntSideRdrLeObj1 with the same data element name.";
CM_ SG_ 353 FrntSideRdrRiObj3RdrObjVy "Refer to the data element description in FrntSideRdrLeObj1 with the same data element name.";
CM_ SG_ 353 FrntSideRdrRiObj3RdrObjVyStdDe "Refer to the data element description in FrntSideRdrLeObj1 with the same data element name.";
CM_ SG_ 353 FrntSideRdrRiObj3RelVx "Refer to the data element description in ReSideRdrRiObj1 with the same data element name";
CM_ SG_ 353 FrntSideRdrRiObj3RelVy "Refer to the data element description in ReSideRdrRiObj1 with the same data element name";
CM_ SG_ 355 FrntSideRdrRiObj4Heading "Refer to the data element description in ReSideRdrRiObj1 with the same data element name";
CM_ SG_ 355 FrntSideRdrRiObj4ObjBoxCenterLat "Box center y coordinate (relative closest point)";
CM_ SG_ 355 FrntSideRdrRiObj4ObjBoxCenterLgt "Box center x coordinate (relative closest point)";
CM_ SG_ 355 FrntSideRdrRiObj4ObservationHist "Refer to the data element description in ReSideRdrRiObj1 with the same data element name";
CM_ SG_ 355 FrntSideRdrRiObj4QualityBits "Refer to the data element description in FrntSideRdrLeObj1 with the same data element name.";
CM_ SG_ 355 FrntSideRdrRiObj4RdrObjAx "Refer to the data element description in FrntSideRdrLeObj1 with the same data element name.";
CM_ SG_ 355 FrntSideRdrRiObj4RdrObjAy "Refer to the data element description in FrntSideRdrLeObj1 with the same data element name.";
CM_ SG_ 355 FrntSideRdrRiObj4RdrObjBoxLength "Box length (box extent that is parallel to objects heading angle)";
CM_ SG_ 355 FrntSideRdrRiObj4RdrObjBoxWidth "Box width (box extent that is perpendicular to objects heading angle)";
CM_ SG_ 355 FrntSideRdrRiObj4RdrObjChks "Refer to the data element description in FrntSideRdrLeObj1 with the same data element name.";
CM_ SG_ 355 FrntSideRdrRiObj4RdrObjCntr "Refer to the data element description in FrntSideRdrLeObj1 with the same data element name.";
CM_ SG_ 355 FrntSideRdrRiObj4RdrObjCoastCnt "Refer to the data element description in FrntSideRdrLeObj1 with the same data element name.";
CM_ SG_ 355 FrntSideRdrRiObj4RdrObjConf "Refer to the data element description in FrntSideRdrLeObj1 with the same data element name.";
CM_ SG_ 355 FrntSideRdrRiObj4RdrObjDx "Refer to the data element description in FrntSideRdrLeObj1 with the same data element name.";
CM_ SG_ 355 FrntSideRdrRiObj4RdrObjDxStdDe "Refer to the data element description in FrntSideRdrLeObj1 with the same data element name.";
CM_ SG_ 355 FrntSideRdrRiObj4RdrObjDy "Refer to the data element description in FrntSideRdrLeObj1 with the same data element name.";
CM_ SG_ 355 FrntSideRdrRiObj4RdrObjDyStdDe "Refer to the data element description in FrntSideRdrLeObj1 with the same data element name.";
CM_ SG_ 355 FrntSideRdrRiObj4RdrObjElevnConf "Refer to the data element description in FrntSideRdrLeObj1 with the same data element name.";
CM_ SG_ 355 FrntSideRdrRiObj4RdrObjElevnSts "Refer to the data element description in FrntSideRdrLeObj1 with the same data element name.";
CM_ SG_ 355 FrntSideRdrRiObj4RdrObjID "Refer to the data element description in FrntSideRdrLeObj1 with the same data element name.";
CM_ SG_ 355 FrntSideRdrRiObj4RdrObjIsInFreeSpace "Refer to the data element description in FrntSideRdrLeObj1 with the same data element name.";
CM_ SG_ 355 FrntSideRdrRiObj4RdrObjMirrProblty "Refer to the data element description in FrntSideRdrLeObj1 with the same data element name.";
CM_ SG_ 355 FrntSideRdrRiObj4RdrObjMtnPat "Refer to the data element description in FrntSideRdrLeObj1 with the same data element name.";
CM_ SG_ 355 FrntSideRdrRiObj4RdrObjNotRealProblty "Refer to the data element description in FrntSideRdrLeObj1 with the same data element name.";
CM_ SG_ 355 FrntSideRdrRiObj4RdrObjStatyCnt "Refer to the data element description in FrntSideRdrLeObj1 with the same data element name.";
CM_ SG_ 355 FrntSideRdrRiObj4RdrObjTiAlv "Refer to the data element description in FrntSideRdrLeObj1 with the same data element name.";
CM_ SG_ 355 FrntSideRdrRiObj4RdrObjTrackSts "Refer to the data element description in FrntSideRdrLeObj1 with the same data element name.";
CM_ SG_ 355 FrntSideRdrRiObj4RdrObjTyp "Refer to the data element description in FrntSideRdrLeObj1 with the same data element name.";
CM_ SG_ 355 FrntSideRdrRiObj4RdrObjTypConfBike "Refer to the data element description in FrntSideRdrLeObj1 with the same data element name.";
CM_ SG_ 355 FrntSideRdrRiObj4RdrObjTypConfPed "Refer to the data element description in FrntSideRdrLeObj1 with the same data element name.";
CM_ SG_ 355 FrntSideRdrRiObj4RdrObjTypConfVeh "Refer to the data element description in FrntSideRdrLeObj1 with the same data element name.";
CM_ SG_ 355 FrntSideRdrRiObj4RdrObjUsedTracker "Refer to the data element description in FrntSideRdrLeObj1 with the same data element name.";
CM_ SG_ 355 FrntSideRdrRiObj4RdrObjVx "Refer to the data element description in FrntSideRdrLeObj1 with the same data element name.";
CM_ SG_ 355 FrntSideRdrRiObj4RdrObjVxStdDe "Refer to the data element description in FrntSideRdrLeObj1 with the same data element name.";
CM_ SG_ 355 FrntSideRdrRiObj4RdrObjVy "Refer to the data element description in FrntSideRdrLeObj1 with the same data element name.";
CM_ SG_ 355 FrntSideRdrRiObj4RdrObjVyStdDe "Refer to the data element description in FrntSideRdrLeObj1 with the same data element name.";
CM_ SG_ 355 FrntSideRdrRiObj4RelVx "Refer to the data element description in ReSideRdrRiObj1 with the same data element name";
CM_ SG_ 355 FrntSideRdrRiObj4RelVy "Refer to the data element description in ReSideRdrRiObj1 with the same data element name";
CM_ SG_ 357 FrntSideRdrRiObj5Heading "Refer to the data element description in ReSideRdrRiObj1 with the same data element name";
CM_ SG_ 357 FrntSideRdrRiObj5ObjBoxCenterLat "Box center y coordinate (relative closest point)";
CM_ SG_ 357 FrntSideRdrRiObj5ObjBoxCenterLgt "Box center x coordinate (relative closest point)";
CM_ SG_ 357 FrntSideRdrRiObj5ObservationHist "Refer to the data element description in ReSideRdrRiObj1 with the same data element name";
CM_ SG_ 357 FrntSideRdrRiObj5QualityBits "Refer to the data element description in FrntSideRdrLeObj1 with the same data element name.";
CM_ SG_ 357 FrntSideRdrRiObj5RdrObjAx "Refer to the data element description in FrntSideRdrLeObj1 with the same data element name.";
CM_ SG_ 357 FrntSideRdrRiObj5RdrObjAy "Refer to the data element description in FrntSideRdrLeObj1 with the same data element name.";
CM_ SG_ 357 FrntSideRdrRiObj5RdrObjBoxLength "Box length (box extent that is parallel to objects heading angle)";
CM_ SG_ 357 FrntSideRdrRiObj5RdrObjBoxWidth "Box width (box extent that is perpendicular to objects heading angle)";
CM_ SG_ 357 FrntSideRdrRiObj5RdrObjChks "Refer to the data element description in FrntSideRdrLeObj1 with the same data element name.";
CM_ SG_ 357 FrntSideRdrRiObj5RdrObjCntr "Refer to the data element description in FrntSideRdrLeObj1 with the same data element name.";
CM_ SG_ 357 FrntSideRdrRiObj5RdrObjCoastCnt "Refer to the data element description in FrntSideRdrLeObj1 with the same data element name.";
CM_ SG_ 357 FrntSideRdrRiObj5RdrObjConf "Refer to the data element description in FrntSideRdrLeObj1 with the same data element name.";
CM_ SG_ 357 FrntSideRdrRiObj5RdrObjDx "Refer to the data element description in FrntSideRdrLeObj1 with the same data element name.";
CM_ SG_ 357 FrntSideRdrRiObj5RdrObjDxStdDe "Refer to the data element description in FrntSideRdrLeObj1 with the same data element name.";
CM_ SG_ 357 FrntSideRdrRiObj5RdrObjDy "Refer to the data element description in FrntSideRdrLeObj1 with the same data element name.";
CM_ SG_ 357 FrntSideRdrRiObj5RdrObjDyStdDe "Refer to the data element description in FrntSideRdrLeObj1 with the same data element name.";
CM_ SG_ 357 FrntSideRdrRiObj5RdrObjElevnConf "Refer to the data element description in FrntSideRdrLeObj1 with the same data element name.";
CM_ SG_ 357 FrntSideRdrRiObj5RdrObjElevnSts "Refer to the data element description in FrntSideRdrLeObj1 with the same data element name.";
CM_ SG_ 357 FrntSideRdrRiObj5RdrObjID "Refer to the data element description in FrntSideRdrLeObj1 with the same data element name.";
CM_ SG_ 357 FrntSideRdrRiObj5RdrObjIsInFreeSpace "Refer to the data element description in FrntSideRdrLeObj1 with the same data element name.";
CM_ SG_ 357 FrntSideRdrRiObj5RdrObjMirrProblty "Refer to the data element description in FrntSideRdrLeObj1 with the same data element name.";
CM_ SG_ 357 FrntSideRdrRiObj5RdrObjMtnPat "Refer to the data element description in FrntSideRdrLeObj1 with the same data element name.";
CM_ SG_ 357 FrntSideRdrRiObj5RdrObjNotRealProblty "Refer to the data element description in FrntSideRdrLeObj1 with the same data element name.";
CM_ SG_ 357 FrntSideRdrRiObj5RdrObjStatyCnt "Refer to the data element description in FrntSideRdrLeObj1 with the same data element name.";
CM_ SG_ 357 FrntSideRdrRiObj5RdrObjTiAlv "Refer to the data element description in FrntSideRdrLeObj1 with the same data element name.";
CM_ SG_ 357 FrntSideRdrRiObj5RdrObjTrackSts "Refer to the data element description in FrntSideRdrLeObj1 with the same data element name.";
CM_ SG_ 357 FrntSideRdrRiObj5RdrObjTyp "Refer to the data element description in FrntSideRdrLeObj1 with the same data element name.";
CM_ SG_ 357 FrntSideRdrRiObj5RdrObjTypConfBike "Refer to the data element description in FrntSideRdrLeObj1 with the same data element name.";
CM_ SG_ 357 FrntSideRdrRiObj5RdrObjTypConfPed "Refer to the data element description in FrntSideRdrLeObj1 with the same data element name.";
CM_ SG_ 357 FrntSideRdrRiObj5RdrObjTypConfVeh "Refer to the data element description in FrntSideRdrLeObj1 with the same data element name.";
CM_ SG_ 357 FrntSideRdrRiObj5RdrObjUsedTracker "Refer to the data element description in FrntSideRdrLeObj1 with the same data element name.";
CM_ SG_ 357 FrntSideRdrRiObj5RdrObjVx "Refer to the data element description in FrntSideRdrLeObj1 with the same data element name.";
CM_ SG_ 357 FrntSideRdrRiObj5RdrObjVxStdDe "Refer to the data element description in FrntSideRdrLeObj1 with the same data element name.";
CM_ SG_ 357 FrntSideRdrRiObj5RdrObjVy "Refer to the data element description in FrntSideRdrLeObj1 with the same data element name.";
CM_ SG_ 357 FrntSideRdrRiObj5RdrObjVyStdDe "Refer to the data element description in FrntSideRdrLeObj1 with the same data element name.";
CM_ SG_ 357 FrntSideRdrRiObj5RelVx "Refer to the data element description in ReSideRdrRiObj1 with the same data element name";
CM_ SG_ 357 FrntSideRdrRiObj5RelVy "Refer to the data element description in ReSideRdrRiObj1 with the same data element name";
BA_DEF_ BO_ "CANFD_BRS" ENUM "0","1";
BA_DEF_ BO_ "GenMsgCycleTime" INT 0 65536; // [ms]
BA_DEF_ BO_ "GenMsgDelayTime" INT 0 65536; // [ms]
BA_DEF_ BO_ "GenMsgSendType" ENUM "cyclic", "spontaneous", "not-used", "not-used", "not-used", "cyclicAndSpontaneous", "not-used", "cyclicIfActive", "NoMsgSendType"; // [us]
BA_DEF_ BO_ "GenMsgStartDelayTime" INT 0 65536; // [ms]
BA_DEF_ BO_ "VFrameFormat" ENUM "StandardCAN","ExtendedCAN","reserved","J1939PG","reserved","reserved","reserved","reserved","reserved","reserved","reserved","reserved","reserved","reserved","StandardCAN_FD","ExtendedCAN_FD";
BA_DEF_ SG_ "GenSigSendType" ENUM "Cyclic","OnWrite","OnWriteWithRepetition","OnChange","OnChangeWithRepetition","IfActive","IfActiveWithRepetition","NoSigSendType";
BA_DEF_ SG_ "GenSigStartValue" HEX 0 80000000;
BA_DEF_ BO_ "GenMsgILSupport" ENUM "No","Yes";
BA_DEF_ BO_ "NmAsrMessage" ENUM "No","Yes";
BA_DEF_ SG_ "GenSigFuncType" ENUM "NoFunction","n/a","n/a","n/a","n/a","n/a","n/a","n/a","n/a","n/a","n/a","n/a","n/a","n/a","n/a","CHK","CNTR","n/a","n/a","n/a","CNTR_AR_01","CRC_AR_01_BOTH","CRC_AR_01_ALT","CRC_AR_01_LOW","CRC_AR_01_NIBBLE","CNTR_AR_04","CRC_AR_04A","CNTR_AR_05","CRC_AR_05";
BA_DEF_ SG_ "GenSigDataID" STRING;
BA_DEF_DEF_ "CANFD_BRS" "1";
BA_DEF_DEF_ "GenSigStartValue" 0;
BA_DEF_DEF_ "VFrameFormat" "J1939PG";
BA_DEF_DEF_ "GenSigSendType" "NoSigSendType";
BA_DEF_DEF_ "GenMsgCycleTime" 0;
BA_DEF_DEF_ "GenMsgDelayTime" 0;
BA_DEF_DEF_ "GenMsgStartDelayTime" 0;
BA_DEF_DEF_ "GenMsgSendType" "NoMsgSendType";
BA_DEF_DEF_ "GenMsgILSupport" "Yes";
BA_DEF_DEF_ "NmAsrMessage" "No";
BA_DEF_DEF_ "GenSigFuncType" "NoFunction";
BA_DEF_DEF_ "GenSigDataID" "";
// Frame: FSRRSafetyCANFD1Frame17
BA_ "GenMsgCycleTime" BO_ 337 50.000;
BA_ "GenMsgSendType" BO_ 337 0;
BA_ "VFrameFormat" BO_ 337 14;
// Frame: FSRRSafetyCANFD1Frame18
BA_ "GenMsgCycleTime" BO_ 339 50.000;
BA_ "GenMsgSendType" BO_ 339 0;
BA_ "VFrameFormat" BO_ 339 14;
// Frame: FSRRSafetyCANFD1Frame19
BA_ "GenMsgCycleTime" BO_ 341 50.000;
BA_ "GenMsgSendType" BO_ 341 0;
BA_ "VFrameFormat" BO_ 341 14;
// Frame: FSRRSafetyCANFD1Frame20
BA_ "GenMsgCycleTime" BO_ 343 50.000;
BA_ "GenMsgSendType" BO_ 343 0;
BA_ "VFrameFormat" BO_ 343 14;
// Frame: FSRRSafetyCANFD1Frame21
BA_ "GenMsgCycleTime" BO_ 345 50.000;
BA_ "GenMsgSendType" BO_ 345 0;
BA_ "VFrameFormat" BO_ 345 14;
// Frame: FSRRSafetyCANFD1Frame22
BA_ "GenMsgCycleTime" BO_ 347 50.000;
BA_ "GenMsgSendType" BO_ 347 0;
BA_ "VFrameFormat" BO_ 347 14;
// Frame: FSRRSafetyCANFD1Frame23
BA_ "GenMsgCycleTime" BO_ 349 50.000;
BA_ "GenMsgSendType" BO_ 349 0;
BA_ "VFrameFormat" BO_ 349 14;
// Frame: FSRRSafetyCANFD1Frame24
BA_ "GenMsgCycleTime" BO_ 351 50.000;
BA_ "GenMsgSendType" BO_ 351 0;
BA_ "VFrameFormat" BO_ 351 14;
// Frame: FSRRSafetyCANFD1Frame25
BA_ "GenMsgCycleTime" BO_ 353 50.000;
BA_ "GenMsgSendType" BO_ 353 0;
BA_ "VFrameFormat" BO_ 353 14;
// Frame: FSRRSafetyCANFD1Frame26
BA_ "GenMsgCycleTime" BO_ 355 50.000;
BA_ "GenMsgSendType" BO_ 355 0;
BA_ "VFrameFormat" BO_ 355 14;
// Frame: FSRRSafetyCANFD1Frame27
BA_ "GenMsgCycleTime" BO_ 357 50.000;
BA_ "GenMsgSendType" BO_ 357 0;
BA_ "VFrameFormat" BO_ 357 14;
BA_ "GenSigSendType" SG_ 337 FrntSideRdrRiDetn100RdrDetnAzi 0;
BA_ "GenSigStartValue" SG_ 337 FrntSideRdrRiDetn100RdrDetnAzi 900;
BA_ "GenSigDataID" SG_ 337 FrntSideRdrRiDetn100RdrDetnChks "0x946";
BA_ "GenSigFuncType" SG_ 337 FrntSideRdrRiDetn100RdrDetnChks 15;
BA_ "GenSigSendType" SG_ 337 FrntSideRdrRiDetn100RdrDetnChks 0;
BA_ "GenSigFuncType" SG_ 337 FrntSideRdrRiDetn100RdrDetnCntr 16;
BA_ "GenSigSendType" SG_ 337 FrntSideRdrRiDetn100RdrDetnCntr 0;
BA_ "GenSigSendType" SG_ 337 FrntSideRdrRiDetn100RdrDetnConf 0;
BA_ "GenSigSendType" SG_ 337 FrntSideRdrRiDetn100RdrDetnElevn 0;
BA_ "GenSigStartValue" SG_ 337 FrntSideRdrRiDetn100RdrDetnElevn 15;
BA_ "GenSigSendType" SG_ 337 FrntSideRdrRiDetn100RdrDetnPwr 0;
BA_ "GenSigSendType" SG_ 337 FrntSideRdrRiDetn100RdrDetnRng 0;
BA_ "GenSigStartValue" SG_ 337 FrntSideRdrRiDetn100RdrDetnRng 10050;
BA_ "GenSigSendType" SG_ 337 FrntSideRdrRiDetn100RdrDetnRngV 0;
BA_ "GenSigStartValue" SG_ 337 FrntSideRdrRiDetn100RdrDetnRngV 4000;
BA_ "GenSigSendType" SG_ 337 FrntSideRdrRiDetn100RdrDetnSts 0;
BA_ "GenSigStartValue" SG_ 337 FrntSideRdrRiDetn100RdrDetnSts 3;
BA_ "GenSigSendType" SG_ 337 FrntSideRdrRiDetn101RdrDetnAzi 0;
BA_ "GenSigStartValue" SG_ 337 FrntSideRdrRiDetn101RdrDetnAzi 900;
BA_ "GenSigDataID" SG_ 337 FrntSideRdrRiDetn101RdrDetnChks "0x947";
BA_ "GenSigFuncType" SG_ 337 FrntSideRdrRiDetn101RdrDetnChks 15;
BA_ "GenSigSendType" SG_ 337 FrntSideRdrRiDetn101RdrDetnChks 0;
BA_ "GenSigFuncType" SG_ 337 FrntSideRdrRiDetn101RdrDetnCntr 16;
BA_ "GenSigSendType" SG_ 337 FrntSideRdrRiDetn101RdrDetnCntr 0;
BA_ "GenSigSendType" SG_ 337 FrntSideRdrRiDetn101RdrDetnConf 0;
BA_ "GenSigSendType" SG_ 337 FrntSideRdrRiDetn101RdrDetnElevn 0;
BA_ "GenSigStartValue" SG_ 337 FrntSideRdrRiDetn101RdrDetnElevn 15;
BA_ "GenSigSendType" SG_ 337 FrntSideRdrRiDetn101RdrDetnPwr 0;
BA_ "GenSigSendType" SG_ 337 FrntSideRdrRiDetn101RdrDetnRng 0;
BA_ "GenSigStartValue" SG_ 337 FrntSideRdrRiDetn101RdrDetnRng 10050;
BA_ "GenSigSendType" SG_ 337 FrntSideRdrRiDetn101RdrDetnRngV 0;
BA_ "GenSigStartValue" SG_ 337 FrntSideRdrRiDetn101RdrDetnRngV 4000;
BA_ "GenSigSendType" SG_ 337 FrntSideRdrRiDetn101RdrDetnSts 0;
BA_ "GenSigStartValue" SG_ 337 FrntSideRdrRiDetn101RdrDetnSts 3;
BA_ "GenSigSendType" SG_ 337 FrntSideRdrRiDetn102RdrDetnAzi 0;
BA_ "GenSigStartValue" SG_ 337 FrntSideRdrRiDetn102RdrDetnAzi 900;
BA_ "GenSigDataID" SG_ 337 FrntSideRdrRiDetn102RdrDetnChks "0x948";
BA_ "GenSigFuncType" SG_ 337 FrntSideRdrRiDetn102RdrDetnChks 15;
BA_ "GenSigSendType" SG_ 337 FrntSideRdrRiDetn102RdrDetnChks 0;
BA_ "GenSigFuncType" SG_ 337 FrntSideRdrRiDetn102RdrDetnCntr 16;
BA_ "GenSigSendType" SG_ 337 FrntSideRdrRiDetn102RdrDetnCntr 0;
BA_ "GenSigSendType" SG_ 337 FrntSideRdrRiDetn102RdrDetnConf 0;
BA_ "GenSigSendType" SG_ 337 FrntSideRdrRiDetn102RdrDetnElevn 0;
BA_ "GenSigStartValue" SG_ 337 FrntSideRdrRiDetn102RdrDetnElevn 15;
BA_ "GenSigSendType" SG_ 337 FrntSideRdrRiDetn102RdrDetnPwr 0;
BA_ "GenSigSendType" SG_ 337 FrntSideRdrRiDetn102RdrDetnRng 0;
BA_ "GenSigStartValue" SG_ 337 FrntSideRdrRiDetn102RdrDetnRng 10050;
BA_ "GenSigSendType" SG_ 337 FrntSideRdrRiDetn102RdrDetnRngV 0;
BA_ "GenSigStartValue" SG_ 337 FrntSideRdrRiDetn102RdrDetnRngV 4000;
BA_ "GenSigSendType" SG_ 337 FrntSideRdrRiDetn102RdrDetnSts 0;
BA_ "GenSigStartValue" SG_ 337 FrntSideRdrRiDetn102RdrDetnSts 3;
BA_ "GenSigSendType" SG_ 339 FrntSideRdrRiDetn103RdrDetnAzi 0;
BA_ "GenSigStartValue" SG_ 339 FrntSideRdrRiDetn103RdrDetnAzi 900;
BA_ "GenSigDataID" SG_ 339 FrntSideRdrRiDetn103RdrDetnChks "0x949";
BA_ "GenSigFuncType" SG_ 339 FrntSideRdrRiDetn103RdrDetnChks 15;
BA_ "GenSigSendType" SG_ 339 FrntSideRdrRiDetn103RdrDetnChks 0;
BA_ "GenSigFuncType" SG_ 339 FrntSideRdrRiDetn103RdrDetnCntr 16;
BA_ "GenSigSendType" SG_ 339 FrntSideRdrRiDetn103RdrDetnCntr 0;
BA_ "GenSigSendType" SG_ 339 FrntSideRdrRiDetn103RdrDetnConf 0;
BA_ "GenSigSendType" SG_ 339 FrntSideRdrRiDetn103RdrDetnElevn 0;
BA_ "GenSigStartValue" SG_ 339 FrntSideRdrRiDetn103RdrDetnElevn 15;
BA_ "GenSigSendType" SG_ 339 FrntSideRdrRiDetn103RdrDetnPwr 0;
BA_ "GenSigSendType" SG_ 339 FrntSideRdrRiDetn103RdrDetnRng 0;
BA_ "GenSigStartValue" SG_ 339 FrntSideRdrRiDetn103RdrDetnRng 10050;
BA_ "GenSigSendType" SG_ 339 FrntSideRdrRiDetn103RdrDetnRngV 0;
BA_ "GenSigStartValue" SG_ 339 FrntSideRdrRiDetn103RdrDetnRngV 4000;
BA_ "GenSigSendType" SG_ 339 FrntSideRdrRiDetn103RdrDetnSts 0;
BA_ "GenSigStartValue" SG_ 339 FrntSideRdrRiDetn103RdrDetnSts 3;
BA_ "GenSigSendType" SG_ 339 FrntSideRdrRiDetn104RdrDetnAzi 0;
BA_ "GenSigStartValue" SG_ 339 FrntSideRdrRiDetn104RdrDetnAzi 900;
BA_ "GenSigDataID" SG_ 339 FrntSideRdrRiDetn104RdrDetnChks "0x94A";
BA_ "GenSigFuncType" SG_ 339 FrntSideRdrRiDetn104RdrDetnChks 15;
BA_ "GenSigSendType" SG_ 339 FrntSideRdrRiDetn104RdrDetnChks 0;
BA_ "GenSigFuncType" SG_ 339 FrntSideRdrRiDetn104RdrDetnCntr 16;
BA_ "GenSigSendType" SG_ 339 FrntSideRdrRiDetn104RdrDetnCntr 0;
BA_ "GenSigSendType" SG_ 339 FrntSideRdrRiDetn104RdrDetnConf 0;
BA_ "GenSigSendType" SG_ 339 FrntSideRdrRiDetn104RdrDetnElevn 0;
BA_ "GenSigStartValue" SG_ 339 FrntSideRdrRiDetn104RdrDetnElevn 15;
BA_ "GenSigSendType" SG_ 339 FrntSideRdrRiDetn104RdrDetnPwr 0;
BA_ "GenSigSendType" SG_ 339 FrntSideRdrRiDetn104RdrDetnRng 0;
BA_ "GenSigStartValue" SG_ 339 FrntSideRdrRiDetn104RdrDetnRng 10050;
BA_ "GenSigSendType" SG_ 339 FrntSideRdrRiDetn104RdrDetnRngV 0;
BA_ "GenSigStartValue" SG_ 339 FrntSideRdrRiDetn104RdrDetnRngV 4000;
BA_ "GenSigSendType" SG_ 339 FrntSideRdrRiDetn104RdrDetnSts 0;
BA_ "GenSigStartValue" SG_ 339 FrntSideRdrRiDetn104RdrDetnSts 3;
BA_ "GenSigSendType" SG_ 339 FrntSideRdrRiDetn105RdrDetnAzi 0;
BA_ "GenSigStartValue" SG_ 339 FrntSideRdrRiDetn105RdrDetnAzi 900;
BA_ "GenSigDataID" SG_ 339 FrntSideRdrRiDetn105RdrDetnChks "0x94B";
BA_ "GenSigFuncType" SG_ 339 FrntSideRdrRiDetn105RdrDetnChks 15;
BA_ "GenSigSendType" SG_ 339 FrntSideRdrRiDetn105RdrDetnChks 0;
BA_ "GenSigFuncType" SG_ 339 FrntSideRdrRiDetn105RdrDetnCntr 16;
BA_ "GenSigSendType" SG_ 339 FrntSideRdrRiDetn105RdrDetnCntr 0;
BA_ "GenSigSendType" SG_ 339 FrntSideRdrRiDetn105RdrDetnConf 0;
BA_ "GenSigSendType" SG_ 339 FrntSideRdrRiDetn105RdrDetnElevn 0;
BA_ "GenSigStartValue" SG_ 339 FrntSideRdrRiDetn105RdrDetnElevn 15;
BA_ "GenSigSendType" SG_ 339 FrntSideRdrRiDetn105RdrDetnPwr 0;
BA_ "GenSigSendType" SG_ 339 FrntSideRdrRiDetn105RdrDetnRng 0;
BA_ "GenSigStartValue" SG_ 339 FrntSideRdrRiDetn105RdrDetnRng 10050;
BA_ "GenSigSendType" SG_ 339 FrntSideRdrRiDetn105RdrDetnRngV 0;
BA_ "GenSigStartValue" SG_ 339 FrntSideRdrRiDetn105RdrDetnRngV 4000;
BA_ "GenSigSendType" SG_ 339 FrntSideRdrRiDetn105RdrDetnSts 0;
BA_ "GenSigStartValue" SG_ 339 FrntSideRdrRiDetn105RdrDetnSts 3;
BA_ "GenSigSendType" SG_ 339 FrntSideRdrRiDetn106RdrDetnAzi 0;
BA_ "GenSigStartValue" SG_ 339 FrntSideRdrRiDetn106RdrDetnAzi 900;
BA_ "GenSigDataID" SG_ 339 FrntSideRdrRiDetn106RdrDetnChks "0x94C";
BA_ "GenSigFuncType" SG_ 339 FrntSideRdrRiDetn106RdrDetnChks 15;
BA_ "GenSigSendType" SG_ 339 FrntSideRdrRiDetn106RdrDetnChks 0;
BA_ "GenSigFuncType" SG_ 339 FrntSideRdrRiDetn106RdrDetnCntr 16;
BA_ "GenSigSendType" SG_ 339 FrntSideRdrRiDetn106RdrDetnCntr 0;
BA_ "GenSigSendType" SG_ 339 FrntSideRdrRiDetn106RdrDetnConf 0;
BA_ "GenSigSendType" SG_ 339 FrntSideRdrRiDetn106RdrDetnElevn 0;
BA_ "GenSigStartValue" SG_ 339 FrntSideRdrRiDetn106RdrDetnElevn 15;
BA_ "GenSigSendType" SG_ 339 FrntSideRdrRiDetn106RdrDetnPwr 0;
BA_ "GenSigSendType" SG_ 339 FrntSideRdrRiDetn106RdrDetnRng 0;
BA_ "GenSigStartValue" SG_ 339 FrntSideRdrRiDetn106RdrDetnRng 10050;
BA_ "GenSigSendType" SG_ 339 FrntSideRdrRiDetn106RdrDetnRngV 0;
BA_ "GenSigStartValue" SG_ 339 FrntSideRdrRiDetn106RdrDetnRngV 4000;
BA_ "GenSigSendType" SG_ 339 FrntSideRdrRiDetn106RdrDetnSts 0;
BA_ "GenSigStartValue" SG_ 339 FrntSideRdrRiDetn106RdrDetnSts 3;
BA_ "GenSigSendType" SG_ 339 FrntSideRdrRiDetn107RdrDetnAzi 0;
BA_ "GenSigStartValue" SG_ 339 FrntSideRdrRiDetn107RdrDetnAzi 900;
BA_ "GenSigDataID" SG_ 339 FrntSideRdrRiDetn107RdrDetnChks "0x94D";
BA_ "GenSigFuncType" SG_ 339 FrntSideRdrRiDetn107RdrDetnChks 15;
BA_ "GenSigSendType" SG_ 339 FrntSideRdrRiDetn107RdrDetnChks 0;
BA_ "GenSigFuncType" SG_ 339 FrntSideRdrRiDetn107RdrDetnCntr 16;
BA_ "GenSigSendType" SG_ 339 FrntSideRdrRiDetn107RdrDetnCntr 0;
BA_ "GenSigSendType" SG_ 339 FrntSideRdrRiDetn107RdrDetnConf 0;
BA_ "GenSigSendType" SG_ 339 FrntSideRdrRiDetn107RdrDetnElevn 0;
BA_ "GenSigStartValue" SG_ 339 FrntSideRdrRiDetn107RdrDetnElevn 15;
BA_ "GenSigSendType" SG_ 339 FrntSideRdrRiDetn107RdrDetnPwr 0;
BA_ "GenSigSendType" SG_ 339 FrntSideRdrRiDetn107RdrDetnRng 0;
BA_ "GenSigStartValue" SG_ 339 FrntSideRdrRiDetn107RdrDetnRng 10050;
BA_ "GenSigSendType" SG_ 339 FrntSideRdrRiDetn107RdrDetnRngV 0;
BA_ "GenSigStartValue" SG_ 339 FrntSideRdrRiDetn107RdrDetnRngV 4000;
BA_ "GenSigSendType" SG_ 339 FrntSideRdrRiDetn107RdrDetnSts 0;
BA_ "GenSigStartValue" SG_ 339 FrntSideRdrRiDetn107RdrDetnSts 3;
BA_ "GenSigSendType" SG_ 339 FrntSideRdrRiDetn108RdrDetnAzi 0;
BA_ "GenSigStartValue" SG_ 339 FrntSideRdrRiDetn108RdrDetnAzi 900;
BA_ "GenSigDataID" SG_ 339 FrntSideRdrRiDetn108RdrDetnChks "0x94E";
BA_ "GenSigFuncType" SG_ 339 FrntSideRdrRiDetn108RdrDetnChks 15;
BA_ "GenSigSendType" SG_ 339 FrntSideRdrRiDetn108RdrDetnChks 0;
BA_ "GenSigFuncType" SG_ 339 FrntSideRdrRiDetn108RdrDetnCntr 16;
BA_ "GenSigSendType" SG_ 339 FrntSideRdrRiDetn108RdrDetnCntr 0;
BA_ "GenSigSendType" SG_ 339 FrntSideRdrRiDetn108RdrDetnConf 0;
BA_ "GenSigSendType" SG_ 339 FrntSideRdrRiDetn108RdrDetnElevn 0;
BA_ "GenSigStartValue" SG_ 339 FrntSideRdrRiDetn108RdrDetnElevn 15;
BA_ "GenSigSendType" SG_ 339 FrntSideRdrRiDetn108RdrDetnPwr 0;
BA_ "GenSigSendType" SG_ 339 FrntSideRdrRiDetn108RdrDetnRng 0;
BA_ "GenSigStartValue" SG_ 339 FrntSideRdrRiDetn108RdrDetnRng 10050;
BA_ "GenSigSendType" SG_ 339 FrntSideRdrRiDetn108RdrDetnRngV 0;
BA_ "GenSigStartValue" SG_ 339 FrntSideRdrRiDetn108RdrDetnRngV 4000;
BA_ "GenSigSendType" SG_ 339 FrntSideRdrRiDetn108RdrDetnSts 0;
BA_ "GenSigStartValue" SG_ 339 FrntSideRdrRiDetn108RdrDetnSts 3;
BA_ "GenSigSendType" SG_ 341 FrntSideRdrRiDetn109RdrDetnAzi 0;
BA_ "GenSigStartValue" SG_ 341 FrntSideRdrRiDetn109RdrDetnAzi 900;
BA_ "GenSigDataID" SG_ 341 FrntSideRdrRiDetn109RdrDetnChks "0x94F";
BA_ "GenSigFuncType" SG_ 341 FrntSideRdrRiDetn109RdrDetnChks 15;
BA_ "GenSigSendType" SG_ 341 FrntSideRdrRiDetn109RdrDetnChks 0;
BA_ "GenSigFuncType" SG_ 341 FrntSideRdrRiDetn109RdrDetnCntr 16;
BA_ "GenSigSendType" SG_ 341 FrntSideRdrRiDetn109RdrDetnCntr 0;
BA_ "GenSigSendType" SG_ 341 FrntSideRdrRiDetn109RdrDetnConf 0;
BA_ "GenSigSendType" SG_ 341 FrntSideRdrRiDetn109RdrDetnElevn 0;
BA_ "GenSigStartValue" SG_ 341 FrntSideRdrRiDetn109RdrDetnElevn 15;
BA_ "GenSigSendType" SG_ 341 FrntSideRdrRiDetn109RdrDetnPwr 0;
BA_ "GenSigSendType" SG_ 341 FrntSideRdrRiDetn109RdrDetnRng 0;
BA_ "GenSigStartValue" SG_ 341 FrntSideRdrRiDetn109RdrDetnRng 10050;
BA_ "GenSigSendType" SG_ 341 FrntSideRdrRiDetn109RdrDetnRngV 0;
BA_ "GenSigStartValue" SG_ 341 FrntSideRdrRiDetn109RdrDetnRngV 4000;
BA_ "GenSigSendType" SG_ 341 FrntSideRdrRiDetn109RdrDetnSts 0;
BA_ "GenSigStartValue" SG_ 341 FrntSideRdrRiDetn109RdrDetnSts 3;
BA_ "GenSigSendType" SG_ 341 FrntSideRdrRiDetn110RdrDetnAzi 0;
BA_ "GenSigStartValue" SG_ 341 FrntSideRdrRiDetn110RdrDetnAzi 900;
BA_ "GenSigDataID" SG_ 341 FrntSideRdrRiDetn110RdrDetnChks "0x950";
BA_ "GenSigFuncType" SG_ 341 FrntSideRdrRiDetn110RdrDetnChks 15;
BA_ "GenSigSendType" SG_ 341 FrntSideRdrRiDetn110RdrDetnChks 0;
BA_ "GenSigFuncType" SG_ 341 FrntSideRdrRiDetn110RdrDetnCntr 16;
BA_ "GenSigSendType" SG_ 341 FrntSideRdrRiDetn110RdrDetnCntr 0;
BA_ "GenSigSendType" SG_ 341 FrntSideRdrRiDetn110RdrDetnConf 0;
BA_ "GenSigSendType" SG_ 341 FrntSideRdrRiDetn110RdrDetnElevn 0;
BA_ "GenSigStartValue" SG_ 341 FrntSideRdrRiDetn110RdrDetnElevn 15;
BA_ "GenSigSendType" SG_ 341 FrntSideRdrRiDetn110RdrDetnPwr 0;
BA_ "GenSigSendType" SG_ 341 FrntSideRdrRiDetn110RdrDetnRng 0;
BA_ "GenSigStartValue" SG_ 341 FrntSideRdrRiDetn110RdrDetnRng 10050;
BA_ "GenSigSendType" SG_ 341 FrntSideRdrRiDetn110RdrDetnRngV 0;
BA_ "GenSigStartValue" SG_ 341 FrntSideRdrRiDetn110RdrDetnRngV 4000;
BA_ "GenSigSendType" SG_ 341 FrntSideRdrRiDetn110RdrDetnSts 0;
BA_ "GenSigStartValue" SG_ 341 FrntSideRdrRiDetn110RdrDetnSts 3;
BA_ "GenSigSendType" SG_ 341 FrntSideRdrRiDetn111RdrDetnAzi 0;
BA_ "GenSigStartValue" SG_ 341 FrntSideRdrRiDetn111RdrDetnAzi 900;
BA_ "GenSigDataID" SG_ 341 FrntSideRdrRiDetn111RdrDetnChks "0x951";
BA_ "GenSigFuncType" SG_ 341 FrntSideRdrRiDetn111RdrDetnChks 15;
BA_ "GenSigSendType" SG_ 341 FrntSideRdrRiDetn111RdrDetnChks 0;
BA_ "GenSigFuncType" SG_ 341 FrntSideRdrRiDetn111RdrDetnCntr 16;
BA_ "GenSigSendType" SG_ 341 FrntSideRdrRiDetn111RdrDetnCntr 0;
BA_ "GenSigSendType" SG_ 341 FrntSideRdrRiDetn111RdrDetnConf 0;
BA_ "GenSigSendType" SG_ 341 FrntSideRdrRiDetn111RdrDetnElevn 0;
BA_ "GenSigStartValue" SG_ 341 FrntSideRdrRiDetn111RdrDetnElevn 15;
BA_ "GenSigSendType" SG_ 341 FrntSideRdrRiDetn111RdrDetnPwr 0;
BA_ "GenSigSendType" SG_ 341 FrntSideRdrRiDetn111RdrDetnRng 0;
BA_ "GenSigStartValue" SG_ 341 FrntSideRdrRiDetn111RdrDetnRng 10050;
BA_ "GenSigSendType" SG_ 341 FrntSideRdrRiDetn111RdrDetnRngV 0;
BA_ "GenSigStartValue" SG_ 341 FrntSideRdrRiDetn111RdrDetnRngV 4000;
BA_ "GenSigSendType" SG_ 341 FrntSideRdrRiDetn111RdrDetnSts 0;
BA_ "GenSigStartValue" SG_ 341 FrntSideRdrRiDetn111RdrDetnSts 3;
BA_ "GenSigSendType" SG_ 341 FrntSideRdrRiDetn112RdrDetnAzi 0;
BA_ "GenSigStartValue" SG_ 341 FrntSideRdrRiDetn112RdrDetnAzi 900;
BA_ "GenSigDataID" SG_ 341 FrntSideRdrRiDetn112RdrDetnChks "0x952";
BA_ "GenSigFuncType" SG_ 341 FrntSideRdrRiDetn112RdrDetnChks 15;
BA_ "GenSigSendType" SG_ 341 FrntSideRdrRiDetn112RdrDetnChks 0;
BA_ "GenSigFuncType" SG_ 341 FrntSideRdrRiDetn112RdrDetnCntr 16;
BA_ "GenSigSendType" SG_ 341 FrntSideRdrRiDetn112RdrDetnCntr 0;
BA_ "GenSigSendType" SG_ 341 FrntSideRdrRiDetn112RdrDetnConf 0;
BA_ "GenSigSendType" SG_ 341 FrntSideRdrRiDetn112RdrDetnElevn 0;
BA_ "GenSigStartValue" SG_ 341 FrntSideRdrRiDetn112RdrDetnElevn 15;
BA_ "GenSigSendType" SG_ 341 FrntSideRdrRiDetn112RdrDetnPwr 0;
BA_ "GenSigSendType" SG_ 341 FrntSideRdrRiDetn112RdrDetnRng 0;
BA_ "GenSigStartValue" SG_ 341 FrntSideRdrRiDetn112RdrDetnRng 10050;
BA_ "GenSigSendType" SG_ 341 FrntSideRdrRiDetn112RdrDetnRngV 0;
BA_ "GenSigStartValue" SG_ 341 FrntSideRdrRiDetn112RdrDetnRngV 4000;
BA_ "GenSigSendType" SG_ 341 FrntSideRdrRiDetn112RdrDetnSts 0;
BA_ "GenSigStartValue" SG_ 341 FrntSideRdrRiDetn112RdrDetnSts 3;
BA_ "GenSigSendType" SG_ 341 FrntSideRdrRiDetn113RdrDetnAzi 0;
BA_ "GenSigStartValue" SG_ 341 FrntSideRdrRiDetn113RdrDetnAzi 900;
BA_ "GenSigDataID" SG_ 341 FrntSideRdrRiDetn113RdrDetnChks "0x953";
BA_ "GenSigFuncType" SG_ 341 FrntSideRdrRiDetn113RdrDetnChks 15;
BA_ "GenSigSendType" SG_ 341 FrntSideRdrRiDetn113RdrDetnChks 0;
BA_ "GenSigFuncType" SG_ 341 FrntSideRdrRiDetn113RdrDetnCntr 16;
BA_ "GenSigSendType" SG_ 341 FrntSideRdrRiDetn113RdrDetnCntr 0;
BA_ "GenSigSendType" SG_ 341 FrntSideRdrRiDetn113RdrDetnConf 0;
BA_ "GenSigSendType" SG_ 341 FrntSideRdrRiDetn113RdrDetnElevn 0;
BA_ "GenSigStartValue" SG_ 341 FrntSideRdrRiDetn113RdrDetnElevn 15;
BA_ "GenSigSendType" SG_ 341 FrntSideRdrRiDetn113RdrDetnPwr 0;
BA_ "GenSigSendType" SG_ 341 FrntSideRdrRiDetn113RdrDetnRng 0;
BA_ "GenSigStartValue" SG_ 341 FrntSideRdrRiDetn113RdrDetnRng 10050;
BA_ "GenSigSendType" SG_ 341 FrntSideRdrRiDetn113RdrDetnRngV 0;
BA_ "GenSigStartValue" SG_ 341 FrntSideRdrRiDetn113RdrDetnRngV 4000;
BA_ "GenSigSendType" SG_ 341 FrntSideRdrRiDetn113RdrDetnSts 0;
BA_ "GenSigStartValue" SG_ 341 FrntSideRdrRiDetn113RdrDetnSts 3;
BA_ "GenSigSendType" SG_ 341 FrntSideRdrRiDetn114RdrDetnAzi 0;
BA_ "GenSigStartValue" SG_ 341 FrntSideRdrRiDetn114RdrDetnAzi 900;
BA_ "GenSigDataID" SG_ 341 FrntSideRdrRiDetn114RdrDetnChks "0x954";
BA_ "GenSigFuncType" SG_ 341 FrntSideRdrRiDetn114RdrDetnChks 15;
BA_ "GenSigSendType" SG_ 341 FrntSideRdrRiDetn114RdrDetnChks 0;
BA_ "GenSigFuncType" SG_ 341 FrntSideRdrRiDetn114RdrDetnCntr 16;
BA_ "GenSigSendType" SG_ 341 FrntSideRdrRiDetn114RdrDetnCntr 0;
BA_ "GenSigSendType" SG_ 341 FrntSideRdrRiDetn114RdrDetnConf 0;
BA_ "GenSigSendType" SG_ 341 FrntSideRdrRiDetn114RdrDetnElevn 0;
BA_ "GenSigStartValue" SG_ 341 FrntSideRdrRiDetn114RdrDetnElevn 15;
BA_ "GenSigSendType" SG_ 341 FrntSideRdrRiDetn114RdrDetnPwr 0;
BA_ "GenSigSendType" SG_ 341 FrntSideRdrRiDetn114RdrDetnRng 0;
BA_ "GenSigStartValue" SG_ 341 FrntSideRdrRiDetn114RdrDetnRng 10050;
BA_ "GenSigSendType" SG_ 341 FrntSideRdrRiDetn114RdrDetnRngV 0;
BA_ "GenSigStartValue" SG_ 341 FrntSideRdrRiDetn114RdrDetnRngV 4000;
BA_ "GenSigSendType" SG_ 341 FrntSideRdrRiDetn114RdrDetnSts 0;
BA_ "GenSigStartValue" SG_ 341 FrntSideRdrRiDetn114RdrDetnSts 3;
BA_ "GenSigSendType" SG_ 343 FrntSideRdrRiDetn115RdrDetnAzi 0;
BA_ "GenSigStartValue" SG_ 343 FrntSideRdrRiDetn115RdrDetnAzi 900;
BA_ "GenSigDataID" SG_ 343 FrntSideRdrRiDetn115RdrDetnChks "0x955";
BA_ "GenSigFuncType" SG_ 343 FrntSideRdrRiDetn115RdrDetnChks 15;
BA_ "GenSigSendType" SG_ 343 FrntSideRdrRiDetn115RdrDetnChks 0;
BA_ "GenSigFuncType" SG_ 343 FrntSideRdrRiDetn115RdrDetnCntr 16;
BA_ "GenSigSendType" SG_ 343 FrntSideRdrRiDetn115RdrDetnCntr 0;
BA_ "GenSigSendType" SG_ 343 FrntSideRdrRiDetn115RdrDetnConf 0;
BA_ "GenSigSendType" SG_ 343 FrntSideRdrRiDetn115RdrDetnElevn 0;
BA_ "GenSigStartValue" SG_ 343 FrntSideRdrRiDetn115RdrDetnElevn 15;
BA_ "GenSigSendType" SG_ 343 FrntSideRdrRiDetn115RdrDetnPwr 0;
BA_ "GenSigSendType" SG_ 343 FrntSideRdrRiDetn115RdrDetnRng 0;
BA_ "GenSigStartValue" SG_ 343 FrntSideRdrRiDetn115RdrDetnRng 10050;
BA_ "GenSigSendType" SG_ 343 FrntSideRdrRiDetn115RdrDetnRngV 0;
BA_ "GenSigStartValue" SG_ 343 FrntSideRdrRiDetn115RdrDetnRngV 4000;
BA_ "GenSigSendType" SG_ 343 FrntSideRdrRiDetn115RdrDetnSts 0;
BA_ "GenSigStartValue" SG_ 343 FrntSideRdrRiDetn115RdrDetnSts 3;
BA_ "GenSigSendType" SG_ 343 FrntSideRdrRiDetn116RdrDetnAzi 0;
BA_ "GenSigStartValue" SG_ 343 FrntSideRdrRiDetn116RdrDetnAzi 900;
BA_ "GenSigDataID" SG_ 343 FrntSideRdrRiDetn116RdrDetnChks "0x956";
BA_ "GenSigFuncType" SG_ 343 FrntSideRdrRiDetn116RdrDetnChks 15;
BA_ "GenSigSendType" SG_ 343 FrntSideRdrRiDetn116RdrDetnChks 0;
BA_ "GenSigFuncType" SG_ 343 FrntSideRdrRiDetn116RdrDetnCntr 16;
BA_ "GenSigSendType" SG_ 343 FrntSideRdrRiDetn116RdrDetnCntr 0;
BA_ "GenSigSendType" SG_ 343 FrntSideRdrRiDetn116RdrDetnConf 0;
BA_ "GenSigSendType" SG_ 343 FrntSideRdrRiDetn116RdrDetnElevn 0;
BA_ "GenSigStartValue" SG_ 343 FrntSideRdrRiDetn116RdrDetnElevn 15;
BA_ "GenSigSendType" SG_ 343 FrntSideRdrRiDetn116RdrDetnPwr 0;
BA_ "GenSigSendType" SG_ 343 FrntSideRdrRiDetn116RdrDetnRng 0;
BA_ "GenSigStartValue" SG_ 343 FrntSideRdrRiDetn116RdrDetnRng 10050;
BA_ "GenSigSendType" SG_ 343 FrntSideRdrRiDetn116RdrDetnRngV 0;
BA_ "GenSigStartValue" SG_ 343 FrntSideRdrRiDetn116RdrDetnRngV 4000;
BA_ "GenSigSendType" SG_ 343 FrntSideRdrRiDetn116RdrDetnSts 0;
BA_ "GenSigStartValue" SG_ 343 FrntSideRdrRiDetn116RdrDetnSts 3;
BA_ "GenSigSendType" SG_ 343 FrntSideRdrRiDetn117RdrDetnAzi 0;
BA_ "GenSigStartValue" SG_ 343 FrntSideRdrRiDetn117RdrDetnAzi 900;
BA_ "GenSigDataID" SG_ 343 FrntSideRdrRiDetn117RdrDetnChks "0x957";
BA_ "GenSigFuncType" SG_ 343 FrntSideRdrRiDetn117RdrDetnChks 15;
BA_ "GenSigSendType" SG_ 343 FrntSideRdrRiDetn117RdrDetnChks 0;
BA_ "GenSigFuncType" SG_ 343 FrntSideRdrRiDetn117RdrDetnCntr 16;
BA_ "GenSigSendType" SG_ 343 FrntSideRdrRiDetn117RdrDetnCntr 0;
BA_ "GenSigSendType" SG_ 343 FrntSideRdrRiDetn117RdrDetnConf 0;
BA_ "GenSigSendType" SG_ 343 FrntSideRdrRiDetn117RdrDetnElevn 0;
BA_ "GenSigStartValue" SG_ 343 FrntSideRdrRiDetn117RdrDetnElevn 15;
BA_ "GenSigSendType" SG_ 343 FrntSideRdrRiDetn117RdrDetnPwr 0;
BA_ "GenSigSendType" SG_ 343 FrntSideRdrRiDetn117RdrDetnRng 0;
BA_ "GenSigStartValue" SG_ 343 FrntSideRdrRiDetn117RdrDetnRng 10050;
BA_ "GenSigSendType" SG_ 343 FrntSideRdrRiDetn117RdrDetnRngV 0;
BA_ "GenSigStartValue" SG_ 343 FrntSideRdrRiDetn117RdrDetnRngV 4000;
BA_ "GenSigSendType" SG_ 343 FrntSideRdrRiDetn117RdrDetnSts 0;
BA_ "GenSigStartValue" SG_ 343 FrntSideRdrRiDetn117RdrDetnSts 3;
BA_ "GenSigSendType" SG_ 343 FrntSideRdrRiDetn118RdrDetnAzi 0;
BA_ "GenSigStartValue" SG_ 343 FrntSideRdrRiDetn118RdrDetnAzi 900;
BA_ "GenSigDataID" SG_ 343 FrntSideRdrRiDetn118RdrDetnChks "0x958";
BA_ "GenSigFuncType" SG_ 343 FrntSideRdrRiDetn118RdrDetnChks 15;
BA_ "GenSigSendType" SG_ 343 FrntSideRdrRiDetn118RdrDetnChks 0;
BA_ "GenSigFuncType" SG_ 343 FrntSideRdrRiDetn118RdrDetnCntr 16;
BA_ "GenSigSendType" SG_ 343 FrntSideRdrRiDetn118RdrDetnCntr 0;
BA_ "GenSigSendType" SG_ 343 FrntSideRdrRiDetn118RdrDetnConf 0;
BA_ "GenSigSendType" SG_ 343 FrntSideRdrRiDetn118RdrDetnElevn 0;
BA_ "GenSigStartValue" SG_ 343 FrntSideRdrRiDetn118RdrDetnElevn 15;
BA_ "GenSigSendType" SG_ 343 FrntSideRdrRiDetn118RdrDetnPwr 0;
BA_ "GenSigSendType" SG_ 343 FrntSideRdrRiDetn118RdrDetnRng 0;
BA_ "GenSigStartValue" SG_ 343 FrntSideRdrRiDetn118RdrDetnRng 10050;
BA_ "GenSigSendType" SG_ 343 FrntSideRdrRiDetn118RdrDetnRngV 0;
BA_ "GenSigStartValue" SG_ 343 FrntSideRdrRiDetn118RdrDetnRngV 4000;
BA_ "GenSigSendType" SG_ 343 FrntSideRdrRiDetn118RdrDetnSts 0;
BA_ "GenSigStartValue" SG_ 343 FrntSideRdrRiDetn118RdrDetnSts 3;
BA_ "GenSigSendType" SG_ 343 FrntSideRdrRiDetn119RdrDetnAzi 0;
BA_ "GenSigStartValue" SG_ 343 FrntSideRdrRiDetn119RdrDetnAzi 900;
BA_ "GenSigDataID" SG_ 343 FrntSideRdrRiDetn119RdrDetnChks "0x959";
BA_ "GenSigFuncType" SG_ 343 FrntSideRdrRiDetn119RdrDetnChks 15;
BA_ "GenSigSendType" SG_ 343 FrntSideRdrRiDetn119RdrDetnChks 0;
BA_ "GenSigFuncType" SG_ 343 FrntSideRdrRiDetn119RdrDetnCntr 16;
BA_ "GenSigSendType" SG_ 343 FrntSideRdrRiDetn119RdrDetnCntr 0;
BA_ "GenSigSendType" SG_ 343 FrntSideRdrRiDetn119RdrDetnConf 0;
BA_ "GenSigSendType" SG_ 343 FrntSideRdrRiDetn119RdrDetnElevn 0;
BA_ "GenSigStartValue" SG_ 343 FrntSideRdrRiDetn119RdrDetnElevn 15;
BA_ "GenSigSendType" SG_ 343 FrntSideRdrRiDetn119RdrDetnPwr 0;
BA_ "GenSigSendType" SG_ 343 FrntSideRdrRiDetn119RdrDetnRng 0;
BA_ "GenSigStartValue" SG_ 343 FrntSideRdrRiDetn119RdrDetnRng 10050;
BA_ "GenSigSendType" SG_ 343 FrntSideRdrRiDetn119RdrDetnRngV 0;
BA_ "GenSigStartValue" SG_ 343 FrntSideRdrRiDetn119RdrDetnRngV 4000;
BA_ "GenSigSendType" SG_ 343 FrntSideRdrRiDetn119RdrDetnSts 0;
BA_ "GenSigStartValue" SG_ 343 FrntSideRdrRiDetn119RdrDetnSts 3;
BA_ "GenSigSendType" SG_ 343 FrntSideRdrRiDetn120RdrDetnAzi 0;
BA_ "GenSigStartValue" SG_ 343 FrntSideRdrRiDetn120RdrDetnAzi 900;
BA_ "GenSigDataID" SG_ 343 FrntSideRdrRiDetn120RdrDetnChks "0x95A";
BA_ "GenSigFuncType" SG_ 343 FrntSideRdrRiDetn120RdrDetnChks 15;
BA_ "GenSigSendType" SG_ 343 FrntSideRdrRiDetn120RdrDetnChks 0;
BA_ "GenSigFuncType" SG_ 343 FrntSideRdrRiDetn120RdrDetnCntr 16;
BA_ "GenSigSendType" SG_ 343 FrntSideRdrRiDetn120RdrDetnCntr 0;
BA_ "GenSigSendType" SG_ 343 FrntSideRdrRiDetn120RdrDetnConf 0;
BA_ "GenSigSendType" SG_ 343 FrntSideRdrRiDetn120RdrDetnElevn 0;
BA_ "GenSigStartValue" SG_ 343 FrntSideRdrRiDetn120RdrDetnElevn 15;
BA_ "GenSigSendType" SG_ 343 FrntSideRdrRiDetn120RdrDetnPwr 0;
BA_ "GenSigSendType" SG_ 343 FrntSideRdrRiDetn120RdrDetnRng 0;
BA_ "GenSigStartValue" SG_ 343 FrntSideRdrRiDetn120RdrDetnRng 10050;
BA_ "GenSigSendType" SG_ 343 FrntSideRdrRiDetn120RdrDetnRngV 0;
BA_ "GenSigStartValue" SG_ 343 FrntSideRdrRiDetn120RdrDetnRngV 4000;
BA_ "GenSigSendType" SG_ 343 FrntSideRdrRiDetn120RdrDetnSts 0;
BA_ "GenSigStartValue" SG_ 343 FrntSideRdrRiDetn120RdrDetnSts 3;
BA_ "GenSigSendType" SG_ 345 FrntSideRdrRiDetn121RdrDetnAzi 0;
BA_ "GenSigStartValue" SG_ 345 FrntSideRdrRiDetn121RdrDetnAzi 900;
BA_ "GenSigDataID" SG_ 345 FrntSideRdrRiDetn121RdrDetnChks "0x95B";
BA_ "GenSigFuncType" SG_ 345 FrntSideRdrRiDetn121RdrDetnChks 15;
BA_ "GenSigSendType" SG_ 345 FrntSideRdrRiDetn121RdrDetnChks 0;
BA_ "GenSigFuncType" SG_ 345 FrntSideRdrRiDetn121RdrDetnCntr 16;
BA_ "GenSigSendType" SG_ 345 FrntSideRdrRiDetn121RdrDetnCntr 0;
BA_ "GenSigSendType" SG_ 345 FrntSideRdrRiDetn121RdrDetnConf 0;
BA_ "GenSigSendType" SG_ 345 FrntSideRdrRiDetn121RdrDetnElevn 0;
BA_ "GenSigStartValue" SG_ 345 FrntSideRdrRiDetn121RdrDetnElevn 15;
BA_ "GenSigSendType" SG_ 345 FrntSideRdrRiDetn121RdrDetnPwr 0;
BA_ "GenSigSendType" SG_ 345 FrntSideRdrRiDetn121RdrDetnRng 0;
BA_ "GenSigStartValue" SG_ 345 FrntSideRdrRiDetn121RdrDetnRng 10050;
BA_ "GenSigSendType" SG_ 345 FrntSideRdrRiDetn121RdrDetnRngV 0;
BA_ "GenSigStartValue" SG_ 345 FrntSideRdrRiDetn121RdrDetnRngV 4000;
BA_ "GenSigSendType" SG_ 345 FrntSideRdrRiDetn121RdrDetnSts 0;
BA_ "GenSigStartValue" SG_ 345 FrntSideRdrRiDetn121RdrDetnSts 3;
BA_ "GenSigSendType" SG_ 345 FrntSideRdrRiDetn122RdrDetnAzi 0;
BA_ "GenSigStartValue" SG_ 345 FrntSideRdrRiDetn122RdrDetnAzi 900;
BA_ "GenSigDataID" SG_ 345 FrntSideRdrRiDetn122RdrDetnChks "0x95C";
BA_ "GenSigFuncType" SG_ 345 FrntSideRdrRiDetn122RdrDetnChks 15;
BA_ "GenSigSendType" SG_ 345 FrntSideRdrRiDetn122RdrDetnChks 0;
BA_ "GenSigFuncType" SG_ 345 FrntSideRdrRiDetn122RdrDetnCntr 16;
BA_ "GenSigSendType" SG_ 345 FrntSideRdrRiDetn122RdrDetnCntr 0;
BA_ "GenSigSendType" SG_ 345 FrntSideRdrRiDetn122RdrDetnConf 0;
BA_ "GenSigSendType" SG_ 345 FrntSideRdrRiDetn122RdrDetnElevn 0;
BA_ "GenSigStartValue" SG_ 345 FrntSideRdrRiDetn122RdrDetnElevn 15;
BA_ "GenSigSendType" SG_ 345 FrntSideRdrRiDetn122RdrDetnPwr 0;
BA_ "GenSigSendType" SG_ 345 FrntSideRdrRiDetn122RdrDetnRng 0;
BA_ "GenSigStartValue" SG_ 345 FrntSideRdrRiDetn122RdrDetnRng 10050;
BA_ "GenSigSendType" SG_ 345 FrntSideRdrRiDetn122RdrDetnRngV 0;
BA_ "GenSigStartValue" SG_ 345 FrntSideRdrRiDetn122RdrDetnRngV 4000;
BA_ "GenSigSendType" SG_ 345 FrntSideRdrRiDetn122RdrDetnSts 0;
BA_ "GenSigStartValue" SG_ 345 FrntSideRdrRiDetn122RdrDetnSts 3;
BA_ "GenSigSendType" SG_ 345 FrntSideRdrRiDetn123RdrDetnAzi 0;
BA_ "GenSigStartValue" SG_ 345 FrntSideRdrRiDetn123RdrDetnAzi 900;
BA_ "GenSigDataID" SG_ 345 FrntSideRdrRiDetn123RdrDetnChks "0x95D";
BA_ "GenSigFuncType" SG_ 345 FrntSideRdrRiDetn123RdrDetnChks 15;
BA_ "GenSigSendType" SG_ 345 FrntSideRdrRiDetn123RdrDetnChks 0;
BA_ "GenSigFuncType" SG_ 345 FrntSideRdrRiDetn123RdrDetnCntr 16;
BA_ "GenSigSendType" SG_ 345 FrntSideRdrRiDetn123RdrDetnCntr 0;
BA_ "GenSigSendType" SG_ 345 FrntSideRdrRiDetn123RdrDetnConf 0;
BA_ "GenSigSendType" SG_ 345 FrntSideRdrRiDetn123RdrDetnElevn 0;
BA_ "GenSigStartValue" SG_ 345 FrntSideRdrRiDetn123RdrDetnElevn 15;
BA_ "GenSigSendType" SG_ 345 FrntSideRdrRiDetn123RdrDetnPwr 0;
BA_ "GenSigSendType" SG_ 345 FrntSideRdrRiDetn123RdrDetnRng 0;
BA_ "GenSigStartValue" SG_ 345 FrntSideRdrRiDetn123RdrDetnRng 10050;
BA_ "GenSigSendType" SG_ 345 FrntSideRdrRiDetn123RdrDetnRngV 0;
BA_ "GenSigStartValue" SG_ 345 FrntSideRdrRiDetn123RdrDetnRngV 4000;
BA_ "GenSigSendType" SG_ 345 FrntSideRdrRiDetn123RdrDetnSts 0;
BA_ "GenSigStartValue" SG_ 345 FrntSideRdrRiDetn123RdrDetnSts 3;
BA_ "GenSigSendType" SG_ 345 FrntSideRdrRiDetn124RdrDetnAzi 0;
BA_ "GenSigStartValue" SG_ 345 FrntSideRdrRiDetn124RdrDetnAzi 900;
BA_ "GenSigDataID" SG_ 345 FrntSideRdrRiDetn124RdrDetnChks "0x95E";
BA_ "GenSigFuncType" SG_ 345 FrntSideRdrRiDetn124RdrDetnChks 15;
BA_ "GenSigSendType" SG_ 345 FrntSideRdrRiDetn124RdrDetnChks 0;
BA_ "GenSigFuncType" SG_ 345 FrntSideRdrRiDetn124RdrDetnCntr 16;
BA_ "GenSigSendType" SG_ 345 FrntSideRdrRiDetn124RdrDetnCntr 0;
BA_ "GenSigSendType" SG_ 345 FrntSideRdrRiDetn124RdrDetnConf 0;
BA_ "GenSigSendType" SG_ 345 FrntSideRdrRiDetn124RdrDetnElevn 0;
BA_ "GenSigStartValue" SG_ 345 FrntSideRdrRiDetn124RdrDetnElevn 15;
BA_ "GenSigSendType" SG_ 345 FrntSideRdrRiDetn124RdrDetnPwr 0;
BA_ "GenSigSendType" SG_ 345 FrntSideRdrRiDetn124RdrDetnRng 0;
BA_ "GenSigStartValue" SG_ 345 FrntSideRdrRiDetn124RdrDetnRng 10050;
BA_ "GenSigSendType" SG_ 345 FrntSideRdrRiDetn124RdrDetnRngV 0;
BA_ "GenSigStartValue" SG_ 345 FrntSideRdrRiDetn124RdrDetnRngV 4000;
BA_ "GenSigSendType" SG_ 345 FrntSideRdrRiDetn124RdrDetnSts 0;
BA_ "GenSigStartValue" SG_ 345 FrntSideRdrRiDetn124RdrDetnSts 3;
BA_ "GenSigSendType" SG_ 345 FrntSideRdrRiDetn125RdrDetnAzi 0;
BA_ "GenSigStartValue" SG_ 345 FrntSideRdrRiDetn125RdrDetnAzi 900;
BA_ "GenSigDataID" SG_ 345 FrntSideRdrRiDetn125RdrDetnChks "0x95F";
BA_ "GenSigFuncType" SG_ 345 FrntSideRdrRiDetn125RdrDetnChks 15;
BA_ "GenSigSendType" SG_ 345 FrntSideRdrRiDetn125RdrDetnChks 0;
BA_ "GenSigFuncType" SG_ 345 FrntSideRdrRiDetn125RdrDetnCntr 16;
BA_ "GenSigSendType" SG_ 345 FrntSideRdrRiDetn125RdrDetnCntr 0;
BA_ "GenSigSendType" SG_ 345 FrntSideRdrRiDetn125RdrDetnConf 0;
BA_ "GenSigSendType" SG_ 345 FrntSideRdrRiDetn125RdrDetnElevn 0;
BA_ "GenSigStartValue" SG_ 345 FrntSideRdrRiDetn125RdrDetnElevn 15;
BA_ "GenSigSendType" SG_ 345 FrntSideRdrRiDetn125RdrDetnPwr 0;
BA_ "GenSigSendType" SG_ 345 FrntSideRdrRiDetn125RdrDetnRng 0;
BA_ "GenSigStartValue" SG_ 345 FrntSideRdrRiDetn125RdrDetnRng 10050;
BA_ "GenSigSendType" SG_ 345 FrntSideRdrRiDetn125RdrDetnRngV 0;
BA_ "GenSigStartValue" SG_ 345 FrntSideRdrRiDetn125RdrDetnRngV 4000;
BA_ "GenSigSendType" SG_ 345 FrntSideRdrRiDetn125RdrDetnSts 0;
BA_ "GenSigStartValue" SG_ 345 FrntSideRdrRiDetn125RdrDetnSts 3;
BA_ "GenSigSendType" SG_ 345 FrntSideRdrRiDetn126RdrDetnAzi 0;
BA_ "GenSigStartValue" SG_ 345 FrntSideRdrRiDetn126RdrDetnAzi 900;
BA_ "GenSigDataID" SG_ 345 FrntSideRdrRiDetn126RdrDetnChks "0x960";
BA_ "GenSigFuncType" SG_ 345 FrntSideRdrRiDetn126RdrDetnChks 15;
BA_ "GenSigSendType" SG_ 345 FrntSideRdrRiDetn126RdrDetnChks 0;
BA_ "GenSigFuncType" SG_ 345 FrntSideRdrRiDetn126RdrDetnCntr 16;
BA_ "GenSigSendType" SG_ 345 FrntSideRdrRiDetn126RdrDetnCntr 0;
BA_ "GenSigSendType" SG_ 345 FrntSideRdrRiDetn126RdrDetnConf 0;
BA_ "GenSigSendType" SG_ 345 FrntSideRdrRiDetn126RdrDetnElevn 0;
BA_ "GenSigStartValue" SG_ 345 FrntSideRdrRiDetn126RdrDetnElevn 15;
BA_ "GenSigSendType" SG_ 345 FrntSideRdrRiDetn126RdrDetnPwr 0;
BA_ "GenSigSendType" SG_ 345 FrntSideRdrRiDetn126RdrDetnRng 0;
BA_ "GenSigStartValue" SG_ 345 FrntSideRdrRiDetn126RdrDetnRng 10050;
BA_ "GenSigSendType" SG_ 345 FrntSideRdrRiDetn126RdrDetnRngV 0;
BA_ "GenSigStartValue" SG_ 345 FrntSideRdrRiDetn126RdrDetnRngV 4000;
BA_ "GenSigSendType" SG_ 345 FrntSideRdrRiDetn126RdrDetnSts 0;
BA_ "GenSigStartValue" SG_ 345 FrntSideRdrRiDetn126RdrDetnSts 3;
BA_ "GenSigSendType" SG_ 347 FrntSideRdrRiDetn127RdrDetnAzi 0;
BA_ "GenSigStartValue" SG_ 347 FrntSideRdrRiDetn127RdrDetnAzi 900;
BA_ "GenSigDataID" SG_ 347 FrntSideRdrRiDetn127RdrDetnChks "0x961";
BA_ "GenSigFuncType" SG_ 347 FrntSideRdrRiDetn127RdrDetnChks 15;
BA_ "GenSigSendType" SG_ 347 FrntSideRdrRiDetn127RdrDetnChks 0;
BA_ "GenSigFuncType" SG_ 347 FrntSideRdrRiDetn127RdrDetnCntr 16;
BA_ "GenSigSendType" SG_ 347 FrntSideRdrRiDetn127RdrDetnCntr 0;
BA_ "GenSigSendType" SG_ 347 FrntSideRdrRiDetn127RdrDetnConf 0;
BA_ "GenSigSendType" SG_ 347 FrntSideRdrRiDetn127RdrDetnElevn 0;
BA_ "GenSigStartValue" SG_ 347 FrntSideRdrRiDetn127RdrDetnElevn 15;
BA_ "GenSigSendType" SG_ 347 FrntSideRdrRiDetn127RdrDetnPwr 0;
BA_ "GenSigSendType" SG_ 347 FrntSideRdrRiDetn127RdrDetnRng 0;
BA_ "GenSigStartValue" SG_ 347 FrntSideRdrRiDetn127RdrDetnRng 10050;
BA_ "GenSigSendType" SG_ 347 FrntSideRdrRiDetn127RdrDetnRngV 0;
BA_ "GenSigStartValue" SG_ 347 FrntSideRdrRiDetn127RdrDetnRngV 4000;
BA_ "GenSigSendType" SG_ 347 FrntSideRdrRiDetn127RdrDetnSts 0;
BA_ "GenSigStartValue" SG_ 347 FrntSideRdrRiDetn127RdrDetnSts 3;
BA_ "GenSigSendType" SG_ 347 FrntSideRdrRiDetn128RdrDetnAzi 0;
BA_ "GenSigStartValue" SG_ 347 FrntSideRdrRiDetn128RdrDetnAzi 900;
BA_ "GenSigDataID" SG_ 347 FrntSideRdrRiDetn128RdrDetnChks "0x962";
BA_ "GenSigFuncType" SG_ 347 FrntSideRdrRiDetn128RdrDetnChks 15;
BA_ "GenSigSendType" SG_ 347 FrntSideRdrRiDetn128RdrDetnChks 0;
BA_ "GenSigFuncType" SG_ 347 FrntSideRdrRiDetn128RdrDetnCntr 16;
BA_ "GenSigSendType" SG_ 347 FrntSideRdrRiDetn128RdrDetnCntr 0;
BA_ "GenSigSendType" SG_ 347 FrntSideRdrRiDetn128RdrDetnConf 0;
BA_ "GenSigSendType" SG_ 347 FrntSideRdrRiDetn128RdrDetnElevn 0;
BA_ "GenSigStartValue" SG_ 347 FrntSideRdrRiDetn128RdrDetnElevn 15;
BA_ "GenSigSendType" SG_ 347 FrntSideRdrRiDetn128RdrDetnPwr 0;
BA_ "GenSigSendType" SG_ 347 FrntSideRdrRiDetn128RdrDetnRng 0;
BA_ "GenSigStartValue" SG_ 347 FrntSideRdrRiDetn128RdrDetnRng 10050;
BA_ "GenSigSendType" SG_ 347 FrntSideRdrRiDetn128RdrDetnRngV 0;
BA_ "GenSigStartValue" SG_ 347 FrntSideRdrRiDetn128RdrDetnRngV 4000;
BA_ "GenSigSendType" SG_ 347 FrntSideRdrRiDetn128RdrDetnSts 0;
BA_ "GenSigStartValue" SG_ 347 FrntSideRdrRiDetn128RdrDetnSts 3;
BA_ "GenSigSendType" SG_ 337 FrntSideRdrRiDetn97RdrDetnAzi 0;
BA_ "GenSigStartValue" SG_ 337 FrntSideRdrRiDetn97RdrDetnAzi 900;
BA_ "GenSigDataID" SG_ 337 FrntSideRdrRiDetn97RdrDetnChks "0x943";
BA_ "GenSigFuncType" SG_ 337 FrntSideRdrRiDetn97RdrDetnChks 15;
BA_ "GenSigSendType" SG_ 337 FrntSideRdrRiDetn97RdrDetnChks 0;
BA_ "GenSigFuncType" SG_ 337 FrntSideRdrRiDetn97RdrDetnCntr 16;
BA_ "GenSigSendType" SG_ 337 FrntSideRdrRiDetn97RdrDetnCntr 0;
BA_ "GenSigSendType" SG_ 337 FrntSideRdrRiDetn97RdrDetnConf 0;
BA_ "GenSigSendType" SG_ 337 FrntSideRdrRiDetn97RdrDetnElevn 0;
BA_ "GenSigStartValue" SG_ 337 FrntSideRdrRiDetn97RdrDetnElevn 15;
BA_ "GenSigSendType" SG_ 337 FrntSideRdrRiDetn97RdrDetnPwr 0;
BA_ "GenSigSendType" SG_ 337 FrntSideRdrRiDetn97RdrDetnRng 0;
BA_ "GenSigStartValue" SG_ 337 FrntSideRdrRiDetn97RdrDetnRng 10050;
BA_ "GenSigSendType" SG_ 337 FrntSideRdrRiDetn97RdrDetnRngV 0;
BA_ "GenSigStartValue" SG_ 337 FrntSideRdrRiDetn97RdrDetnRngV 4000;
BA_ "GenSigSendType" SG_ 337 FrntSideRdrRiDetn97RdrDetnSts 0;
BA_ "GenSigStartValue" SG_ 337 FrntSideRdrRiDetn97RdrDetnSts 3;
BA_ "GenSigSendType" SG_ 337 FrntSideRdrRiDetn98RdrDetnAzi 0;
BA_ "GenSigStartValue" SG_ 337 FrntSideRdrRiDetn98RdrDetnAzi 900;
BA_ "GenSigDataID" SG_ 337 FrntSideRdrRiDetn98RdrDetnChks "0x944";
BA_ "GenSigFuncType" SG_ 337 FrntSideRdrRiDetn98RdrDetnChks 15;
BA_ "GenSigSendType" SG_ 337 FrntSideRdrRiDetn98RdrDetnChks 0;
BA_ "GenSigFuncType" SG_ 337 FrntSideRdrRiDetn98RdrDetnCntr 16;
BA_ "GenSigSendType" SG_ 337 FrntSideRdrRiDetn98RdrDetnCntr 0;
BA_ "GenSigSendType" SG_ 337 FrntSideRdrRiDetn98RdrDetnConf 0;
BA_ "GenSigSendType" SG_ 337 FrntSideRdrRiDetn98RdrDetnElevn 0;
BA_ "GenSigStartValue" SG_ 337 FrntSideRdrRiDetn98RdrDetnElevn 15;
BA_ "GenSigSendType" SG_ 337 FrntSideRdrRiDetn98RdrDetnPwr 0;
BA_ "GenSigSendType" SG_ 337 FrntSideRdrRiDetn98RdrDetnRng 0;
BA_ "GenSigStartValue" SG_ 337 FrntSideRdrRiDetn98RdrDetnRng 10050;
BA_ "GenSigSendType" SG_ 337 FrntSideRdrRiDetn98RdrDetnRngV 0;
BA_ "GenSigStartValue" SG_ 337 FrntSideRdrRiDetn98RdrDetnRngV 4000;
BA_ "GenSigSendType" SG_ 337 FrntSideRdrRiDetn98RdrDetnSts 0;
BA_ "GenSigStartValue" SG_ 337 FrntSideRdrRiDetn98RdrDetnSts 3;
BA_ "GenSigSendType" SG_ 337 FrntSideRdrRiDetn99RdrDetnAzi 0;
BA_ "GenSigStartValue" SG_ 337 FrntSideRdrRiDetn99RdrDetnAzi 900;
BA_ "GenSigDataID" SG_ 337 FrntSideRdrRiDetn99RdrDetnChks "0x945";
BA_ "GenSigFuncType" SG_ 337 FrntSideRdrRiDetn99RdrDetnChks 15;
BA_ "GenSigSendType" SG_ 337 FrntSideRdrRiDetn99RdrDetnChks 0;
BA_ "GenSigFuncType" SG_ 337 FrntSideRdrRiDetn99RdrDetnCntr 16;
BA_ "GenSigSendType" SG_ 337 FrntSideRdrRiDetn99RdrDetnCntr 0;
BA_ "GenSigSendType" SG_ 337 FrntSideRdrRiDetn99RdrDetnConf 0;
BA_ "GenSigSendType" SG_ 337 FrntSideRdrRiDetn99RdrDetnElevn 0;
BA_ "GenSigStartValue" SG_ 337 FrntSideRdrRiDetn99RdrDetnElevn 15;
BA_ "GenSigSendType" SG_ 337 FrntSideRdrRiDetn99RdrDetnPwr 0;
BA_ "GenSigSendType" SG_ 337 FrntSideRdrRiDetn99RdrDetnRng 0;
BA_ "GenSigStartValue" SG_ 337 FrntSideRdrRiDetn99RdrDetnRng 10050;
BA_ "GenSigSendType" SG_ 337 FrntSideRdrRiDetn99RdrDetnRngV 0;
BA_ "GenSigStartValue" SG_ 337 FrntSideRdrRiDetn99RdrDetnRngV 4000;
BA_ "GenSigSendType" SG_ 337 FrntSideRdrRiDetn99RdrDetnSts 0;
BA_ "GenSigStartValue" SG_ 337 FrntSideRdrRiDetn99RdrDetnSts 3;
BA_ "GenSigSendType" SG_ 349 FrntSideRdrRiObj1Heading 0;
BA_ "GenSigStartValue" SG_ 349 FrntSideRdrRiObj1Heading 1800;
BA_ "GenSigSendType" SG_ 349 FrntSideRdrRiObj1ObjBoxCenterLat 0;
BA_ "GenSigStartValue" SG_ 349 FrntSideRdrRiObj1ObjBoxCenterLat 250;
BA_ "GenSigSendType" SG_ 349 FrntSideRdrRiObj1ObjBoxCenterLgt 0;
BA_ "GenSigStartValue" SG_ 349 FrntSideRdrRiObj1ObjBoxCenterLgt 250;
BA_ "GenSigSendType" SG_ 349 FrntSideRdrRiObj1ObservationHist 0;
BA_ "GenSigSendType" SG_ 349 FrntSideRdrRiObj1QualityBits 0;
BA_ "GenSigSendType" SG_ 349 FrntSideRdrRiObj1RdrObjAx 0;
BA_ "GenSigSendType" SG_ 349 FrntSideRdrRiObj1RdrObjAy 0;
BA_ "GenSigSendType" SG_ 349 FrntSideRdrRiObj1RdrObjBoxLength 0;
BA_ "GenSigSendType" SG_ 349 FrntSideRdrRiObj1RdrObjBoxWidth 0;
BA_ "GenSigDataID" SG_ 349 FrntSideRdrRiObj1RdrObjChks "0x963";
BA_ "GenSigFuncType" SG_ 349 FrntSideRdrRiObj1RdrObjChks 15;
BA_ "GenSigSendType" SG_ 349 FrntSideRdrRiObj1RdrObjChks 0;
BA_ "GenSigFuncType" SG_ 349 FrntSideRdrRiObj1RdrObjCntr 16;
BA_ "GenSigSendType" SG_ 349 FrntSideRdrRiObj1RdrObjCntr 0;
BA_ "GenSigSendType" SG_ 349 FrntSideRdrRiObj1RdrObjCoastCnt 0;
BA_ "GenSigStartValue" SG_ 349 FrntSideRdrRiObj1RdrObjCoastCnt 31;
BA_ "GenSigSendType" SG_ 349 FrntSideRdrRiObj1RdrObjConf 0;
BA_ "GenSigSendType" SG_ 349 FrntSideRdrRiObj1RdrObjDx 0;
BA_ "GenSigSendType" SG_ 349 FrntSideRdrRiObj1RdrObjDxStdDe 0;
BA_ "GenSigSendType" SG_ 349 FrntSideRdrRiObj1RdrObjDy 0;
BA_ "GenSigStartValue" SG_ 349 FrntSideRdrRiObj1RdrObjDy 4000;
BA_ "GenSigSendType" SG_ 349 FrntSideRdrRiObj1RdrObjDyStdDe 0;
BA_ "GenSigSendType" SG_ 349 FrntSideRdrRiObj1RdrObjElevnConf 0;
BA_ "GenSigSendType" SG_ 349 FrntSideRdrRiObj1RdrObjElevnSts 0;
BA_ "GenSigSendType" SG_ 349 FrntSideRdrRiObj1RdrObjID 0;
BA_ "GenSigSendType" SG_ 349 FrntSideRdrRiObj1RdrObjIsInFreeSpace 0;
BA_ "GenSigStartValue" SG_ 349 FrntSideRdrRiObj1RdrObjIsInFreeSpace 1;
BA_ "GenSigSendType" SG_ 349 FrntSideRdrRiObj1RdrObjMirrProblty 0;
BA_ "GenSigSendType" SG_ 349 FrntSideRdrRiObj1RdrObjMtnPat 0;
BA_ "GenSigStartValue" SG_ 349 FrntSideRdrRiObj1RdrObjMtnPat 3;
BA_ "GenSigSendType" SG_ 349 FrntSideRdrRiObj1RdrObjNotRealProblty 0;
BA_ "GenSigSendType" SG_ 349 FrntSideRdrRiObj1RdrObjStatyCnt 0;
BA_ "GenSigSendType" SG_ 349 FrntSideRdrRiObj1RdrObjTiAlv 0;
BA_ "GenSigSendType" SG_ 349 FrntSideRdrRiObj1RdrObjTrackSts 0;
BA_ "GenSigSendType" SG_ 349 FrntSideRdrRiObj1RdrObjTyp 0;
BA_ "GenSigSendType" SG_ 349 FrntSideRdrRiObj1RdrObjTypConfBike 0;
BA_ "GenSigSendType" SG_ 349 FrntSideRdrRiObj1RdrObjTypConfPed 0;
BA_ "GenSigSendType" SG_ 349 FrntSideRdrRiObj1RdrObjTypConfVeh 0;
BA_ "GenSigSendType" SG_ 349 FrntSideRdrRiObj1RdrObjUsedTracker 0;
BA_ "GenSigStartValue" SG_ 349 FrntSideRdrRiObj1RdrObjUsedTracker 3;
BA_ "GenSigSendType" SG_ 349 FrntSideRdrRiObj1RdrObjVx 0;
BA_ "GenSigStartValue" SG_ 349 FrntSideRdrRiObj1RdrObjVx 6400;
BA_ "GenSigSendType" SG_ 349 FrntSideRdrRiObj1RdrObjVxStdDe 0;
BA_ "GenSigSendType" SG_ 349 FrntSideRdrRiObj1RdrObjVy 0;
BA_ "GenSigStartValue" SG_ 349 FrntSideRdrRiObj1RdrObjVy 6400;
BA_ "GenSigSendType" SG_ 349 FrntSideRdrRiObj1RdrObjVyStdDe 0;
BA_ "GenSigSendType" SG_ 349 FrntSideRdrRiObj1RelVx 0;
BA_ "GenSigStartValue" SG_ 349 FrntSideRdrRiObj1RelVx 1780;
BA_ "GenSigSendType" SG_ 349 FrntSideRdrRiObj1RelVy 0;
BA_ "GenSigStartValue" SG_ 349 FrntSideRdrRiObj1RelVy 1780;
BA_ "GenSigSendType" SG_ 351 FrntSideRdrRiObj2Heading 0;
BA_ "GenSigStartValue" SG_ 351 FrntSideRdrRiObj2Heading 1800;
BA_ "GenSigSendType" SG_ 351 FrntSideRdrRiObj2ObjBoxCenterLat 0;
BA_ "GenSigStartValue" SG_ 351 FrntSideRdrRiObj2ObjBoxCenterLat 250;
BA_ "GenSigSendType" SG_ 351 FrntSideRdrRiObj2ObjBoxCenterLgt 0;
BA_ "GenSigStartValue" SG_ 351 FrntSideRdrRiObj2ObjBoxCenterLgt 250;
BA_ "GenSigSendType" SG_ 351 FrntSideRdrRiObj2ObservationHist 0;
BA_ "GenSigSendType" SG_ 351 FrntSideRdrRiObj2QualityBits 0;
BA_ "GenSigSendType" SG_ 351 FrntSideRdrRiObj2RdrObjAx 0;
BA_ "GenSigSendType" SG_ 351 FrntSideRdrRiObj2RdrObjAy 0;
BA_ "GenSigSendType" SG_ 351 FrntSideRdrRiObj2RdrObjBoxLength 0;
BA_ "GenSigSendType" SG_ 351 FrntSideRdrRiObj2RdrObjBoxWidth 0;
BA_ "GenSigDataID" SG_ 351 FrntSideRdrRiObj2RdrObjChks "0x964";
BA_ "GenSigFuncType" SG_ 351 FrntSideRdrRiObj2RdrObjChks 15;
BA_ "GenSigSendType" SG_ 351 FrntSideRdrRiObj2RdrObjChks 0;
BA_ "GenSigFuncType" SG_ 351 FrntSideRdrRiObj2RdrObjCntr 16;
BA_ "GenSigSendType" SG_ 351 FrntSideRdrRiObj2RdrObjCntr 0;
BA_ "GenSigSendType" SG_ 351 FrntSideRdrRiObj2RdrObjCoastCnt 0;
BA_ "GenSigStartValue" SG_ 351 FrntSideRdrRiObj2RdrObjCoastCnt 31;
BA_ "GenSigSendType" SG_ 351 FrntSideRdrRiObj2RdrObjConf 0;
BA_ "GenSigSendType" SG_ 351 FrntSideRdrRiObj2RdrObjDx 0;
BA_ "GenSigSendType" SG_ 351 FrntSideRdrRiObj2RdrObjDxStdDe 0;
BA_ "GenSigSendType" SG_ 351 FrntSideRdrRiObj2RdrObjDy 0;
BA_ "GenSigStartValue" SG_ 351 FrntSideRdrRiObj2RdrObjDy 4000;
BA_ "GenSigSendType" SG_ 351 FrntSideRdrRiObj2RdrObjDyStdDe 0;
BA_ "GenSigSendType" SG_ 351 FrntSideRdrRiObj2RdrObjElevnConf 0;
BA_ "GenSigSendType" SG_ 351 FrntSideRdrRiObj2RdrObjElevnSts 0;
BA_ "GenSigSendType" SG_ 351 FrntSideRdrRiObj2RdrObjID 0;
BA_ "GenSigSendType" SG_ 351 FrntSideRdrRiObj2RdrObjIsInFreeSpace 0;
BA_ "GenSigStartValue" SG_ 351 FrntSideRdrRiObj2RdrObjIsInFreeSpace 1;
BA_ "GenSigSendType" SG_ 351 FrntSideRdrRiObj2RdrObjMirrProblty 0;
BA_ "GenSigSendType" SG_ 351 FrntSideRdrRiObj2RdrObjMtnPat 0;
BA_ "GenSigStartValue" SG_ 351 FrntSideRdrRiObj2RdrObjMtnPat 3;
BA_ "GenSigSendType" SG_ 351 FrntSideRdrRiObj2RdrObjNotRealProblty 0;
BA_ "GenSigSendType" SG_ 351 FrntSideRdrRiObj2RdrObjStatyCnt 0;
BA_ "GenSigSendType" SG_ 351 FrntSideRdrRiObj2RdrObjTiAlv 0;
BA_ "GenSigSendType" SG_ 351 FrntSideRdrRiObj2RdrObjTrackSts 0;
BA_ "GenSigSendType" SG_ 351 FrntSideRdrRiObj2RdrObjTyp 0;
BA_ "GenSigSendType" SG_ 351 FrntSideRdrRiObj2RdrObjTypConfBike 0;
BA_ "GenSigSendType" SG_ 351 FrntSideRdrRiObj2RdrObjTypConfPed 0;
BA_ "GenSigSendType" SG_ 351 FrntSideRdrRiObj2RdrObjTypConfVeh 0;
BA_ "GenSigSendType" SG_ 351 FrntSideRdrRiObj2RdrObjUsedTracker 0;
BA_ "GenSigStartValue" SG_ 351 FrntSideRdrRiObj2RdrObjUsedTracker 3;
BA_ "GenSigSendType" SG_ 351 FrntSideRdrRiObj2RdrObjVx 0;
BA_ "GenSigStartValue" SG_ 351 FrntSideRdrRiObj2RdrObjVx 6400;
BA_ "GenSigSendType" SG_ 351 FrntSideRdrRiObj2RdrObjVxStdDe 0;
BA_ "GenSigSendType" SG_ 351 FrntSideRdrRiObj2RdrObjVy 0;
BA_ "GenSigStartValue" SG_ 351 FrntSideRdrRiObj2RdrObjVy 6400;
BA_ "GenSigSendType" SG_ 351 FrntSideRdrRiObj2RdrObjVyStdDe 0;
BA_ "GenSigSendType" SG_ 351 FrntSideRdrRiObj2RelVx 0;
BA_ "GenSigStartValue" SG_ 351 FrntSideRdrRiObj2RelVx 1780;
BA_ "GenSigSendType" SG_ 351 FrntSideRdrRiObj2RelVy 0;
BA_ "GenSigStartValue" SG_ 351 FrntSideRdrRiObj2RelVy 1780;
BA_ "GenSigSendType" SG_ 353 FrntSideRdrRiObj3Heading 0;
BA_ "GenSigStartValue" SG_ 353 FrntSideRdrRiObj3Heading 1800;
BA_ "GenSigSendType" SG_ 353 FrntSideRdrRiObj3ObjBoxCenterLat 0;
BA_ "GenSigStartValue" SG_ 353 FrntSideRdrRiObj3ObjBoxCenterLat 250;
BA_ "GenSigSendType" SG_ 353 FrntSideRdrRiObj3ObjBoxCenterLgt 0;
BA_ "GenSigStartValue" SG_ 353 FrntSideRdrRiObj3ObjBoxCenterLgt 250;
BA_ "GenSigSendType" SG_ 353 FrntSideRdrRiObj3ObservationHist 0;
BA_ "GenSigSendType" SG_ 353 FrntSideRdrRiObj3QualityBits 0;
BA_ "GenSigSendType" SG_ 353 FrntSideRdrRiObj3RdrObjAx 0;
BA_ "GenSigSendType" SG_ 353 FrntSideRdrRiObj3RdrObjAy 0;
BA_ "GenSigSendType" SG_ 353 FrntSideRdrRiObj3RdrObjBoxLength 0;
BA_ "GenSigSendType" SG_ 353 FrntSideRdrRiObj3RdrObjBoxWidth 0;
BA_ "GenSigDataID" SG_ 353 FrntSideRdrRiObj3RdrObjChks "0x965";
BA_ "GenSigFuncType" SG_ 353 FrntSideRdrRiObj3RdrObjChks 15;
BA_ "GenSigSendType" SG_ 353 FrntSideRdrRiObj3RdrObjChks 0;
BA_ "GenSigFuncType" SG_ 353 FrntSideRdrRiObj3RdrObjCntr 16;
BA_ "GenSigSendType" SG_ 353 FrntSideRdrRiObj3RdrObjCntr 0;
BA_ "GenSigSendType" SG_ 353 FrntSideRdrRiObj3RdrObjCoastCnt 0;
BA_ "GenSigStartValue" SG_ 353 FrntSideRdrRiObj3RdrObjCoastCnt 31;
BA_ "GenSigSendType" SG_ 353 FrntSideRdrRiObj3RdrObjConf 0;
BA_ "GenSigSendType" SG_ 353 FrntSideRdrRiObj3RdrObjDx 0;
BA_ "GenSigSendType" SG_ 353 FrntSideRdrRiObj3RdrObjDxStdDe 0;
BA_ "GenSigSendType" SG_ 353 FrntSideRdrRiObj3RdrObjDy 0;
BA_ "GenSigStartValue" SG_ 353 FrntSideRdrRiObj3RdrObjDy 4000;
BA_ "GenSigSendType" SG_ 353 FrntSideRdrRiObj3RdrObjDyStdDe 0;
BA_ "GenSigSendType" SG_ 353 FrntSideRdrRiObj3RdrObjElevnConf 0;
BA_ "GenSigSendType" SG_ 353 FrntSideRdrRiObj3RdrObjElevnSts 0;
BA_ "GenSigSendType" SG_ 353 FrntSideRdrRiObj3RdrObjID 0;
BA_ "GenSigSendType" SG_ 353 FrntSideRdrRiObj3RdrObjIsInFreeSpace 0;
BA_ "GenSigStartValue" SG_ 353 FrntSideRdrRiObj3RdrObjIsInFreeSpace 1;
BA_ "GenSigSendType" SG_ 353 FrntSideRdrRiObj3RdrObjMirrProblty 0;
BA_ "GenSigSendType" SG_ 353 FrntSideRdrRiObj3RdrObjMtnPat 0;
BA_ "GenSigStartValue" SG_ 353 FrntSideRdrRiObj3RdrObjMtnPat 3;
BA_ "GenSigSendType" SG_ 353 FrntSideRdrRiObj3RdrObjNotRealProblty 0;
BA_ "GenSigSendType" SG_ 353 FrntSideRdrRiObj3RdrObjStatyCnt 0;
BA_ "GenSigSendType" SG_ 353 FrntSideRdrRiObj3RdrObjTiAlv 0;
BA_ "GenSigSendType" SG_ 353 FrntSideRdrRiObj3RdrObjTrackSts 0;
BA_ "GenSigSendType" SG_ 353 FrntSideRdrRiObj3RdrObjTyp 0;
BA_ "GenSigSendType" SG_ 353 FrntSideRdrRiObj3RdrObjTypConfBike 0;
BA_ "GenSigSendType" SG_ 353 FrntSideRdrRiObj3RdrObjTypConfPed 0;
BA_ "GenSigSendType" SG_ 353 FrntSideRdrRiObj3RdrObjTypConfVeh 0;
BA_ "GenSigSendType" SG_ 353 FrntSideRdrRiObj3RdrObjUsedTracker 0;
BA_ "GenSigStartValue" SG_ 353 FrntSideRdrRiObj3RdrObjUsedTracker 3;
BA_ "GenSigSendType" SG_ 353 FrntSideRdrRiObj3RdrObjVx 0;
BA_ "GenSigStartValue" SG_ 353 FrntSideRdrRiObj3RdrObjVx 6400;
BA_ "GenSigSendType" SG_ 353 FrntSideRdrRiObj3RdrObjVxStdDe 0;
BA_ "GenSigSendType" SG_ 353 FrntSideRdrRiObj3RdrObjVy 0;
BA_ "GenSigStartValue" SG_ 353 FrntSideRdrRiObj3RdrObjVy 6400;
BA_ "GenSigSendType" SG_ 353 FrntSideRdrRiObj3RdrObjVyStdDe 0;
BA_ "GenSigSendType" SG_ 353 FrntSideRdrRiObj3RelVx 0;
BA_ "GenSigStartValue" SG_ 353 FrntSideRdrRiObj3RelVx 1780;
BA_ "GenSigSendType" SG_ 353 FrntSideRdrRiObj3RelVy 0;
BA_ "GenSigStartValue" SG_ 353 FrntSideRdrRiObj3RelVy 1780;
BA_ "GenSigSendType" SG_ 355 FrntSideRdrRiObj4Heading 0;
BA_ "GenSigStartValue" SG_ 355 FrntSideRdrRiObj4Heading 1800;
BA_ "GenSigSendType" SG_ 355 FrntSideRdrRiObj4ObjBoxCenterLat 0;
BA_ "GenSigStartValue" SG_ 355 FrntSideRdrRiObj4ObjBoxCenterLat 250;
BA_ "GenSigSendType" SG_ 355 FrntSideRdrRiObj4ObjBoxCenterLgt 0;
BA_ "GenSigStartValue" SG_ 355 FrntSideRdrRiObj4ObjBoxCenterLgt 250;
BA_ "GenSigSendType" SG_ 355 FrntSideRdrRiObj4ObservationHist 0;
BA_ "GenSigSendType" SG_ 355 FrntSideRdrRiObj4QualityBits 0;
BA_ "GenSigSendType" SG_ 355 FrntSideRdrRiObj4RdrObjAx 0;
BA_ "GenSigSendType" SG_ 355 FrntSideRdrRiObj4RdrObjAy 0;
BA_ "GenSigSendType" SG_ 355 FrntSideRdrRiObj4RdrObjBoxLength 0;
BA_ "GenSigSendType" SG_ 355 FrntSideRdrRiObj4RdrObjBoxWidth 0;
BA_ "GenSigDataID" SG_ 355 FrntSideRdrRiObj4RdrObjChks "0x966";
BA_ "GenSigFuncType" SG_ 355 FrntSideRdrRiObj4RdrObjChks 15;
BA_ "GenSigSendType" SG_ 355 FrntSideRdrRiObj4RdrObjChks 0;
BA_ "GenSigFuncType" SG_ 355 FrntSideRdrRiObj4RdrObjCntr 16;
BA_ "GenSigSendType" SG_ 355 FrntSideRdrRiObj4RdrObjCntr 0;
BA_ "GenSigSendType" SG_ 355 FrntSideRdrRiObj4RdrObjCoastCnt 0;
BA_ "GenSigStartValue" SG_ 355 FrntSideRdrRiObj4RdrObjCoastCnt 31;
BA_ "GenSigSendType" SG_ 355 FrntSideRdrRiObj4RdrObjConf 0;
BA_ "GenSigSendType" SG_ 355 FrntSideRdrRiObj4RdrObjDx 0;
BA_ "GenSigSendType" SG_ 355 FrntSideRdrRiObj4RdrObjDxStdDe 0;
BA_ "GenSigSendType" SG_ 355 FrntSideRdrRiObj4RdrObjDy 0;
BA_ "GenSigStartValue" SG_ 355 FrntSideRdrRiObj4RdrObjDy 4000;
BA_ "GenSigSendType" SG_ 355 FrntSideRdrRiObj4RdrObjDyStdDe 0;
BA_ "GenSigSendType" SG_ 355 FrntSideRdrRiObj4RdrObjElevnConf 0;
BA_ "GenSigSendType" SG_ 355 FrntSideRdrRiObj4RdrObjElevnSts 0;
BA_ "GenSigSendType" SG_ 355 FrntSideRdrRiObj4RdrObjID 0;
BA_ "GenSigSendType" SG_ 355 FrntSideRdrRiObj4RdrObjIsInFreeSpace 0;
BA_ "GenSigStartValue" SG_ 355 FrntSideRdrRiObj4RdrObjIsInFreeSpace 1;
BA_ "GenSigSendType" SG_ 355 FrntSideRdrRiObj4RdrObjMirrProblty 0;
BA_ "GenSigSendType" SG_ 355 FrntSideRdrRiObj4RdrObjMtnPat 0;
BA_ "GenSigStartValue" SG_ 355 FrntSideRdrRiObj4RdrObjMtnPat 3;
BA_ "GenSigSendType" SG_ 355 FrntSideRdrRiObj4RdrObjNotRealProblty 0;
BA_ "GenSigSendType" SG_ 355 FrntSideRdrRiObj4RdrObjStatyCnt 0;
BA_ "GenSigSendType" SG_ 355 FrntSideRdrRiObj4RdrObjTiAlv 0;
BA_ "GenSigSendType" SG_ 355 FrntSideRdrRiObj4RdrObjTrackSts 0;
BA_ "GenSigSendType" SG_ 355 FrntSideRdrRiObj4RdrObjTyp 0;
BA_ "GenSigSendType" SG_ 355 FrntSideRdrRiObj4RdrObjTypConfBike 0;
BA_ "GenSigSendType" SG_ 355 FrntSideRdrRiObj4RdrObjTypConfPed 0;
BA_ "GenSigSendType" SG_ 355 FrntSideRdrRiObj4RdrObjTypConfVeh 0;
BA_ "GenSigSendType" SG_ 355 FrntSideRdrRiObj4RdrObjUsedTracker 0;
BA_ "GenSigStartValue" SG_ 355 FrntSideRdrRiObj4RdrObjUsedTracker 3;
BA_ "GenSigSendType" SG_ 355 FrntSideRdrRiObj4RdrObjVx 0;
BA_ "GenSigStartValue" SG_ 355 FrntSideRdrRiObj4RdrObjVx 6400;
BA_ "GenSigSendType" SG_ 355 FrntSideRdrRiObj4RdrObjVxStdDe 0;
BA_ "GenSigSendType" SG_ 355 FrntSideRdrRiObj4RdrObjVy 0;
BA_ "GenSigStartValue" SG_ 355 FrntSideRdrRiObj4RdrObjVy 6400;
BA_ "GenSigSendType" SG_ 355 FrntSideRdrRiObj4RdrObjVyStdDe 0;
BA_ "GenSigSendType" SG_ 355 FrntSideRdrRiObj4RelVx 0;
BA_ "GenSigStartValue" SG_ 355 FrntSideRdrRiObj4RelVx 1780;
BA_ "GenSigSendType" SG_ 355 FrntSideRdrRiObj4RelVy 0;
BA_ "GenSigStartValue" SG_ 355 FrntSideRdrRiObj4RelVy 1780;
BA_ "GenSigSendType" SG_ 357 FrntSideRdrRiObj5Heading 0;
BA_ "GenSigStartValue" SG_ 357 FrntSideRdrRiObj5Heading 1800;
BA_ "GenSigSendType" SG_ 357 FrntSideRdrRiObj5ObjBoxCenterLat 0;
BA_ "GenSigStartValue" SG_ 357 FrntSideRdrRiObj5ObjBoxCenterLat 250;
BA_ "GenSigSendType" SG_ 357 FrntSideRdrRiObj5ObjBoxCenterLgt 0;
BA_ "GenSigStartValue" SG_ 357 FrntSideRdrRiObj5ObjBoxCenterLgt 250;
BA_ "GenSigSendType" SG_ 357 FrntSideRdrRiObj5ObservationHist 0;
BA_ "GenSigSendType" SG_ 357 FrntSideRdrRiObj5QualityBits 0;
BA_ "GenSigSendType" SG_ 357 FrntSideRdrRiObj5RdrObjAx 0;
BA_ "GenSigSendType" SG_ 357 FrntSideRdrRiObj5RdrObjAy 0;
BA_ "GenSigSendType" SG_ 357 FrntSideRdrRiObj5RdrObjBoxLength 0;
BA_ "GenSigSendType" SG_ 357 FrntSideRdrRiObj5RdrObjBoxWidth 0;
BA_ "GenSigDataID" SG_ 357 FrntSideRdrRiObj5RdrObjChks "0x967";
BA_ "GenSigFuncType" SG_ 357 FrntSideRdrRiObj5RdrObjChks 15;
BA_ "GenSigSendType" SG_ 357 FrntSideRdrRiObj5RdrObjChks 0;
BA_ "GenSigFuncType" SG_ 357 FrntSideRdrRiObj5RdrObjCntr 16;
BA_ "GenSigSendType" SG_ 357 FrntSideRdrRiObj5RdrObjCntr 0;
BA_ "GenSigSendType" SG_ 357 FrntSideRdrRiObj5RdrObjCoastCnt 0;
BA_ "GenSigStartValue" SG_ 357 FrntSideRdrRiObj5RdrObjCoastCnt 31;
BA_ "GenSigSendType" SG_ 357 FrntSideRdrRiObj5RdrObjConf 0;
BA_ "GenSigSendType" SG_ 357 FrntSideRdrRiObj5RdrObjDx 0;
BA_ "GenSigSendType" SG_ 357 FrntSideRdrRiObj5RdrObjDxStdDe 0;
BA_ "GenSigSendType" SG_ 357 FrntSideRdrRiObj5RdrObjDy 0;
BA_ "GenSigStartValue" SG_ 357 FrntSideRdrRiObj5RdrObjDy 4000;
BA_ "GenSigSendType" SG_ 357 FrntSideRdrRiObj5RdrObjDyStdDe 0;
BA_ "GenSigSendType" SG_ 357 FrntSideRdrRiObj5RdrObjElevnConf 0;
BA_ "GenSigSendType" SG_ 357 FrntSideRdrRiObj5RdrObjElevnSts 0;
BA_ "GenSigSendType" SG_ 357 FrntSideRdrRiObj5RdrObjID 0;
BA_ "GenSigSendType" SG_ 357 FrntSideRdrRiObj5RdrObjIsInFreeSpace 0;
BA_ "GenSigStartValue" SG_ 357 FrntSideRdrRiObj5RdrObjIsInFreeSpace 1;
BA_ "GenSigSendType" SG_ 357 FrntSideRdrRiObj5RdrObjMirrProblty 0;
BA_ "GenSigSendType" SG_ 357 FrntSideRdrRiObj5RdrObjMtnPat 0;
BA_ "GenSigStartValue" SG_ 357 FrntSideRdrRiObj5RdrObjMtnPat 3;
BA_ "GenSigSendType" SG_ 357 FrntSideRdrRiObj5RdrObjNotRealProblty 0;
BA_ "GenSigSendType" SG_ 357 FrntSideRdrRiObj5RdrObjStatyCnt 0;
BA_ "GenSigSendType" SG_ 357 FrntSideRdrRiObj5RdrObjTiAlv 0;
BA_ "GenSigSendType" SG_ 357 FrntSideRdrRiObj5RdrObjTrackSts 0;
BA_ "GenSigSendType" SG_ 357 FrntSideRdrRiObj5RdrObjTyp 0;
BA_ "GenSigSendType" SG_ 357 FrntSideRdrRiObj5RdrObjTypConfBike 0;
BA_ "GenSigSendType" SG_ 357 FrntSideRdrRiObj5RdrObjTypConfPed 0;
BA_ "GenSigSendType" SG_ 357 FrntSideRdrRiObj5RdrObjTypConfVeh 0;
BA_ "GenSigSendType" SG_ 357 FrntSideRdrRiObj5RdrObjUsedTracker 0;
BA_ "GenSigStartValue" SG_ 357 FrntSideRdrRiObj5RdrObjUsedTracker 3;
BA_ "GenSigSendType" SG_ 357 FrntSideRdrRiObj5RdrObjVx 0;
BA_ "GenSigStartValue" SG_ 357 FrntSideRdrRiObj5RdrObjVx 6400;
BA_ "GenSigSendType" SG_ 357 FrntSideRdrRiObj5RdrObjVxStdDe 0;
BA_ "GenSigSendType" SG_ 357 FrntSideRdrRiObj5RdrObjVy 0;
BA_ "GenSigStartValue" SG_ 357 FrntSideRdrRiObj5RdrObjVy 6400;
BA_ "GenSigSendType" SG_ 357 FrntSideRdrRiObj5RdrObjVyStdDe 0;
BA_ "GenSigSendType" SG_ 357 FrntSideRdrRiObj5RelVx 0;
BA_ "GenSigStartValue" SG_ 357 FrntSideRdrRiObj5RelVx 1780;
BA_ "GenSigSendType" SG_ 357 FrntSideRdrRiObj5RelVy 0;
BA_ "GenSigStartValue" SG_ 357 FrntSideRdrRiObj5RelVy 1780;
VAL_ 337 FrntSideRdrRiDetn100RdrDetnSts 0 "RdrDetnSts_Ukwn" 1 "RdrDetnSts_Movg" 2 "RdrDetnSts_Staty" 3 "RdrDetnSts_Invalid";
VAL_ 337 FrntSideRdrRiDetn101RdrDetnSts 0 "RdrDetnSts_Ukwn" 1 "RdrDetnSts_Movg" 2 "RdrDetnSts_Staty" 3 "RdrDetnSts_Invalid";
VAL_ 337 FrntSideRdrRiDetn102RdrDetnSts 0 "RdrDetnSts_Ukwn" 1 "RdrDetnSts_Movg" 2 "RdrDetnSts_Staty" 3 "RdrDetnSts_Invalid";
VAL_ 337 FrntSideRdrRiDetn97RdrDetnSts 0 "RdrDetnSts_Ukwn" 1 "RdrDetnSts_Movg" 2 "RdrDetnSts_Staty" 3 "RdrDetnSts_Invalid";
VAL_ 337 FrntSideRdrRiDetn98RdrDetnSts 0 "RdrDetnSts_Ukwn" 1 "RdrDetnSts_Movg" 2 "RdrDetnSts_Staty" 3 "RdrDetnSts_Invalid";
VAL_ 337 FrntSideRdrRiDetn99RdrDetnSts 0 "RdrDetnSts_Ukwn" 1 "RdrDetnSts_Movg" 2 "RdrDetnSts_Staty" 3 "RdrDetnSts_Invalid";
VAL_ 339 FrntSideRdrRiDetn103RdrDetnSts 0 "RdrDetnSts_Ukwn" 1 "RdrDetnSts_Movg" 2 "RdrDetnSts_Staty" 3 "RdrDetnSts_Invalid";
VAL_ 339 FrntSideRdrRiDetn104RdrDetnSts 0 "RdrDetnSts_Ukwn" 1 "RdrDetnSts_Movg" 2 "RdrDetnSts_Staty" 3 "RdrDetnSts_Invalid";
VAL_ 339 FrntSideRdrRiDetn105RdrDetnSts 0 "RdrDetnSts_Ukwn" 1 "RdrDetnSts_Movg" 2 "RdrDetnSts_Staty" 3 "RdrDetnSts_Invalid";
VAL_ 339 FrntSideRdrRiDetn106RdrDetnSts 0 "RdrDetnSts_Ukwn" 1 "RdrDetnSts_Movg" 2 "RdrDetnSts_Staty" 3 "RdrDetnSts_Invalid";
VAL_ 339 FrntSideRdrRiDetn107RdrDetnSts 0 "RdrDetnSts_Ukwn" 1 "RdrDetnSts_Movg" 2 "RdrDetnSts_Staty" 3 "RdrDetnSts_Invalid";
VAL_ 339 FrntSideRdrRiDetn108RdrDetnSts 0 "RdrDetnSts_Ukwn" 1 "RdrDetnSts_Movg" 2 "RdrDetnSts_Staty" 3 "RdrDetnSts_Invalid";
VAL_ 341 FrntSideRdrRiDetn109RdrDetnSts 0 "RdrDetnSts_Ukwn" 1 "RdrDetnSts_Movg" 2 "RdrDetnSts_Staty" 3 "RdrDetnSts_Invalid";
VAL_ 341 FrntSideRdrRiDetn110RdrDetnSts 0 "RdrDetnSts_Ukwn" 1 "RdrDetnSts_Movg" 2 "RdrDetnSts_Staty" 3 "RdrDetnSts_Invalid";
VAL_ 341 FrntSideRdrRiDetn111RdrDetnSts 0 "RdrDetnSts_Ukwn" 1 "RdrDetnSts_Movg" 2 "RdrDetnSts_Staty" 3 "RdrDetnSts_Invalid";
VAL_ 341 FrntSideRdrRiDetn112RdrDetnSts 0 "RdrDetnSts_Ukwn" 1 "RdrDetnSts_Movg" 2 "RdrDetnSts_Staty" 3 "RdrDetnSts_Invalid";
VAL_ 341 FrntSideRdrRiDetn113RdrDetnSts 0 "RdrDetnSts_Ukwn" 1 "RdrDetnSts_Movg" 2 "RdrDetnSts_Staty" 3 "RdrDetnSts_Invalid";
VAL_ 341 FrntSideRdrRiDetn114RdrDetnSts 0 "RdrDetnSts_Ukwn" 1 "RdrDetnSts_Movg" 2 "RdrDetnSts_Staty" 3 "RdrDetnSts_Invalid";
VAL_ 343 FrntSideRdrRiDetn115RdrDetnSts 0 "RdrDetnSts_Ukwn" 1 "RdrDetnSts_Movg" 2 "RdrDetnSts_Staty" 3 "RdrDetnSts_Invalid";
VAL_ 343 FrntSideRdrRiDetn116RdrDetnSts 0 "RdrDetnSts_Ukwn" 1 "RdrDetnSts_Movg" 2 "RdrDetnSts_Staty" 3 "RdrDetnSts_Invalid";
VAL_ 343 FrntSideRdrRiDetn117RdrDetnSts 0 "RdrDetnSts_Ukwn" 1 "RdrDetnSts_Movg" 2 "RdrDetnSts_Staty" 3 "RdrDetnSts_Invalid";
VAL_ 343 FrntSideRdrRiDetn118RdrDetnSts 0 "RdrDetnSts_Ukwn" 1 "RdrDetnSts_Movg" 2 "RdrDetnSts_Staty" 3 "RdrDetnSts_Invalid";
VAL_ 343 FrntSideRdrRiDetn119RdrDetnSts 0 "RdrDetnSts_Ukwn" 1 "RdrDetnSts_Movg" 2 "RdrDetnSts_Staty" 3 "RdrDetnSts_Invalid";
VAL_ 343 FrntSideRdrRiDetn120RdrDetnSts 0 "RdrDetnSts_Ukwn" 1 "RdrDetnSts_Movg" 2 "RdrDetnSts_Staty" 3 "RdrDetnSts_Invalid";
VAL_ 345 FrntSideRdrRiDetn121RdrDetnSts 0 "RdrDetnSts_Ukwn" 1 "RdrDetnSts_Movg" 2 "RdrDetnSts_Staty" 3 "RdrDetnSts_Invalid";
VAL_ 345 FrntSideRdrRiDetn122RdrDetnSts 0 "RdrDetnSts_Ukwn" 1 "RdrDetnSts_Movg" 2 "RdrDetnSts_Staty" 3 "RdrDetnSts_Invalid";
VAL_ 345 FrntSideRdrRiDetn123RdrDetnSts 0 "RdrDetnSts_Ukwn" 1 "RdrDetnSts_Movg" 2 "RdrDetnSts_Staty" 3 "RdrDetnSts_Invalid";
VAL_ 345 FrntSideRdrRiDetn124RdrDetnSts 0 "RdrDetnSts_Ukwn" 1 "RdrDetnSts_Movg" 2 "RdrDetnSts_Staty" 3 "RdrDetnSts_Invalid";
VAL_ 345 FrntSideRdrRiDetn125RdrDetnSts 0 "RdrDetnSts_Ukwn" 1 "RdrDetnSts_Movg" 2 "RdrDetnSts_Staty" 3 "RdrDetnSts_Invalid";
VAL_ 345 FrntSideRdrRiDetn126RdrDetnSts 0 "RdrDetnSts_Ukwn" 1 "RdrDetnSts_Movg" 2 "RdrDetnSts_Staty" 3 "RdrDetnSts_Invalid";
VAL_ 347 FrntSideRdrRiDetn127RdrDetnSts 0 "RdrDetnSts_Ukwn" 1 "RdrDetnSts_Movg" 2 "RdrDetnSts_Staty" 3 "RdrDetnSts_Invalid";
VAL_ 347 FrntSideRdrRiDetn128RdrDetnSts 0 "RdrDetnSts_Ukwn" 1 "RdrDetnSts_Movg" 2 "RdrDetnSts_Staty" 3 "RdrDetnSts_Invalid";
VAL_ 349 FrntSideRdrRiObj1RdrObjElevnSts 0 "RdrObjElevnSts_Unknown" 1 "RdrObjElevnSts_OverRidable" 2 "RdrObjElevnSts_Rlv" 3 "RdrObjElevnSts_UnderRidable";
VAL_ 349 FrntSideRdrRiObj1RdrObjIsInFreeSpace 0 "YesNo2_No" 1 "YesNo2_Yes";
VAL_ 349 FrntSideRdrRiObj1RdrObjMtnPat 0 "RdrObjMtnPat_Ukwn" 1 "RdrObjMtnPat_Staty" 2 "RdrObjMtnPat_StatyFromMovg" 3 "RdrObjMtnPat_Movg" 4 "RdrObjMtnPat_Receding" 5 "RdrObjMtnPat_Oncoming" 6 "RdrObjMtnPat_CrossingFromLe" 7 "RdrObjMtnPat_CrossingFromRi";
VAL_ 349 FrntSideRdrRiObj1RdrObjTrackSts 0 "RdrObjTrackSts_Invld" 1 "RdrObjTrackSts_Updated" 2 "RdrObjTrackSts_New" 3 "RdrObjTrackSts_Coasted";
VAL_ 349 FrntSideRdrRiObj1RdrObjTyp 0 "RdrObjTyp_Ukwn" 1 "RdrObjTyp_Car" 2 "RdrObjTyp_MotorCycle" 3 "RdrObjTyp_Truck" 4 "RdrObjTyp_Ped" 5 "RdrObjTyp_ObstdVert1" 6 "RdrObjTyp_ObstdVert2" 7 "RdrObjTyp_Anim" 8 "RdrObjTyp_ObjGen" 9 "RdrObjTyp_Bicycle" 10 "RdrObjTyp_VehofUkwnClass" 11 "RdrObjTyp_Reserved";
VAL_ 349 FrntSideRdrRiObj1RdrObjUsedTracker 0 "RdrObjUsedTracker_Stationary" 1 "RdrObjUsedTracker_MovingCVModel" 2 "RdrObjUsedTracker_MovingCTModel" 3 "RdrObjUsedTracker_Undefined";
VAL_ 351 FrntSideRdrRiObj2RdrObjElevnSts 0 "RdrObjElevnSts_Unknown" 1 "RdrObjElevnSts_OverRidable" 2 "RdrObjElevnSts_Rlv" 3 "RdrObjElevnSts_UnderRidable";
VAL_ 351 FrntSideRdrRiObj2RdrObjIsInFreeSpace 0 "YesNo2_No" 1 "YesNo2_Yes";
VAL_ 351 FrntSideRdrRiObj2RdrObjMtnPat 0 "RdrObjMtnPat_Ukwn" 1 "RdrObjMtnPat_Staty" 2 "RdrObjMtnPat_StatyFromMovg" 3 "RdrObjMtnPat_Movg" 4 "RdrObjMtnPat_Receding" 5 "RdrObjMtnPat_Oncoming" 6 "RdrObjMtnPat_CrossingFromLe" 7 "RdrObjMtnPat_CrossingFromRi";
VAL_ 351 FrntSideRdrRiObj2RdrObjTrackSts 0 "RdrObjTrackSts_Invld" 1 "RdrObjTrackSts_Updated" 2 "RdrObjTrackSts_New" 3 "RdrObjTrackSts_Coasted";
VAL_ 351 FrntSideRdrRiObj2RdrObjTyp 0 "RdrObjTyp_Ukwn" 1 "RdrObjTyp_Car" 2 "RdrObjTyp_MotorCycle" 3 "RdrObjTyp_Truck" 4 "RdrObjTyp_Ped" 5 "RdrObjTyp_ObstdVert1" 6 "RdrObjTyp_ObstdVert2" 7 "RdrObjTyp_Anim" 8 "RdrObjTyp_ObjGen" 9 "RdrObjTyp_Bicycle" 10 "RdrObjTyp_VehofUkwnClass" 11 "RdrObjTyp_Reserved";
VAL_ 351 FrntSideRdrRiObj2RdrObjUsedTracker 0 "RdrObjUsedTracker_Stationary" 1 "RdrObjUsedTracker_MovingCVModel" 2 "RdrObjUsedTracker_MovingCTModel" 3 "RdrObjUsedTracker_Undefined";
VAL_ 353 FrntSideRdrRiObj3RdrObjElevnSts 0 "RdrObjElevnSts_Unknown" 1 "RdrObjElevnSts_OverRidable" 2 "RdrObjElevnSts_Rlv" 3 "RdrObjElevnSts_UnderRidable";
VAL_ 353 FrntSideRdrRiObj3RdrObjIsInFreeSpace 0 "YesNo2_No" 1 "YesNo2_Yes";
VAL_ 353 FrntSideRdrRiObj3RdrObjMtnPat 0 "RdrObjMtnPat_Ukwn" 1 "RdrObjMtnPat_Staty" 2 "RdrObjMtnPat_StatyFromMovg" 3 "RdrObjMtnPat_Movg" 4 "RdrObjMtnPat_Receding" 5 "RdrObjMtnPat_Oncoming" 6 "RdrObjMtnPat_CrossingFromLe" 7 "RdrObjMtnPat_CrossingFromRi";
VAL_ 353 FrntSideRdrRiObj3RdrObjTrackSts 0 "RdrObjTrackSts_Invld" 1 "RdrObjTrackSts_Updated" 2 "RdrObjTrackSts_New" 3 "RdrObjTrackSts_Coasted";
VAL_ 353 FrntSideRdrRiObj3RdrObjTyp 0 "RdrObjTyp_Ukwn" 1 "RdrObjTyp_Car" 2 "RdrObjTyp_MotorCycle" 3 "RdrObjTyp_Truck" 4 "RdrObjTyp_Ped" 5 "RdrObjTyp_ObstdVert1" 6 "RdrObjTyp_ObstdVert2" 7 "RdrObjTyp_Anim" 8 "RdrObjTyp_ObjGen" 9 "RdrObjTyp_Bicycle" 10 "RdrObjTyp_VehofUkwnClass" 11 "RdrObjTyp_Reserved";
VAL_ 353 FrntSideRdrRiObj3RdrObjUsedTracker 0 "RdrObjUsedTracker_Stationary" 1 "RdrObjUsedTracker_MovingCVModel" 2 "RdrObjUsedTracker_MovingCTModel" 3 "RdrObjUsedTracker_Undefined";
VAL_ 355 FrntSideRdrRiObj4RdrObjElevnSts 0 "RdrObjElevnSts_Unknown" 1 "RdrObjElevnSts_OverRidable" 2 "RdrObjElevnSts_Rlv" 3 "RdrObjElevnSts_UnderRidable";
VAL_ 355 FrntSideRdrRiObj4RdrObjIsInFreeSpace 0 "YesNo2_No" 1 "YesNo2_Yes";
VAL_ 355 FrntSideRdrRiObj4RdrObjMtnPat 0 "RdrObjMtnPat_Ukwn" 1 "RdrObjMtnPat_Staty" 2 "RdrObjMtnPat_StatyFromMovg" 3 "RdrObjMtnPat_Movg" 4 "RdrObjMtnPat_Receding" 5 "RdrObjMtnPat_Oncoming" 6 "RdrObjMtnPat_CrossingFromLe" 7 "RdrObjMtnPat_CrossingFromRi";
VAL_ 355 FrntSideRdrRiObj4RdrObjTrackSts 0 "RdrObjTrackSts_Invld" 1 "RdrObjTrackSts_Updated" 2 "RdrObjTrackSts_New" 3 "RdrObjTrackSts_Coasted";
VAL_ 355 FrntSideRdrRiObj4RdrObjTyp 0 "RdrObjTyp_Ukwn" 1 "RdrObjTyp_Car" 2 "RdrObjTyp_MotorCycle" 3 "RdrObjTyp_Truck" 4 "RdrObjTyp_Ped" 5 "RdrObjTyp_ObstdVert1" 6 "RdrObjTyp_ObstdVert2" 7 "RdrObjTyp_Anim" 8 "RdrObjTyp_ObjGen" 9 "RdrObjTyp_Bicycle" 10 "RdrObjTyp_VehofUkwnClass" 11 "RdrObjTyp_Reserved";
VAL_ 355 FrntSideRdrRiObj4RdrObjUsedTracker 0 "RdrObjUsedTracker_Stationary" 1 "RdrObjUsedTracker_MovingCVModel" 2 "RdrObjUsedTracker_MovingCTModel" 3 "RdrObjUsedTracker_Undefined";
VAL_ 357 FrntSideRdrRiObj5RdrObjElevnSts 0 "RdrObjElevnSts_Unknown" 1 "RdrObjElevnSts_OverRidable" 2 "RdrObjElevnSts_Rlv" 3 "RdrObjElevnSts_UnderRidable";
VAL_ 357 FrntSideRdrRiObj5RdrObjIsInFreeSpace 0 "YesNo2_No" 1 "YesNo2_Yes";
VAL_ 357 FrntSideRdrRiObj5RdrObjMtnPat 0 "RdrObjMtnPat_Ukwn" 1 "RdrObjMtnPat_Staty" 2 "RdrObjMtnPat_StatyFromMovg" 3 "RdrObjMtnPat_Movg" 4 "RdrObjMtnPat_Receding" 5 "RdrObjMtnPat_Oncoming" 6 "RdrObjMtnPat_CrossingFromLe" 7 "RdrObjMtnPat_CrossingFromRi";
VAL_ 357 FrntSideRdrRiObj5RdrObjTrackSts 0 "RdrObjTrackSts_Invld" 1 "RdrObjTrackSts_Updated" 2 "RdrObjTrackSts_New" 3 "RdrObjTrackSts_Coasted";
VAL_ 357 FrntSideRdrRiObj5RdrObjTyp 0 "RdrObjTyp_Ukwn" 1 "RdrObjTyp_Car" 2 "RdrObjTyp_MotorCycle" 3 "RdrObjTyp_Truck" 4 "RdrObjTyp_Ped" 5 "RdrObjTyp_ObstdVert1" 6 "RdrObjTyp_ObstdVert2" 7 "RdrObjTyp_Anim" 8 "RdrObjTyp_ObjGen" 9 "RdrObjTyp_Bicycle" 10 "RdrObjTyp_VehofUkwnClass" 11 "RdrObjTyp_Reserved";
VAL_ 357 FrntSideRdrRiObj5RdrObjUsedTracker 0 "RdrObjUsedTracker_Stationary" 1 "RdrObjUsedTracker_MovingCVModel" 2 "RdrObjUsedTracker_MovingCTModel" 3 "RdrObjUsedTracker_Undefined";
SIG_GROUP_ 337 FrntSideRdrRiDetn100 1 : FrntSideRdrRiDetn100RdrDetnAzi FrntSideRdrRiDetn100RdrDetnChks FrntSideRdrRiDetn100RdrDetnCntr FrntSideRdrRiDetn100RdrDetnConf FrntSideRdrRiDetn100RdrDetnElevn FrntSideRdrRiDetn100RdrDetnPwr FrntSideRdrRiDetn100RdrDetnRng FrntSideRdrRiDetn100RdrDetnRngV FrntSideRdrRiDetn100RdrDetnSts;
SIG_GROUP_ 337 FrntSideRdrRiDetn101 1 : FrntSideRdrRiDetn101RdrDetnAzi FrntSideRdrRiDetn101RdrDetnChks FrntSideRdrRiDetn101RdrDetnCntr FrntSideRdrRiDetn101RdrDetnConf FrntSideRdrRiDetn101RdrDetnElevn FrntSideRdrRiDetn101RdrDetnPwr FrntSideRdrRiDetn101RdrDetnRng FrntSideRdrRiDetn101RdrDetnRngV FrntSideRdrRiDetn101RdrDetnSts;
SIG_GROUP_ 337 FrntSideRdrRiDetn102 1 : FrntSideRdrRiDetn102RdrDetnAzi FrntSideRdrRiDetn102RdrDetnChks FrntSideRdrRiDetn102RdrDetnCntr FrntSideRdrRiDetn102RdrDetnConf FrntSideRdrRiDetn102RdrDetnElevn FrntSideRdrRiDetn102RdrDetnPwr FrntSideRdrRiDetn102RdrDetnRng FrntSideRdrRiDetn102RdrDetnRngV FrntSideRdrRiDetn102RdrDetnSts;
SIG_GROUP_ 339 FrntSideRdrRiDetn103 1 : FrntSideRdrRiDetn103RdrDetnAzi FrntSideRdrRiDetn103RdrDetnChks FrntSideRdrRiDetn103RdrDetnCntr FrntSideRdrRiDetn103RdrDetnConf FrntSideRdrRiDetn103RdrDetnElevn FrntSideRdrRiDetn103RdrDetnPwr FrntSideRdrRiDetn103RdrDetnRng FrntSideRdrRiDetn103RdrDetnRngV FrntSideRdrRiDetn103RdrDetnSts;
SIG_GROUP_ 339 FrntSideRdrRiDetn104 1 : FrntSideRdrRiDetn104RdrDetnAzi FrntSideRdrRiDetn104RdrDetnChks FrntSideRdrRiDetn104RdrDetnCntr FrntSideRdrRiDetn104RdrDetnConf FrntSideRdrRiDetn104RdrDetnElevn FrntSideRdrRiDetn104RdrDetnPwr FrntSideRdrRiDetn104RdrDetnRng FrntSideRdrRiDetn104RdrDetnRngV FrntSideRdrRiDetn104RdrDetnSts;
SIG_GROUP_ 339 FrntSideRdrRiDetn105 1 : FrntSideRdrRiDetn105RdrDetnAzi FrntSideRdrRiDetn105RdrDetnChks FrntSideRdrRiDetn105RdrDetnCntr FrntSideRdrRiDetn105RdrDetnConf FrntSideRdrRiDetn105RdrDetnElevn FrntSideRdrRiDetn105RdrDetnPwr FrntSideRdrRiDetn105RdrDetnRng FrntSideRdrRiDetn105RdrDetnRngV FrntSideRdrRiDetn105RdrDetnSts;
SIG_GROUP_ 339 FrntSideRdrRiDetn106 1 : FrntSideRdrRiDetn106RdrDetnAzi FrntSideRdrRiDetn106RdrDetnChks FrntSideRdrRiDetn106RdrDetnCntr FrntSideRdrRiDetn106RdrDetnConf FrntSideRdrRiDetn106RdrDetnElevn FrntSideRdrRiDetn106RdrDetnPwr FrntSideRdrRiDetn106RdrDetnRng FrntSideRdrRiDetn106RdrDetnRngV FrntSideRdrRiDetn106RdrDetnSts;
SIG_GROUP_ 339 FrntSideRdrRiDetn107 1 : FrntSideRdrRiDetn107RdrDetnAzi FrntSideRdrRiDetn107RdrDetnChks FrntSideRdrRiDetn107RdrDetnCntr FrntSideRdrRiDetn107RdrDetnConf FrntSideRdrRiDetn107RdrDetnElevn FrntSideRdrRiDetn107RdrDetnPwr FrntSideRdrRiDetn107RdrDetnRng FrntSideRdrRiDetn107RdrDetnRngV FrntSideRdrRiDetn107RdrDetnSts;
SIG_GROUP_ 339 FrntSideRdrRiDetn108 1 : FrntSideRdrRiDetn108RdrDetnAzi FrntSideRdrRiDetn108RdrDetnChks FrntSideRdrRiDetn108RdrDetnCntr FrntSideRdrRiDetn108RdrDetnConf FrntSideRdrRiDetn108RdrDetnElevn FrntSideRdrRiDetn108RdrDetnPwr FrntSideRdrRiDetn108RdrDetnRng FrntSideRdrRiDetn108RdrDetnRngV FrntSideRdrRiDetn108RdrDetnSts;
SIG_GROUP_ 341 FrntSideRdrRiDetn109 1 : FrntSideRdrRiDetn109RdrDetnAzi FrntSideRdrRiDetn109RdrDetnChks FrntSideRdrRiDetn109RdrDetnCntr FrntSideRdrRiDetn109RdrDetnConf FrntSideRdrRiDetn109RdrDetnElevn FrntSideRdrRiDetn109RdrDetnPwr FrntSideRdrRiDetn109RdrDetnRng FrntSideRdrRiDetn109RdrDetnRngV FrntSideRdrRiDetn109RdrDetnSts;
SIG_GROUP_ 341 FrntSideRdrRiDetn110 1 : FrntSideRdrRiDetn110RdrDetnAzi FrntSideRdrRiDetn110RdrDetnChks FrntSideRdrRiDetn110RdrDetnCntr FrntSideRdrRiDetn110RdrDetnConf FrntSideRdrRiDetn110RdrDetnElevn FrntSideRdrRiDetn110RdrDetnPwr FrntSideRdrRiDetn110RdrDetnRng FrntSideRdrRiDetn110RdrDetnRngV FrntSideRdrRiDetn110RdrDetnSts;
SIG_GROUP_ 341 FrntSideRdrRiDetn111 1 : FrntSideRdrRiDetn111RdrDetnAzi FrntSideRdrRiDetn111RdrDetnChks FrntSideRdrRiDetn111RdrDetnCntr FrntSideRdrRiDetn111RdrDetnConf FrntSideRdrRiDetn111RdrDetnElevn FrntSideRdrRiDetn111RdrDetnPwr FrntSideRdrRiDetn111RdrDetnRng FrntSideRdrRiDetn111RdrDetnRngV FrntSideRdrRiDetn111RdrDetnSts;
SIG_GROUP_ 341 FrntSideRdrRiDetn112 1 : FrntSideRdrRiDetn112RdrDetnAzi FrntSideRdrRiDetn112RdrDetnChks FrntSideRdrRiDetn112RdrDetnCntr FrntSideRdrRiDetn112RdrDetnConf FrntSideRdrRiDetn112RdrDetnElevn FrntSideRdrRiDetn112RdrDetnPwr FrntSideRdrRiDetn112RdrDetnRng FrntSideRdrRiDetn112RdrDetnRngV FrntSideRdrRiDetn112RdrDetnSts;
SIG_GROUP_ 341 FrntSideRdrRiDetn113 1 : FrntSideRdrRiDetn113RdrDetnAzi FrntSideRdrRiDetn113RdrDetnChks FrntSideRdrRiDetn113RdrDetnCntr FrntSideRdrRiDetn113RdrDetnConf FrntSideRdrRiDetn113RdrDetnElevn FrntSideRdrRiDetn113RdrDetnPwr FrntSideRdrRiDetn113RdrDetnRng FrntSideRdrRiDetn113RdrDetnRngV FrntSideRdrRiDetn113RdrDetnSts;
SIG_GROUP_ 341 FrntSideRdrRiDetn114 1 : FrntSideRdrRiDetn114RdrDetnAzi FrntSideRdrRiDetn114RdrDetnChks FrntSideRdrRiDetn114RdrDetnCntr FrntSideRdrRiDetn114RdrDetnConf FrntSideRdrRiDetn114RdrDetnElevn FrntSideRdrRiDetn114RdrDetnPwr FrntSideRdrRiDetn114RdrDetnRng FrntSideRdrRiDetn114RdrDetnRngV FrntSideRdrRiDetn114RdrDetnSts;
SIG_GROUP_ 343 FrntSideRdrRiDetn115 1 : FrntSideRdrRiDetn115RdrDetnAzi FrntSideRdrRiDetn115RdrDetnChks FrntSideRdrRiDetn115RdrDetnCntr FrntSideRdrRiDetn115RdrDetnConf FrntSideRdrRiDetn115RdrDetnElevn FrntSideRdrRiDetn115RdrDetnPwr FrntSideRdrRiDetn115RdrDetnRng FrntSideRdrRiDetn115RdrDetnRngV FrntSideRdrRiDetn115RdrDetnSts;
SIG_GROUP_ 343 FrntSideRdrRiDetn116 1 : FrntSideRdrRiDetn116RdrDetnAzi FrntSideRdrRiDetn116RdrDetnChks FrntSideRdrRiDetn116RdrDetnCntr FrntSideRdrRiDetn116RdrDetnConf FrntSideRdrRiDetn116RdrDetnElevn FrntSideRdrRiDetn116RdrDetnPwr FrntSideRdrRiDetn116RdrDetnRng FrntSideRdrRiDetn116RdrDetnRngV FrntSideRdrRiDetn116RdrDetnSts;
SIG_GROUP_ 343 FrntSideRdrRiDetn117 1 : FrntSideRdrRiDetn117RdrDetnAzi FrntSideRdrRiDetn117RdrDetnChks FrntSideRdrRiDetn117RdrDetnCntr FrntSideRdrRiDetn117RdrDetnConf FrntSideRdrRiDetn117RdrDetnElevn FrntSideRdrRiDetn117RdrDetnPwr FrntSideRdrRiDetn117RdrDetnRng FrntSideRdrRiDetn117RdrDetnRngV FrntSideRdrRiDetn117RdrDetnSts;
SIG_GROUP_ 343 FrntSideRdrRiDetn118 1 : FrntSideRdrRiDetn118RdrDetnAzi FrntSideRdrRiDetn118RdrDetnChks FrntSideRdrRiDetn118RdrDetnCntr FrntSideRdrRiDetn118RdrDetnConf FrntSideRdrRiDetn118RdrDetnElevn FrntSideRdrRiDetn118RdrDetnPwr FrntSideRdrRiDetn118RdrDetnRng FrntSideRdrRiDetn118RdrDetnRngV FrntSideRdrRiDetn118RdrDetnSts;
SIG_GROUP_ 343 FrntSideRdrRiDetn119 1 : FrntSideRdrRiDetn119RdrDetnAzi FrntSideRdrRiDetn119RdrDetnChks FrntSideRdrRiDetn119RdrDetnCntr FrntSideRdrRiDetn119RdrDetnConf FrntSideRdrRiDetn119RdrDetnElevn FrntSideRdrRiDetn119RdrDetnPwr FrntSideRdrRiDetn119RdrDetnRng FrntSideRdrRiDetn119RdrDetnRngV FrntSideRdrRiDetn119RdrDetnSts;
SIG_GROUP_ 343 FrntSideRdrRiDetn120 1 : FrntSideRdrRiDetn120RdrDetnAzi FrntSideRdrRiDetn120RdrDetnChks FrntSideRdrRiDetn120RdrDetnCntr FrntSideRdrRiDetn120RdrDetnConf FrntSideRdrRiDetn120RdrDetnElevn FrntSideRdrRiDetn120RdrDetnPwr FrntSideRdrRiDetn120RdrDetnRng FrntSideRdrRiDetn120RdrDetnRngV FrntSideRdrRiDetn120RdrDetnSts;
SIG_GROUP_ 345 FrntSideRdrRiDetn121 1 : FrntSideRdrRiDetn121RdrDetnAzi FrntSideRdrRiDetn121RdrDetnChks FrntSideRdrRiDetn121RdrDetnCntr FrntSideRdrRiDetn121RdrDetnConf FrntSideRdrRiDetn121RdrDetnElevn FrntSideRdrRiDetn121RdrDetnPwr FrntSideRdrRiDetn121RdrDetnRng FrntSideRdrRiDetn121RdrDetnRngV FrntSideRdrRiDetn121RdrDetnSts;
SIG_GROUP_ 345 FrntSideRdrRiDetn122 1 : FrntSideRdrRiDetn122RdrDetnAzi FrntSideRdrRiDetn122RdrDetnChks FrntSideRdrRiDetn122RdrDetnCntr FrntSideRdrRiDetn122RdrDetnConf FrntSideRdrRiDetn122RdrDetnElevn FrntSideRdrRiDetn122RdrDetnPwr FrntSideRdrRiDetn122RdrDetnRng FrntSideRdrRiDetn122RdrDetnRngV FrntSideRdrRiDetn122RdrDetnSts;
SIG_GROUP_ 345 FrntSideRdrRiDetn123 1 : FrntSideRdrRiDetn123RdrDetnAzi FrntSideRdrRiDetn123RdrDetnChks FrntSideRdrRiDetn123RdrDetnCntr FrntSideRdrRiDetn123RdrDetnConf FrntSideRdrRiDetn123RdrDetnElevn FrntSideRdrRiDetn123RdrDetnPwr FrntSideRdrRiDetn123RdrDetnRng FrntSideRdrRiDetn123RdrDetnRngV FrntSideRdrRiDetn123RdrDetnSts;
SIG_GROUP_ 345 FrntSideRdrRiDetn124 1 : FrntSideRdrRiDetn124RdrDetnAzi FrntSideRdrRiDetn124RdrDetnChks FrntSideRdrRiDetn124RdrDetnCntr FrntSideRdrRiDetn124RdrDetnConf FrntSideRdrRiDetn124RdrDetnElevn FrntSideRdrRiDetn124RdrDetnPwr FrntSideRdrRiDetn124RdrDetnRng FrntSideRdrRiDetn124RdrDetnRngV FrntSideRdrRiDetn124RdrDetnSts;
SIG_GROUP_ 345 FrntSideRdrRiDetn125 1 : FrntSideRdrRiDetn125RdrDetnAzi FrntSideRdrRiDetn125RdrDetnChks FrntSideRdrRiDetn125RdrDetnCntr FrntSideRdrRiDetn125RdrDetnConf FrntSideRdrRiDetn125RdrDetnElevn FrntSideRdrRiDetn125RdrDetnPwr FrntSideRdrRiDetn125RdrDetnRng FrntSideRdrRiDetn125RdrDetnRngV FrntSideRdrRiDetn125RdrDetnSts;
SIG_GROUP_ 345 FrntSideRdrRiDetn126 1 : FrntSideRdrRiDetn126RdrDetnAzi FrntSideRdrRiDetn126RdrDetnChks FrntSideRdrRiDetn126RdrDetnCntr FrntSideRdrRiDetn126RdrDetnConf FrntSideRdrRiDetn126RdrDetnElevn FrntSideRdrRiDetn126RdrDetnPwr FrntSideRdrRiDetn126RdrDetnRng FrntSideRdrRiDetn126RdrDetnRngV FrntSideRdrRiDetn126RdrDetnSts;
SIG_GROUP_ 347 FrntSideRdrRiDetn127 1 : FrntSideRdrRiDetn127RdrDetnAzi FrntSideRdrRiDetn127RdrDetnChks FrntSideRdrRiDetn127RdrDetnCntr FrntSideRdrRiDetn127RdrDetnConf FrntSideRdrRiDetn127RdrDetnElevn FrntSideRdrRiDetn127RdrDetnPwr FrntSideRdrRiDetn127RdrDetnRng FrntSideRdrRiDetn127RdrDetnRngV FrntSideRdrRiDetn127RdrDetnSts;
SIG_GROUP_ 347 FrntSideRdrRiDetn128 1 : FrntSideRdrRiDetn128RdrDetnAzi FrntSideRdrRiDetn128RdrDetnChks FrntSideRdrRiDetn128RdrDetnCntr FrntSideRdrRiDetn128RdrDetnConf FrntSideRdrRiDetn128RdrDetnElevn FrntSideRdrRiDetn128RdrDetnPwr FrntSideRdrRiDetn128RdrDetnRng FrntSideRdrRiDetn128RdrDetnRngV FrntSideRdrRiDetn128RdrDetnSts;
SIG_GROUP_ 337 FrntSideRdrRiDetn97 1 : FrntSideRdrRiDetn97RdrDetnAzi FrntSideRdrRiDetn97RdrDetnChks FrntSideRdrRiDetn97RdrDetnCntr FrntSideRdrRiDetn97RdrDetnConf FrntSideRdrRiDetn97RdrDetnElevn FrntSideRdrRiDetn97RdrDetnPwr FrntSideRdrRiDetn97RdrDetnRng FrntSideRdrRiDetn97RdrDetnRngV FrntSideRdrRiDetn97RdrDetnSts;
SIG_GROUP_ 337 FrntSideRdrRiDetn98 1 : FrntSideRdrRiDetn98RdrDetnAzi FrntSideRdrRiDetn98RdrDetnChks FrntSideRdrRiDetn98RdrDetnCntr FrntSideRdrRiDetn98RdrDetnConf FrntSideRdrRiDetn98RdrDetnElevn FrntSideRdrRiDetn98RdrDetnPwr FrntSideRdrRiDetn98RdrDetnRng FrntSideRdrRiDetn98RdrDetnRngV FrntSideRdrRiDetn98RdrDetnSts;
SIG_GROUP_ 337 FrntSideRdrRiDetn99 1 : FrntSideRdrRiDetn99RdrDetnAzi FrntSideRdrRiDetn99RdrDetnChks FrntSideRdrRiDetn99RdrDetnCntr FrntSideRdrRiDetn99RdrDetnConf FrntSideRdrRiDetn99RdrDetnElevn FrntSideRdrRiDetn99RdrDetnPwr FrntSideRdrRiDetn99RdrDetnRng FrntSideRdrRiDetn99RdrDetnRngV FrntSideRdrRiDetn99RdrDetnSts;
SIG_GROUP_ 349 FrntSideRdrRiObj1 1 : FrntSideRdrRiObj1Heading FrntSideRdrRiObj1ObjBoxCenterLat FrntSideRdrRiObj1ObjBoxCenterLgt FrntSideRdrRiObj1ObservationHist FrntSideRdrRiObj1QualityBits FrntSideRdrRiObj1RdrObjAx FrntSideRdrRiObj1RdrObjAy FrntSideRdrRiObj1RdrObjBoxLength FrntSideRdrRiObj1RdrObjBoxWidth FrntSideRdrRiObj1RdrObjChks FrntSideRdrRiObj1RdrObjCntr FrntSideRdrRiObj1RdrObjCoastCnt FrntSideRdrRiObj1RdrObjConf FrntSideRdrRiObj1RdrObjDx FrntSideRdrRiObj1RdrObjDxStdDe FrntSideRdrRiObj1RdrObjDy FrntSideRdrRiObj1RdrObjDyStdDe FrntSideRdrRiObj1RdrObjElevnConf FrntSideRdrRiObj1RdrObjElevnSts FrntSideRdrRiObj1RdrObjID FrntSideRdrRiObj1RdrObjIsInFreeSpace FrntSideRdrRiObj1RdrObjMirrProblty FrntSideRdrRiObj1RdrObjMtnPat FrntSideRdrRiObj1RdrObjNotRealProblty FrntSideRdrRiObj1RdrObjStatyCnt FrntSideRdrRiObj1RdrObjTiAlv FrntSideRdrRiObj1RdrObjTrackSts FrntSideRdrRiObj1RdrObjTyp FrntSideRdrRiObj1RdrObjTypConfBike FrntSideRdrRiObj1RdrObjTypConfPed FrntSideRdrRiObj1RdrObjTypConfVeh FrntSideRdrRiObj1RdrObjUsedTracker FrntSideRdrRiObj1RdrObjVx FrntSideRdrRiObj1RdrObjVxStdDe FrntSideRdrRiObj1RdrObjVy FrntSideRdrRiObj1RdrObjVyStdDe FrntSideRdrRiObj1RelVx FrntSideRdrRiObj1RelVy;
SIG_GROUP_ 351 FrntSideRdrRiObj2 1 : FrntSideRdrRiObj2Heading FrntSideRdrRiObj2ObjBoxCenterLat FrntSideRdrRiObj2ObjBoxCenterLgt FrntSideRdrRiObj2ObservationHist FrntSideRdrRiObj2QualityBits FrntSideRdrRiObj2RdrObjAx FrntSideRdrRiObj2RdrObjAy FrntSideRdrRiObj2RdrObjBoxLength FrntSideRdrRiObj2RdrObjBoxWidth FrntSideRdrRiObj2RdrObjChks FrntSideRdrRiObj2RdrObjCntr FrntSideRdrRiObj2RdrObjCoastCnt FrntSideRdrRiObj2RdrObjConf FrntSideRdrRiObj2RdrObjDx FrntSideRdrRiObj2RdrObjDxStdDe FrntSideRdrRiObj2RdrObjDy FrntSideRdrRiObj2RdrObjDyStdDe FrntSideRdrRiObj2RdrObjElevnConf FrntSideRdrRiObj2RdrObjElevnSts FrntSideRdrRiObj2RdrObjID FrntSideRdrRiObj2RdrObjIsInFreeSpace FrntSideRdrRiObj2RdrObjMirrProblty FrntSideRdrRiObj2RdrObjMtnPat FrntSideRdrRiObj2RdrObjNotRealProblty FrntSideRdrRiObj2RdrObjStatyCnt FrntSideRdrRiObj2RdrObjTiAlv FrntSideRdrRiObj2RdrObjTrackSts FrntSideRdrRiObj2RdrObjTyp FrntSideRdrRiObj2RdrObjTypConfBike FrntSideRdrRiObj2RdrObjTypConfPed FrntSideRdrRiObj2RdrObjTypConfVeh FrntSideRdrRiObj2RdrObjUsedTracker FrntSideRdrRiObj2RdrObjVx FrntSideRdrRiObj2RdrObjVxStdDe FrntSideRdrRiObj2RdrObjVy FrntSideRdrRiObj2RdrObjVyStdDe FrntSideRdrRiObj2RelVx FrntSideRdrRiObj2RelVy;
SIG_GROUP_ 353 FrntSideRdrRiObj3 1 : FrntSideRdrRiObj3Heading FrntSideRdrRiObj3ObjBoxCenterLat FrntSideRdrRiObj3ObjBoxCenterLgt FrntSideRdrRiObj3ObservationHist FrntSideRdrRiObj3QualityBits FrntSideRdrRiObj3RdrObjAx FrntSideRdrRiObj3RdrObjAy FrntSideRdrRiObj3RdrObjBoxLength FrntSideRdrRiObj3RdrObjBoxWidth FrntSideRdrRiObj3RdrObjChks FrntSideRdrRiObj3RdrObjCntr FrntSideRdrRiObj3RdrObjCoastCnt FrntSideRdrRiObj3RdrObjConf FrntSideRdrRiObj3RdrObjDx FrntSideRdrRiObj3RdrObjDxStdDe FrntSideRdrRiObj3RdrObjDy FrntSideRdrRiObj3RdrObjDyStdDe FrntSideRdrRiObj3RdrObjElevnConf FrntSideRdrRiObj3RdrObjElevnSts FrntSideRdrRiObj3RdrObjID FrntSideRdrRiObj3RdrObjIsInFreeSpace FrntSideRdrRiObj3RdrObjMirrProblty FrntSideRdrRiObj3RdrObjMtnPat FrntSideRdrRiObj3RdrObjNotRealProblty FrntSideRdrRiObj3RdrObjStatyCnt FrntSideRdrRiObj3RdrObjTiAlv FrntSideRdrRiObj3RdrObjTrackSts FrntSideRdrRiObj3RdrObjTyp FrntSideRdrRiObj3RdrObjTypConfBike FrntSideRdrRiObj3RdrObjTypConfPed FrntSideRdrRiObj3RdrObjTypConfVeh FrntSideRdrRiObj3RdrObjUsedTracker FrntSideRdrRiObj3RdrObjVx FrntSideRdrRiObj3RdrObjVxStdDe FrntSideRdrRiObj3RdrObjVy FrntSideRdrRiObj3RdrObjVyStdDe FrntSideRdrRiObj3RelVx FrntSideRdrRiObj3RelVy;
SIG_GROUP_ 355 FrntSideRdrRiObj4 1 : FrntSideRdrRiObj4Heading FrntSideRdrRiObj4ObjBoxCenterLat FrntSideRdrRiObj4ObjBoxCenterLgt FrntSideRdrRiObj4ObservationHist FrntSideRdrRiObj4QualityBits FrntSideRdrRiObj4RdrObjAx FrntSideRdrRiObj4RdrObjAy FrntSideRdrRiObj4RdrObjBoxLength FrntSideRdrRiObj4RdrObjBoxWidth FrntSideRdrRiObj4RdrObjChks FrntSideRdrRiObj4RdrObjCntr FrntSideRdrRiObj4RdrObjCoastCnt FrntSideRdrRiObj4RdrObjConf FrntSideRdrRiObj4RdrObjDx FrntSideRdrRiObj4RdrObjDxStdDe FrntSideRdrRiObj4RdrObjDy FrntSideRdrRiObj4RdrObjDyStdDe FrntSideRdrRiObj4RdrObjElevnConf FrntSideRdrRiObj4RdrObjElevnSts FrntSideRdrRiObj4RdrObjID FrntSideRdrRiObj4RdrObjIsInFreeSpace FrntSideRdrRiObj4RdrObjMirrProblty FrntSideRdrRiObj4RdrObjMtnPat FrntSideRdrRiObj4RdrObjNotRealProblty FrntSideRdrRiObj4RdrObjStatyCnt FrntSideRdrRiObj4RdrObjTiAlv FrntSideRdrRiObj4RdrObjTrackSts FrntSideRdrRiObj4RdrObjTyp FrntSideRdrRiObj4RdrObjTypConfBike FrntSideRdrRiObj4RdrObjTypConfPed FrntSideRdrRiObj4RdrObjTypConfVeh FrntSideRdrRiObj4RdrObjUsedTracker FrntSideRdrRiObj4RdrObjVx FrntSideRdrRiObj4RdrObjVxStdDe FrntSideRdrRiObj4RdrObjVy FrntSideRdrRiObj4RdrObjVyStdDe FrntSideRdrRiObj4RelVx FrntSideRdrRiObj4RelVy;
SIG_GROUP_ 357 FrntSideRdrRiObj5 1 : FrntSideRdrRiObj5Heading FrntSideRdrRiObj5ObjBoxCenterLat FrntSideRdrRiObj5ObjBoxCenterLgt FrntSideRdrRiObj5ObservationHist FrntSideRdrRiObj5QualityBits FrntSideRdrRiObj5RdrObjAx FrntSideRdrRiObj5RdrObjAy FrntSideRdrRiObj5RdrObjBoxLength FrntSideRdrRiObj5RdrObjBoxWidth FrntSideRdrRiObj5RdrObjChks FrntSideRdrRiObj5RdrObjCntr FrntSideRdrRiObj5RdrObjCoastCnt FrntSideRdrRiObj5RdrObjConf FrntSideRdrRiObj5RdrObjDx FrntSideRdrRiObj5RdrObjDxStdDe FrntSideRdrRiObj5RdrObjDy FrntSideRdrRiObj5RdrObjDyStdDe FrntSideRdrRiObj5RdrObjElevnConf FrntSideRdrRiObj5RdrObjElevnSts FrntSideRdrRiObj5RdrObjID FrntSideRdrRiObj5RdrObjIsInFreeSpace FrntSideRdrRiObj5RdrObjMirrProblty FrntSideRdrRiObj5RdrObjMtnPat FrntSideRdrRiObj5RdrObjNotRealProblty FrntSideRdrRiObj5RdrObjStatyCnt FrntSideRdrRiObj5RdrObjTiAlv FrntSideRdrRiObj5RdrObjTrackSts FrntSideRdrRiObj5RdrObjTyp FrntSideRdrRiObj5RdrObjTypConfBike FrntSideRdrRiObj5RdrObjTypConfPed FrntSideRdrRiObj5RdrObjTypConfVeh FrntSideRdrRiObj5RdrObjUsedTracker FrntSideRdrRiObj5RdrObjVx FrntSideRdrRiObj5RdrObjVxStdDe FrntSideRdrRiObj5RdrObjVy FrntSideRdrRiObj5RdrObjVyStdDe FrntSideRdrRiObj5RelVx FrntSideRdrRiObj5RelVy;

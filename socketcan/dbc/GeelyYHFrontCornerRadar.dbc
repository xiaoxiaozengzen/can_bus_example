// *************************************************************************** *
// *                                                                           *
// * Description:         CANDB File                                           *
// * Generated at:        2023-03-04 22:47                                     *
// * System:              SDB23100                                             *
// * Variant:             DX11_VDDM_CDD3_ADCU3                                 *
// * Network:             SafetyCANFD1                                         *
// *                                                                           *
// *************************************************************************** *
VERSION "SafetyCANFD1"

NS_ :

BS_ :

BU_ :  ASDM ETC FSRL FSRR

BO_ 33 ASDMCanFD1TimeSyncFr : 8 ASDM

BO_ 288 AsdmSafetyCANFD1Fr01 : 64 ASDM
 SG_ ADataRawSafe_UB : 56|1@0+ (1,0) [0|1] "" FSRL,FSRR
 SG_ ADataRawSafeALat : 23|15@0- (0.0085,0.0) [-138.99200000000002|139.00050000000002] "m/s^2" FSRL,FSRR
 SG_ ADataRawSafeALat1Qf : 11|2@0+ (1,0) [0|3] "" FSRL,FSRR
 SG_ ADataRawSafeALgt : 38|15@0- (0.0085,0.0) [-138.99200000000002|139.00050000000002] "m/s^2" FSRL,FSRR
 SG_ ADataRawSafeALgt1Qf : 9|2@0+ (1,0) [0|3] "" FSRL,FSRR
 SG_ ADataRawSafeAVert : 55|15@0- (0.0085,0.0) [-138.99200000000002|139.00050000000002] "m/s^2" FSRL,FSRR
 SG_ ADataRawSafeAVertQf : 24|2@0+ (1,0) [0|3] "" FSRL,FSRR
 SG_ ADataRawSafeChks : 7|8@0+ (1.0,0.0) [0.0|255.0] "Unitless" FSRL,FSRR
 SG_ ADataRawSafeCntr : 15|4@0+ (1.0,0.0) [0.0|15.0] "Unitless" FSRL,FSRR
 SG_ ALgtStdFromWhlSpd_UB : 318|1@0+ (1,0) [0|1] "" FSRL,FSRR
 SG_ ALgtStdFromWhlSpdALgtStdFromWhlSpd : 335|16@0- (0.0009765625,0.0) [-18.0|18.0] "m/s^2" FSRL,FSRR
 SG_ ALgtStdFromWhlSpdChks : 327|8@0+ (1.0,0.0) [0.0|255.0] "Unitless" FSRL,FSRR
 SG_ ALgtStdFromWhlSpdCntr : 315|4@0+ (1.0,0.0) [0.0|15.0] "Unitless" FSRL,FSRR
 SG_ ALgtStdFromWhlSpdQf : 317|2@0+ (1,0) [0|3] "" FSRL,FSRR
 SG_ AmbTRaw_UB : 106|1@0+ (1,0) [0|1] "" FSRL,FSRR
 SG_ AmbTRawAmbTVal : 234|11@0+ (0.1,-70.0) [-70.0|134.70000000000002] "degC" FSRL,FSRR
 SG_ AmbTRawQly : 236|2@0+ (1,0) [0|3] "" FSRL,FSRR
 SG_ AsyDataWithCmpSafe_UB : 168|1@0+ (1,0) [0|1] "" FSRL,FSRR
 SG_ AsyDataWithCmpSafeALat1Qf : 153|2@0+ (1,0) [0|3] "" FSRL,FSRR
 SG_ AsyDataWithCmpSafeALatWithCmp : 167|15@0- (0.0085,0.0) [-138.99200000000002|139.00050000000002] "m/s^2" FSRL,FSRR
 SG_ AsyDataWithCmpSafeALgt1Qf : 155|2@0+ (1,0) [0|3] "" FSRL,FSRR
 SG_ AsyDataWithCmpSafeChks : 135|8@0+ (1.0,0.0) [0.0|255.0] "Unitless" FSRL,FSRR
 SG_ AsyDataWithCmpSafeCntr : 159|4@0+ (1.0,0.0) [0.0|15.0] "Unitless" FSRL,FSRR
 SG_ AsyDataWithCmpSafeGrdtOfALgt : 143|14@0- (0.00390625,0.0) [-30.0|30.0] "m/s^3" FSRL,FSRR
 SG_ AsyDataWithCmpSafeYawRateQf : 145|2@0+ (1,0) [0|3] "" FSRL,FSRR
 SG_ AsyDataWithCmpSafeYawRateWithCmp : 119|16@0- (0.000244140625,0.0) [-6.0|6.0] "rad/s" FSRL,FSRR
 SG_ BkpOfDstTrvld : 416|21@0+ (1.0,0.0) [0.0|2000000.0] "km" FSRL,FSRR
 SG_ BkpOfDstTrvld_UB : 319|1@0+ (1,0) [0|1] "" FSRL,FSRR
 SG_ CarTiGlb : 391|32@0+ (0.1,0.0) [0.0|429496729.5] "s" FSRL,FSRR
 SG_ CarTiGlb_UB : 107|1@0+ (1,0) [0|1] "" FSRL,FSRR
 SG_ DrvModReq : 227|4@0+ (1,0) [0|15] "" FSRL,FSRR
 SG_ DrvModReq_UB : 105|1@0+ (1,0) [0|1] "" FSRL,FSRR
 SG_ PinionSteerAgGroup_UB : 305|1@0+ (1,0) [0|1] "" FSRL,FSRR
 SG_ PinionSteerAgGroupChks : 255|8@0+ (1.0,0.0) [0.0|255.0] "Unitless" FSRL,FSRR
 SG_ PinionSteerAgGroupCntr : 311|4@0+ (1.0,0.0) [0.0|15.0] "Unitless" FSRL,FSRR
 SG_ PinionSteerAgGroupPinionSteerAg1 : 294|15@0- (0.0009765625,0.0) [-14.5|14.5] "rad" FSRL,FSRR
 SG_ PinionSteerAgGroupPinionSteerAg1Qf : 263|2@0+ (1,0) [0|3] "" FSRL,FSRR
 SG_ PinionSteerAgGroupPinionSteerAgSpd1 : 261|14@0- (0.0078125,0.0) [-50.0|50.0] "rad/s" FSRL,FSRR
 SG_ PinionSteerAgGroupPinionSteerAgSpd1Qf : 279|2@0+ (1,0) [0|3] "" FSRL,FSRR
 SG_ PinionSteerAgGroupSteerWhlTq : 277|14@0- (0.00390625,0.0) [-30.0|30.0] "NewtonMeter" FSRL,FSRR
 SG_ PinionSteerAgGroupSteerWhlTqQf : 307|2@0+ (1,0) [0|3] "" FSRL,FSRR
 SG_ RainfallAmnt : 231|4@0+ (1,0) [0|15] "" Vector__XXX
 SG_ RainfallAmnt_UB : 237|1@0+ (1,0) [0|1] "" Vector__XXX
 SG_ SteerWhlSnsr_UB : 71|1@0+ (1,0) [0|1] "" FSRL,FSRR
 SG_ SteerWhlSnsrAg : 70|15@0- (0.0009765625,0.0) [-14.5|14.5] "rad" FSRL,FSRR
 SG_ SteerWhlSnsrAgSpd : 85|14@0- (0.0078125,0.0) [-50.0|50.0] "rad/s" FSRL,FSRR
 SG_ SteerWhlSnsrChks : 103|8@0+ (1.0,0.0) [0.0|255.0] "Unitless" FSRL,FSRR
 SG_ SteerWhlSnsrCntr : 111|4@0+ (1.0,0.0) [0.0|15.0] "Unitless" FSRL,FSRR
 SG_ SteerWhlSnsrQf : 87|2@0+ (1,0) [0|3] "" FSRL,FSRR
 SG_ VehBattU_UB : 442|1@0+ (1,0) [0|1] "" FSRL,FSRR
 SG_ VehBattUSysU : 455|8@0+ (0.1,0.0) [0.0|25.0] "Volt" FSRL,FSRR
 SG_ VehBattUSysUQf : 441|2@0+ (1,0) [0|3] "" FSRL,FSRR
 SG_ VehModMngtGlbSafe1_UB : 376|1@0+ (1,0) [0|1] "" FSRL,FSRR
 SG_ VehModMngtGlbSafe1CarModSts1 : 383|3@0+ (1,0) [0|7] "" FSRL,FSRR
 SG_ VehModMngtGlbSafe1CarModSubtypWdCarModSubtyp : 380|3@0+ (1.0,0.0) [0.0|7.0] "Unitless" FSRL,FSRR
 SG_ VehModMngtGlbSafe1Chks : 351|8@0+ (1.0,0.0) [0.0|255.0] "Unitless" FSRL,FSRR
 SG_ VehModMngtGlbSafe1Cntr : 359|4@0+ (1.0,0.0) [0.0|15.0] "Unitless" FSRL,FSRR
 SG_ VehModMngtGlbSafe1EgyLvlElecMai : 355|4@0+ (1.0,0.0) [0.0|15.0] "Unitless" FSRL,FSRR
 SG_ VehModMngtGlbSafe1EgyLvlElecSubtyp : 367|4@0+ (1.0,0.0) [0.0|15.0] "Unitless" FSRL,FSRR
 SG_ VehModMngtGlbSafe1FltEgyCnsWdSts : 377|1@0+ (1,0) [0|1] "" FSRL,FSRR
 SG_ VehModMngtGlbSafe1PwrLvlElecMai : 363|4@0+ (1.0,0.0) [0.0|15.0] "Unitless" FSRL,FSRR
 SG_ VehModMngtGlbSafe1PwrLvlElecSubtyp : 375|4@0+ (1.0,0.0) [0.0|15.0] "Unitless" FSRL,FSRR
 SG_ VehModMngtGlbSafe1UsgModSts : 371|4@0+ (1,0) [0|15] "" FSRL,FSRR
 SG_ VehMtnSt_UB : 183|1@0+ (1,0) [0|1] "" FSRL,FSRR
 SG_ VehMtnStChks : 191|8@0+ (1.0,0.0) [0.0|255.0] "Unitless" FSRL,FSRR
 SG_ VehMtnStCntr : 182|4@0+ (1.0,0.0) [0.0|15.0] "Unitless" FSRL,FSRR
 SG_ VehMtnStVehMtnSt : 178|3@0+ (1,0) [0|7] "" FSRL,FSRR
 SG_ VehSpdLgt_UB : 199|1@0+ (1,0) [0|1] "" FSRL,FSRR
 SG_ VehSpdLgtA : 198|15@0+ (0.00391,0.0) [0.0|125.0027] "m/s" FSRL,FSRR
 SG_ VehSpdLgtChks : 215|8@0+ (1.0,0.0) [0.0|255.0] "Unitless" FSRL,FSRR
 SG_ VehSpdLgtCntr : 223|4@0+ (1.0,0.0) [0.0|15.0] "Unitless" FSRL,FSRR
 SG_ VehSpdLgtQf : 219|2@0+ (1,0) [0|3] "" FSRL,FSRR
 SG_ WipgInfo_UB : 461|1@0+ (1,0) [0|1] "" FSRL,FSRR
 SG_ WipgInfoWipgSpdInfo : 458|3@0+ (1,0) [0|7] "" FSRL,FSRR
 SG_ WipgInfoWiprActv : 459|1@0+ (1,0) [0|1] "" FSRL,FSRR
 SG_ WipgInfoWiprInWipgAr : 460|1@0+ (1,0) [0|1] "" FSRL,FSRR

BO_ 1007 AsdmSafetyCANFD1Fr02 : 64 ASDM
 SG_ FrntSideRdrLeVehPrm_UB : 147|1@0+ (1,0) [0|1] "" FSRL
 SG_ FrntSideRdrLeVehPrmRdrVehPrmChks : 7|8@0+ (1.0,0.0) [0.0|255.0] "Unitless" FSRL
 SG_ FrntSideRdrLeVehPrmRdrVehPrmCntr : 15|4@0+ (1.0,0.0) [0.0|15.0] "Unitless" FSRL
 SG_ FrntSideRdrLeVehPrmRdrVehPrmRdrDynCalPrmForAgOffs : 71|8@0+ (0.1,-12.8) [-12.8|12.7] "Deg" FSRL
 SG_ FrntSideRdrLeVehPrmRdrVehPrmRdrDynCalPrmForAxleDstReToVehFrnt : 109|9@0+ (0.01,1.0) [1.0|6.0] "m" FSRL
 SG_ FrntSideRdrLeVehPrmRdrVehPrmRdrDynCalPrmForPinoinAgRat : 95|8@0+ (0.05,8.0) [8.0|20.75] "Unitless" FSRL
 SG_ FrntSideRdrLeVehPrmRdrVehPrmRdrDynCalPrmForRollAgGain : 79|14@0+ (0.0001,0.0) [0.0|1.0] "Unitless" FSRL
 SG_ FrntSideRdrLeVehPrmRdrVehPrmRdrDynCalPrmForSnsrDir : 81|1@0+ (1,0) [0|1] "" FSRL
 SG_ FrntSideRdrLeVehPrmRdrVehPrmRdrDynCalPrmForSnsrOrntn : 80|1@0+ (1,0) [0|1] "" FSRL
 SG_ FrntSideRdrLeVehPrmRdrVehPrmRdrDynCalPrmForSnsrPosnLat : 11|12@0+ (0.001,-2.0) [-2.0|2.0] "m" FSRL
 SG_ FrntSideRdrLeVehPrmRdrVehPrmRdrDynCalPrmForSnsrPosnLgt : 135|14@0+ (0.001,-5.0) [-5.0|5.0] "m" FSRL
 SG_ FrntSideRdrLeVehPrmRdrVehPrmRdrDynCalPrmForSnsrPosnVert : 31|11@0+ (0.001,0.0) [0.0|2.0] "m" FSRL
 SG_ FrntSideRdrLeVehPrmRdrVehPrmRdrDynCalPrmForSnsrRot1 : 36|11@0+ (0.1,-90.0) [-90.0|90.0] "Deg" FSRL
 SG_ FrntSideRdrLeVehPrmRdrVehPrmRdrDynCalPrmForVehLen : 41|10@0+ (0.01,0.0) [0.0|10.0] "m" FSRL
 SG_ FrntSideRdrLeVehPrmRdrVehPrmRdrDynCalPrmForVehTyp : 63|8@0+ (1.0,0.0) [0.0|255.0] "Unitless" FSRL
 SG_ FrntSideRdrLeVehPrmRdrVehPrmRdrDynCalPrmForVehWidth : 116|9@0+ (0.01,0.0) [0.0|5.0] "m" FSRL
 SG_ FrntSideRdrLeVehPrmRdrVehPrmRdrDynCalPrmForVersMajor : 123|4@0+ (1.0,0.0) [0.0|15.0] "Unitless" FSRL
 SG_ FrntSideRdrLeVehPrmRdrVehPrmRdrDynCalPrmForVersMinor : 151|4@0+ (1.0,0.0) [0.0|15.0] "Unitless" FSRL
 SG_ FrntSideRdrLeVehPrmRdrVehPrmRdrDynCalPrmForWhlBas : 103|10@0+ (0.01,0.0) [0.0|10.0] "m" FSRL
 SG_ FrntSideRdrLeVehPrmRdrVehPrmVld : 137|1@0+ (1,0) [0|1] "" FSRL
 SG_ FrntSideRdrRiVehPrm_UB : 299|1@0+ (1,0) [0|1] "" FSRR
 SG_ FrntSideRdrRiVehPrmRdrVehPrmChks : 159|8@0+ (1.0,0.0) [0.0|255.0] "Unitless" FSRR
 SG_ FrntSideRdrRiVehPrmRdrVehPrmCntr : 167|4@0+ (1.0,0.0) [0.0|15.0] "Unitless" FSRR
 SG_ FrntSideRdrRiVehPrmRdrVehPrmRdrDynCalPrmForAgOffs : 175|8@0+ (0.1,-12.8) [-12.8|12.7] "Deg" FSRR
 SG_ FrntSideRdrRiVehPrmRdrVehPrmRdrDynCalPrmForAxleDstReToVehFrnt : 208|9@0+ (0.01,1.0) [1.0|6.0] "m" FSRR
 SG_ FrntSideRdrRiVehPrmRdrVehPrmRdrDynCalPrmForPinoinAgRat : 183|8@0+ (0.05,8.0) [8.0|20.75] "Unitless" FSRR
 SG_ FrntSideRdrRiVehPrmRdrVehPrmRdrDynCalPrmForRollAgGain : 231|14@0+ (0.0001,0.0) [0.0|1.0] "Unitless" FSRR
 SG_ FrntSideRdrRiVehPrmRdrVehPrmRdrDynCalPrmForSnsrDir : 233|1@0+ (1,0) [0|1] "" FSRR
 SG_ FrntSideRdrRiVehPrmRdrVehPrmRdrDynCalPrmForSnsrOrntn : 232|1@0+ (1,0) [0|1] "" FSRR
 SG_ FrntSideRdrRiVehPrmRdrVehPrmRdrDynCalPrmForSnsrPosnLat : 271|12@0+ (0.001,-2.0) [-2.0|2.0] "m" FSRR
 SG_ FrntSideRdrRiVehPrmRdrVehPrmRdrDynCalPrmForSnsrPosnLgt : 247|14@0+ (0.001,-5.0) [-5.0|5.0] "m" FSRR
 SG_ FrntSideRdrRiVehPrmRdrVehPrmRdrDynCalPrmForSnsrPosnVert : 203|11@0+ (0.001,0.0) [0.0|2.0] "m" FSRR
 SG_ FrntSideRdrRiVehPrmRdrVehPrmRdrDynCalPrmForSnsrRot1 : 275|11@0+ (0.1,-90.0) [-90.0|90.0] "Deg" FSRR
 SG_ FrntSideRdrRiVehPrmRdrVehPrmRdrDynCalPrmForVehLen : 197|10@0+ (0.01,0.0) [0.0|10.0] "m" FSRR
 SG_ FrntSideRdrRiVehPrmRdrVehPrmRdrDynCalPrmForVehTyp : 295|8@0+ (1.0,0.0) [0.0|255.0] "Unitless" FSRR
 SG_ FrntSideRdrRiVehPrmRdrVehPrmRdrDynCalPrmForVehWidth : 249|9@0+ (0.01,0.0) [0.0|5.0] "m" FSRR
 SG_ FrntSideRdrRiVehPrmRdrVehPrmRdrDynCalPrmForVersMajor : 163|4@0+ (1.0,0.0) [0.0|15.0] "Unitless" FSRR
 SG_ FrntSideRdrRiVehPrmRdrVehPrmRdrDynCalPrmForVersMinor : 303|4@0+ (1.0,0.0) [0.0|15.0] "Unitless" FSRR
 SG_ FrntSideRdrRiVehPrmRdrVehPrmRdrDynCalPrmForWhlBas : 191|10@0+ (0.01,0.0) [0.0|10.0] "m" FSRR
 SG_ FrntSideRdrRiVehPrmRdrVehPrmVld : 256|1@0+ (1,0) [0|1] "" FSRR
 SG_ TiAndDateIndcn_UB : 311|1@0+ (1,0) [0|1] "" FSRR
 SG_ TiAndDateIndcnDataValid : 310|1@0+ (1,0) [0|1] "" FSRR
 SG_ TiAndDateIndcnDay : 332|5@0+ (1.0,0.0) [1.0|31.0] "Days" FSRR
 SG_ TiAndDateIndcnHr1 : 324|5@0+ (1.0,0.0) [0.0|23.0] "hours" FSRR
 SG_ TiAndDateIndcnMins1 : 317|6@0+ (1.0,0.0) [0.0|59.0] "Mins" FSRR
 SG_ TiAndDateIndcnMth1 : 339|4@0+ (1.0,0.0) [1.0|12.0] "Month" FSRR
 SG_ TiAndDateIndcnSec1 : 309|6@0+ (1.0,0.0) [0.0|59.0] "s" FSRR
 SG_ TiAndDateIndcnYr1 : 350|7@0+ (1.0,0.0) [0.0|99.0] "Year" FSRR

BO_ 1281 AsdmSafetyCanFD1NMFr : 8 ASDM
 SG_ PNC16_ASDM : 16|1@0+ (1,0) [0|0] "" FSRR
 SG_ PNC17_ASDM : 17|1@0+ (1,0) [0|0] "" FSRR
 SG_ PNC18_ASDM : 18|1@0+ (1,0) [0|0] "" FSRR
 SG_ PNC19_ASDM : 19|1@0+ (1,0) [0|0] "" FSRR
 SG_ PNC20_ASDM : 20|1@0+ (1,0) [0|0] "" FSRR
 SG_ PNC21_ASDM : 21|1@0+ (1,0) [0|0] "" FSRR
 SG_ PNC22_ASDM : 22|1@0+ (1,0) [0|0] "" FSRR
 SG_ PNC23_ASDM : 23|1@0+ (1,0) [0|0] "" FSRR
 SG_ PNC24_ASDM : 24|1@0+ (1,0) [0|0] "" FSRR
 SG_ PNC25_ASDM : 25|1@0+ (1,0) [0|0] "" FSRR
 SG_ PNC26_ASDM : 26|1@0+ (1,0) [0|0] "" FSRR
 SG_ PNC27_ASDM : 27|1@0+ (1,0) [0|0] "" FSRR
 SG_ PNC28_ASDM : 28|1@0+ (1,0) [0|0] "" FSRR
 SG_ PNC29_ASDM : 29|1@0+ (1,0) [0|0] "" FSRR
 SG_ PNC30_ASDM : 30|1@0+ (1,0) [0|0] "" FSRR
 SG_ PNC31_ASDM : 31|1@0+ (1,0) [0|0] "" FSRR
 SG_ PNC32_ASDM : 32|1@0+ (1,0) [0|0] "" FSRR
 SG_ PNC33_ASDM : 33|1@0+ (1,0) [0|0] "" FSRR
 SG_ PNC34_ASDM : 34|1@0+ (1,0) [0|0] "" FSRR
 SG_ PNC35_ASDM : 35|1@0+ (1,0) [0|0] "" FSRR
 SG_ PNC36_ASDM : 36|1@0+ (1,0) [0|0] "" FSRR
 SG_ PNC37_ASDM : 37|1@0+ (1,0) [0|0] "" FSRR
 SG_ PNC38_ASDM : 38|1@0+ (1,0) [0|0] "" FSRR
 SG_ PNC39_ASDM : 39|1@0+ (1,0) [0|0] "" FSRR
 SG_ PNC40_ASDM : 40|1@0+ (1,0) [0|0] "" FSRR
 SG_ PNC41_ASDM : 41|1@0+ (1,0) [0|0] "" FSRR
 SG_ PNC42_ASDM : 42|1@0+ (1,0) [0|0] "" FSRR
 SG_ NM_PNI_ASDM : 14|1@0+ (1,0) [0|0] "" FSRR
 SG_ NM_AW_ASDM : 12|1@0+ (1,0) [0|0] "" FSRR
 SG_ NM_CS_ASDM : 11|1@0+ (1,0) [0|0] "" FSRR
 SG_ NM_RMR_ASDM : 8|1@0+ (1,0) [0|0] "" FSRR
 SG_ NM_NodeID_ASDM : 7|8@0+ (1,0) [0|0] "" FSRR

BO_ 2047 AsdmToAllFuncSafetyCanFD1DiagReqFrame : 8 ASDM
 SG_ AsdmToAllFuncSafetyCanFD1DiagReqNpdu : 7|64@0+ (1,0) [0|0] "" FSRL, FSRR

BO_ 1841 AsdmToFsrlSafetyCanFD1DiagReqFrame : 64 ASDM
 SG_ AsdmToFsrlSafetyCanFD1DiagReqNpdu : 7|512@0+ (1,0) [0|0] "" FSRL

BO_ 1840 AsdmToFsrrSafetyCanFD1DiagReqFrame : 64 ASDM
 SG_ AsdmToFsrrSafetyCanFD1DiagReqNpdu : 7|512@0+ (1,0) [0|0] "" FSRR

BO_ 1413 EtcToFsrlXcpFr01 : 8 ETC

BO_ 1414 EtcToFsrrXcpFr01 : 8 ETC

BO_ 297 FSRLSafetyCANFD1Frame00 : 64 FSRL
 SG_ FrntSideRdrLeSts_UB : 243|1@0+ (1,0) [0|1] "" ASDM
 SG_ FrntSideRdrLeStsForDim : 127|3@0+ (1,0) [0|7] "" ASDM
 SG_ FrntSideRdrLeStsForDim_UB : 116|1@0+ (1,0) [0|1] "" ASDM
 SG_ FrntSideRdrLeStsRdrNrDetn : 207|8@0+ (1.0,0.0) [0.0|255.0] "Unitless" ASDM
 SG_ FrntSideRdrLeStsRdrNrObj : 215|8@0+ (1.0,0.0) [0.0|255.0] "Unitless" ASDM
 SG_ FrntSideRdrLeStsRdrStsBlkd0bin : 216|1@0+ (1,0) [0|1] "" ASDM
 SG_ FrntSideRdrLeStsRdrStsBlkdConf : 223|7@0+ (1.0,0.0) [0.0|100.0] "%" ASDM
 SG_ FrntSideRdrLeStsRdrStsChks : 135|8@0+ (1.0,0.0) [0.0|255.0] "Unitless" ASDM
 SG_ FrntSideRdrLeStsRdrStsCntr : 143|4@0+ (1.0,0.0) [0.0|15.0] "Unitless" ASDM
 SG_ FrntSideRdrLeStsRdrStsDstbc : 239|7@0+ (1.0,0.0) [0.0|100.0] "%" ASDM
 SG_ FrntSideRdrLeStsRdrStsEna : 232|1@0+ (1,0) [0|1] "" ASDM
 SG_ FrntSideRdrLeStsRdrStsFaulty : 247|1@0+ (1,0) [0|1] "" ASDM
 SG_ FrntSideRdrLeStsRdrStsIfVersMajor : 139|4@0+ (1.0,0.0) [0.0|15.0] "Unitless" ASDM
 SG_ FrntSideRdrLeStsRdrStsIfVersMinor : 151|4@0+ (1.0,0.0) [0.0|15.0] "Unitless" ASDM
 SG_ FrntSideRdrLeStsRdrStsLatency : 191|16@0+ (1.0,0.0) [0.0|65535.0] "Unitless" ASDM
 SG_ FrntSideRdrLeStsRdrStsMisAlign : 147|3@0+ (1,0) [0|7] "" ASDM
 SG_ FrntSideRdrLeStsRdrStsMissCom : 144|1@0+ (1,0) [0|1] "" ASDM
 SG_ FrntSideRdrLeStsRdrStsSftyFlt : 246|2@0+ (1,0) [0|3] "" ASDM
 SG_ FrntSideRdrLeStsRdrStsTiStamp : 159|32@0+ (0.0001,0.0) [0.0|429496.7295] "s" ASDM
 SG_ FrntSideRdrLeStsRdrStsTiStampStsGlbTiBas : 244|1@0+ (1,0) [0|1] "" ASDM
 SG_ FrntSideRdrLeStsRdrStsTiStampStsSyncToGatewy : 224|1@0+ (1,0) [0|1] "" ASDM
 SG_ FrntSideRdrLeStsRdrStsTiStampStsTiLeap : 225|1@0+ (1,0) [0|1] "" ASDM
 SG_ FrntSideRdrLeStsRdrStsTiStampStsTiOut : 226|1@0+ (1,0) [0|1] "" ASDM
 SG_ FrntSideRdrLeStsRdrStsWhlSpdCmpFac : 231|5@0+ (0.005,0.92) [0.92|1.075] "Unitless" ASDM

BO_ 304 FSRLSafetyCANFD1Frame01 : 64 FSRL
 SG_ FrntSideRdrLeDetn1_UB : 74|1@0+ (1,0) [0|1] "" ASDM
 SG_ FrntSideRdrLeDetn1RdrDetnAzi : 31|11@0+ (0.1,-90.0) [-90.0|90.0] "Deg" ASDM
 SG_ FrntSideRdrLeDetn1RdrDetnChks : 7|8@0+ (1.0,0.0) [0.0|255.0] "Unitless" ASDM
 SG_ FrntSideRdrLeDetn1RdrDetnCntr : 15|4@0+ (1.0,0.0) [0.0|15.0] "Unitless" ASDM
 SG_ FrntSideRdrLeDetn1RdrDetnConf : 71|7@0+ (1.0,0.0) [0.0|100.0] "%" ASDM
 SG_ FrntSideRdrLeDetn1RdrDetnElevn : 79|5@0+ (1.0,-15.0) [-15.0|15.0] "Deg" ASDM
 SG_ FrntSideRdrLeDetn1RdrDetnPwr : 8|9@0+ (0.1,0.0) [0.0|51.1] "dB" ASDM
 SG_ FrntSideRdrLeDetn1RdrDetnRng : 55|14@0+ (0.02,-1.0) [-1.0|200.0] "m" ASDM
 SG_ FrntSideRdrLeDetn1RdrDetnRngV : 36|13@0+ (0.02,-80.0) [-80.0|80.0] "m/s" ASDM
 SG_ FrntSideRdrLeDetn1RdrDetnSts : 11|2@0+ (1,0) [0|3] "" ASDM
 SG_ FrntSideRdrLeDetn2_UB : 154|1@0+ (1,0) [0|1] "" ASDM
 SG_ FrntSideRdrLeDetn2RdrDetnAzi : 119|11@0+ (0.1,-90.0) [-90.0|90.0] "Deg" ASDM
 SG_ FrntSideRdrLeDetn2RdrDetnChks : 87|8@0+ (1.0,0.0) [0.0|255.0] "Unitless" ASDM
 SG_ FrntSideRdrLeDetn2RdrDetnCntr : 95|4@0+ (1.0,0.0) [0.0|15.0] "Unitless" ASDM
 SG_ FrntSideRdrLeDetn2RdrDetnConf : 111|7@0+ (1.0,0.0) [0.0|100.0] "%" ASDM
 SG_ FrntSideRdrLeDetn2RdrDetnElevn : 159|5@0+ (1.0,-15.0) [-15.0|15.0] "Deg" ASDM
 SG_ FrntSideRdrLeDetn2RdrDetnPwr : 89|9@0+ (0.1,0.0) [0.0|51.1] "dB" ASDM
 SG_ FrntSideRdrLeDetn2RdrDetnRng : 143|14@0+ (0.02,-1.0) [-1.0|200.0] "m" ASDM
 SG_ FrntSideRdrLeDetn2RdrDetnRngV : 124|13@0+ (0.02,-80.0) [-80.0|80.0] "m/s" ASDM
 SG_ FrntSideRdrLeDetn2RdrDetnSts : 91|2@0+ (1,0) [0|3] "" ASDM
 SG_ FrntSideRdrLeDetn3_UB : 234|1@0+ (1,0) [0|1] "" ASDM
 SG_ FrntSideRdrLeDetn3RdrDetnAzi : 199|11@0+ (0.1,-90.0) [-90.0|90.0] "Deg" ASDM
 SG_ FrntSideRdrLeDetn3RdrDetnChks : 167|8@0+ (1.0,0.0) [0.0|255.0] "Unitless" ASDM
 SG_ FrntSideRdrLeDetn3RdrDetnCntr : 175|4@0+ (1.0,0.0) [0.0|15.0] "Unitless" ASDM
 SG_ FrntSideRdrLeDetn3RdrDetnConf : 191|7@0+ (1.0,0.0) [0.0|100.0] "%" ASDM
 SG_ FrntSideRdrLeDetn3RdrDetnElevn : 239|5@0+ (1.0,-15.0) [-15.0|15.0] "Deg" ASDM
 SG_ FrntSideRdrLeDetn3RdrDetnPwr : 169|9@0+ (0.1,0.0) [0.0|51.1] "dB" ASDM
 SG_ FrntSideRdrLeDetn3RdrDetnRng : 223|14@0+ (0.02,-1.0) [-1.0|200.0] "m" ASDM
 SG_ FrntSideRdrLeDetn3RdrDetnRngV : 204|13@0+ (0.02,-80.0) [-80.0|80.0] "m/s" ASDM
 SG_ FrntSideRdrLeDetn3RdrDetnSts : 171|2@0+ (1,0) [0|3] "" ASDM
 SG_ FrntSideRdrLeDetn4_UB : 314|1@0+ (1,0) [0|1] "" ASDM
 SG_ FrntSideRdrLeDetn4RdrDetnAzi : 287|11@0+ (0.1,-90.0) [-90.0|90.0] "Deg" ASDM
 SG_ FrntSideRdrLeDetn4RdrDetnChks : 247|8@0+ (1.0,0.0) [0.0|255.0] "Unitless" ASDM
 SG_ FrntSideRdrLeDetn4RdrDetnCntr : 255|4@0+ (1.0,0.0) [0.0|15.0] "Unitless" ASDM
 SG_ FrntSideRdrLeDetn4RdrDetnConf : 311|7@0+ (1.0,0.0) [0.0|100.0] "%" ASDM
 SG_ FrntSideRdrLeDetn4RdrDetnElevn : 319|5@0+ (1.0,-15.0) [-15.0|15.0] "Deg" ASDM
 SG_ FrntSideRdrLeDetn4RdrDetnPwr : 249|9@0+ (0.1,0.0) [0.0|51.1] "dB" ASDM
 SG_ FrntSideRdrLeDetn4RdrDetnRng : 271|14@0+ (0.02,-1.0) [-1.0|200.0] "m" ASDM
 SG_ FrntSideRdrLeDetn4RdrDetnRngV : 292|13@0+ (0.02,-80.0) [-80.0|80.0] "m/s" ASDM
 SG_ FrntSideRdrLeDetn4RdrDetnSts : 251|2@0+ (1,0) [0|3] "" ASDM
 SG_ FrntSideRdrLeDetn5_UB : 394|1@0+ (1,0) [0|1] "" ASDM
 SG_ FrntSideRdrLeDetn5RdrDetnAzi : 351|11@0+ (0.1,-90.0) [-90.0|90.0] "Deg" ASDM
 SG_ FrntSideRdrLeDetn5RdrDetnChks : 327|8@0+ (1.0,0.0) [0.0|255.0] "Unitless" ASDM
 SG_ FrntSideRdrLeDetn5RdrDetnCntr : 335|4@0+ (1.0,0.0) [0.0|15.0] "Unitless" ASDM
 SG_ FrntSideRdrLeDetn5RdrDetnConf : 391|7@0+ (1.0,0.0) [0.0|100.0] "%" ASDM
 SG_ FrntSideRdrLeDetn5RdrDetnElevn : 399|5@0+ (1.0,-15.0) [-15.0|15.0] "Deg" ASDM
 SG_ FrntSideRdrLeDetn5RdrDetnPwr : 329|9@0+ (0.1,0.0) [0.0|51.1] "dB" ASDM
 SG_ FrntSideRdrLeDetn5RdrDetnRng : 375|14@0+ (0.02,-1.0) [-1.0|200.0] "m" ASDM
 SG_ FrntSideRdrLeDetn5RdrDetnRngV : 356|13@0+ (0.02,-80.0) [-80.0|80.0] "m/s" ASDM
 SG_ FrntSideRdrLeDetn5RdrDetnSts : 331|2@0+ (1,0) [0|3] "" ASDM
 SG_ FrntSideRdrLeDetn6_UB : 474|1@0+ (1,0) [0|1] "" ASDM
 SG_ FrntSideRdrLeDetn6RdrDetnAzi : 447|11@0+ (0.1,-90.0) [-90.0|90.0] "Deg" ASDM
 SG_ FrntSideRdrLeDetn6RdrDetnChks : 407|8@0+ (1.0,0.0) [0.0|255.0] "Unitless" ASDM
 SG_ FrntSideRdrLeDetn6RdrDetnCntr : 415|4@0+ (1.0,0.0) [0.0|15.0] "Unitless" ASDM
 SG_ FrntSideRdrLeDetn6RdrDetnConf : 471|7@0+ (1.0,0.0) [0.0|100.0] "%" ASDM
 SG_ FrntSideRdrLeDetn6RdrDetnElevn : 479|5@0+ (1.0,-15.0) [-15.0|15.0] "Deg" ASDM
 SG_ FrntSideRdrLeDetn6RdrDetnPwr : 409|9@0+ (0.1,0.0) [0.0|51.1] "dB" ASDM
 SG_ FrntSideRdrLeDetn6RdrDetnRng : 431|14@0+ (0.02,-1.0) [-1.0|200.0] "m" ASDM
 SG_ FrntSideRdrLeDetn6RdrDetnRngV : 452|13@0+ (0.02,-80.0) [-80.0|80.0] "m/s" ASDM
 SG_ FrntSideRdrLeDetn6RdrDetnSts : 411|2@0+ (1,0) [0|3] "" ASDM

BO_ 306 FSRLSafetyCANFD1Frame02 : 64 FSRL
 SG_ FrntSideRdrLeDetn10_UB : 314|1@0+ (1,0) [0|1] "" ASDM
 SG_ FrntSideRdrLeDetn10RdrDetnAzi : 287|11@0+ (0.1,-90.0) [-90.0|90.0] "Deg" ASDM
 SG_ FrntSideRdrLeDetn10RdrDetnChks : 247|8@0+ (1.0,0.0) [0.0|255.0] "Unitless" ASDM
 SG_ FrntSideRdrLeDetn10RdrDetnCntr : 255|4@0+ (1.0,0.0) [0.0|15.0] "Unitless" ASDM
 SG_ FrntSideRdrLeDetn10RdrDetnConf : 311|7@0+ (1.0,0.0) [0.0|100.0] "%" ASDM
 SG_ FrntSideRdrLeDetn10RdrDetnElevn : 319|5@0+ (1.0,-15.0) [-15.0|15.0] "Deg" ASDM
 SG_ FrntSideRdrLeDetn10RdrDetnPwr : 249|9@0+ (0.1,0.0) [0.0|51.1] "dB" ASDM
 SG_ FrntSideRdrLeDetn10RdrDetnRng : 271|14@0+ (0.02,-1.0) [-1.0|200.0] "m" ASDM
 SG_ FrntSideRdrLeDetn10RdrDetnRngV : 292|13@0+ (0.02,-80.0) [-80.0|80.0] "m/s" ASDM
 SG_ FrntSideRdrLeDetn10RdrDetnSts : 251|2@0+ (1,0) [0|3] "" ASDM
 SG_ FrntSideRdrLeDetn11_UB : 394|1@0+ (1,0) [0|1] "" ASDM
 SG_ FrntSideRdrLeDetn11RdrDetnAzi : 367|11@0+ (0.1,-90.0) [-90.0|90.0] "Deg" ASDM
 SG_ FrntSideRdrLeDetn11RdrDetnChks : 327|8@0+ (1.0,0.0) [0.0|255.0] "Unitless" ASDM
 SG_ FrntSideRdrLeDetn11RdrDetnCntr : 335|4@0+ (1.0,0.0) [0.0|15.0] "Unitless" ASDM
 SG_ FrntSideRdrLeDetn11RdrDetnConf : 391|7@0+ (1.0,0.0) [0.0|100.0] "%" ASDM
 SG_ FrntSideRdrLeDetn11RdrDetnElevn : 399|5@0+ (1.0,-15.0) [-15.0|15.0] "Deg" ASDM
 SG_ FrntSideRdrLeDetn11RdrDetnPwr : 329|9@0+ (0.1,0.0) [0.0|51.1] "dB" ASDM
 SG_ FrntSideRdrLeDetn11RdrDetnRng : 351|14@0+ (0.02,-1.0) [-1.0|200.0] "m" ASDM
 SG_ FrntSideRdrLeDetn11RdrDetnRngV : 372|13@0+ (0.02,-80.0) [-80.0|80.0] "m/s" ASDM
 SG_ FrntSideRdrLeDetn11RdrDetnSts : 331|2@0+ (1,0) [0|3] "" ASDM
 SG_ FrntSideRdrLeDetn12_UB : 474|1@0+ (1,0) [0|1] "" ASDM
 SG_ FrntSideRdrLeDetn12RdrDetnAzi : 447|11@0+ (0.1,-90.0) [-90.0|90.0] "Deg" ASDM
 SG_ FrntSideRdrLeDetn12RdrDetnChks : 407|8@0+ (1.0,0.0) [0.0|255.0] "Unitless" ASDM
 SG_ FrntSideRdrLeDetn12RdrDetnCntr : 415|4@0+ (1.0,0.0) [0.0|15.0] "Unitless" ASDM
 SG_ FrntSideRdrLeDetn12RdrDetnConf : 471|7@0+ (1.0,0.0) [0.0|100.0] "%" ASDM
 SG_ FrntSideRdrLeDetn12RdrDetnElevn : 479|5@0+ (1.0,-15.0) [-15.0|15.0] "Deg" ASDM
 SG_ FrntSideRdrLeDetn12RdrDetnPwr : 409|9@0+ (0.1,0.0) [0.0|51.1] "dB" ASDM
 SG_ FrntSideRdrLeDetn12RdrDetnRng : 431|14@0+ (0.02,-1.0) [-1.0|200.0] "m" ASDM
 SG_ FrntSideRdrLeDetn12RdrDetnRngV : 452|13@0+ (0.02,-80.0) [-80.0|80.0] "m/s" ASDM
 SG_ FrntSideRdrLeDetn12RdrDetnSts : 411|2@0+ (1,0) [0|3] "" ASDM
 SG_ FrntSideRdrLeDetn7_UB : 74|1@0+ (1,0) [0|1] "" ASDM
 SG_ FrntSideRdrLeDetn7RdrDetnAzi : 31|11@0+ (0.1,-90.0) [-90.0|90.0] "Deg" ASDM
 SG_ FrntSideRdrLeDetn7RdrDetnChks : 7|8@0+ (1.0,0.0) [0.0|255.0] "Unitless" ASDM
 SG_ FrntSideRdrLeDetn7RdrDetnCntr : 15|4@0+ (1.0,0.0) [0.0|15.0] "Unitless" ASDM
 SG_ FrntSideRdrLeDetn7RdrDetnConf : 71|7@0+ (1.0,0.0) [0.0|100.0] "%" ASDM
 SG_ FrntSideRdrLeDetn7RdrDetnElevn : 79|5@0+ (1.0,-15.0) [-15.0|15.0] "Deg" ASDM
 SG_ FrntSideRdrLeDetn7RdrDetnPwr : 8|9@0+ (0.1,0.0) [0.0|51.1] "dB" ASDM
 SG_ FrntSideRdrLeDetn7RdrDetnRng : 55|14@0+ (0.02,-1.0) [-1.0|200.0] "m" ASDM
 SG_ FrntSideRdrLeDetn7RdrDetnRngV : 36|13@0+ (0.02,-80.0) [-80.0|80.0] "m/s" ASDM
 SG_ FrntSideRdrLeDetn7RdrDetnSts : 11|2@0+ (1,0) [0|3] "" ASDM
 SG_ FrntSideRdrLeDetn8_UB : 154|1@0+ (1,0) [0|1] "" ASDM
 SG_ FrntSideRdrLeDetn8RdrDetnAzi : 119|11@0+ (0.1,-90.0) [-90.0|90.0] "Deg" ASDM
 SG_ FrntSideRdrLeDetn8RdrDetnChks : 87|8@0+ (1.0,0.0) [0.0|255.0] "Unitless" ASDM
 SG_ FrntSideRdrLeDetn8RdrDetnCntr : 95|4@0+ (1.0,0.0) [0.0|15.0] "Unitless" ASDM
 SG_ FrntSideRdrLeDetn8RdrDetnConf : 111|7@0+ (1.0,0.0) [0.0|100.0] "%" ASDM
 SG_ FrntSideRdrLeDetn8RdrDetnElevn : 159|5@0+ (1.0,-15.0) [-15.0|15.0] "Deg" ASDM
 SG_ FrntSideRdrLeDetn8RdrDetnPwr : 89|9@0+ (0.1,0.0) [0.0|51.1] "dB" ASDM
 SG_ FrntSideRdrLeDetn8RdrDetnRng : 143|14@0+ (0.02,-1.0) [-1.0|200.0] "m" ASDM
 SG_ FrntSideRdrLeDetn8RdrDetnRngV : 124|13@0+ (0.02,-80.0) [-80.0|80.0] "m/s" ASDM
 SG_ FrntSideRdrLeDetn8RdrDetnSts : 91|2@0+ (1,0) [0|3] "" ASDM
 SG_ FrntSideRdrLeDetn9_UB : 234|1@0+ (1,0) [0|1] "" ASDM
 SG_ FrntSideRdrLeDetn9RdrDetnAzi : 199|11@0+ (0.1,-90.0) [-90.0|90.0] "Deg" ASDM
 SG_ FrntSideRdrLeDetn9RdrDetnChks : 167|8@0+ (1.0,0.0) [0.0|255.0] "Unitless" ASDM
 SG_ FrntSideRdrLeDetn9RdrDetnCntr : 175|4@0+ (1.0,0.0) [0.0|15.0] "Unitless" ASDM
 SG_ FrntSideRdrLeDetn9RdrDetnConf : 191|7@0+ (1.0,0.0) [0.0|100.0] "%" ASDM
 SG_ FrntSideRdrLeDetn9RdrDetnElevn : 239|5@0+ (1.0,-15.0) [-15.0|15.0] "Deg" ASDM
 SG_ FrntSideRdrLeDetn9RdrDetnPwr : 169|9@0+ (0.1,0.0) [0.0|51.1] "dB" ASDM
 SG_ FrntSideRdrLeDetn9RdrDetnRng : 223|14@0+ (0.02,-1.0) [-1.0|200.0] "m" ASDM
 SG_ FrntSideRdrLeDetn9RdrDetnRngV : 204|13@0+ (0.02,-80.0) [-80.0|80.0] "m/s" ASDM
 SG_ FrntSideRdrLeDetn9RdrDetnSts : 171|2@0+ (1,0) [0|3] "" ASDM

BO_ 308 FSRLSafetyCANFD1Frame03 : 64 FSRL
 SG_ FrntSideRdrLeDetn13_UB : 74|1@0+ (1,0) [0|1] "" ASDM
 SG_ FrntSideRdrLeDetn13RdrDetnAzi : 31|11@0+ (0.1,-90.0) [-90.0|90.0] "Deg" ASDM
 SG_ FrntSideRdrLeDetn13RdrDetnChks : 7|8@0+ (1.0,0.0) [0.0|255.0] "Unitless" ASDM
 SG_ FrntSideRdrLeDetn13RdrDetnCntr : 15|4@0+ (1.0,0.0) [0.0|15.0] "Unitless" ASDM
 SG_ FrntSideRdrLeDetn13RdrDetnConf : 71|7@0+ (1.0,0.0) [0.0|100.0] "%" ASDM
 SG_ FrntSideRdrLeDetn13RdrDetnElevn : 79|5@0+ (1.0,-15.0) [-15.0|15.0] "Deg" ASDM
 SG_ FrntSideRdrLeDetn13RdrDetnPwr : 8|9@0+ (0.1,0.0) [0.0|51.1] "dB" ASDM
 SG_ FrntSideRdrLeDetn13RdrDetnRng : 55|14@0+ (0.02,-1.0) [-1.0|200.0] "m" ASDM
 SG_ FrntSideRdrLeDetn13RdrDetnRngV : 36|13@0+ (0.02,-80.0) [-80.0|80.0] "m/s" ASDM
 SG_ FrntSideRdrLeDetn13RdrDetnSts : 11|2@0+ (1,0) [0|3] "" ASDM
 SG_ FrntSideRdrLeDetn14_UB : 154|1@0+ (1,0) [0|1] "" ASDM
 SG_ FrntSideRdrLeDetn14RdrDetnAzi : 119|11@0+ (0.1,-90.0) [-90.0|90.0] "Deg" ASDM
 SG_ FrntSideRdrLeDetn14RdrDetnChks : 87|8@0+ (1.0,0.0) [0.0|255.0] "Unitless" ASDM
 SG_ FrntSideRdrLeDetn14RdrDetnCntr : 95|4@0+ (1.0,0.0) [0.0|15.0] "Unitless" ASDM
 SG_ FrntSideRdrLeDetn14RdrDetnConf : 111|7@0+ (1.0,0.0) [0.0|100.0] "%" ASDM
 SG_ FrntSideRdrLeDetn14RdrDetnElevn : 159|5@0+ (1.0,-15.0) [-15.0|15.0] "Deg" ASDM
 SG_ FrntSideRdrLeDetn14RdrDetnPwr : 89|9@0+ (0.1,0.0) [0.0|51.1] "dB" ASDM
 SG_ FrntSideRdrLeDetn14RdrDetnRng : 143|14@0+ (0.02,-1.0) [-1.0|200.0] "m" ASDM
 SG_ FrntSideRdrLeDetn14RdrDetnRngV : 124|13@0+ (0.02,-80.0) [-80.0|80.0] "m/s" ASDM
 SG_ FrntSideRdrLeDetn14RdrDetnSts : 91|2@0+ (1,0) [0|3] "" ASDM
 SG_ FrntSideRdrLeDetn15_UB : 234|1@0+ (1,0) [0|1] "" ASDM
 SG_ FrntSideRdrLeDetn15RdrDetnAzi : 199|11@0+ (0.1,-90.0) [-90.0|90.0] "Deg" ASDM
 SG_ FrntSideRdrLeDetn15RdrDetnChks : 167|8@0+ (1.0,0.0) [0.0|255.0] "Unitless" ASDM
 SG_ FrntSideRdrLeDetn15RdrDetnCntr : 175|4@0+ (1.0,0.0) [0.0|15.0] "Unitless" ASDM
 SG_ FrntSideRdrLeDetn15RdrDetnConf : 191|7@0+ (1.0,0.0) [0.0|100.0] "%" ASDM
 SG_ FrntSideRdrLeDetn15RdrDetnElevn : 239|5@0+ (1.0,-15.0) [-15.0|15.0] "Deg" ASDM
 SG_ FrntSideRdrLeDetn15RdrDetnPwr : 169|9@0+ (0.1,0.0) [0.0|51.1] "dB" ASDM
 SG_ FrntSideRdrLeDetn15RdrDetnRng : 223|14@0+ (0.02,-1.0) [-1.0|200.0] "m" ASDM
 SG_ FrntSideRdrLeDetn15RdrDetnRngV : 204|13@0+ (0.02,-80.0) [-80.0|80.0] "m/s" ASDM
 SG_ FrntSideRdrLeDetn15RdrDetnSts : 171|2@0+ (1,0) [0|3] "" ASDM
 SG_ FrntSideRdrLeDetn16_UB : 314|1@0+ (1,0) [0|1] "" ASDM
 SG_ FrntSideRdrLeDetn16RdrDetnAzi : 287|11@0+ (0.1,-90.0) [-90.0|90.0] "Deg" ASDM
 SG_ FrntSideRdrLeDetn16RdrDetnChks : 247|8@0+ (1.0,0.0) [0.0|255.0] "Unitless" ASDM
 SG_ FrntSideRdrLeDetn16RdrDetnCntr : 255|4@0+ (1.0,0.0) [0.0|15.0] "Unitless" ASDM
 SG_ FrntSideRdrLeDetn16RdrDetnConf : 311|7@0+ (1.0,0.0) [0.0|100.0] "%" ASDM
 SG_ FrntSideRdrLeDetn16RdrDetnElevn : 319|5@0+ (1.0,-15.0) [-15.0|15.0] "Deg" ASDM
 SG_ FrntSideRdrLeDetn16RdrDetnPwr : 249|9@0+ (0.1,0.0) [0.0|51.1] "dB" ASDM
 SG_ FrntSideRdrLeDetn16RdrDetnRng : 271|14@0+ (0.02,-1.0) [-1.0|200.0] "m" ASDM
 SG_ FrntSideRdrLeDetn16RdrDetnRngV : 292|13@0+ (0.02,-80.0) [-80.0|80.0] "m/s" ASDM
 SG_ FrntSideRdrLeDetn16RdrDetnSts : 251|2@0+ (1,0) [0|3] "" ASDM
 SG_ FrntSideRdrLeDetn17_UB : 394|1@0+ (1,0) [0|1] "" ASDM
 SG_ FrntSideRdrLeDetn17RdrDetnAzi : 367|11@0+ (0.1,-90.0) [-90.0|90.0] "Deg" ASDM
 SG_ FrntSideRdrLeDetn17RdrDetnChks : 327|8@0+ (1.0,0.0) [0.0|255.0] "Unitless" ASDM
 SG_ FrntSideRdrLeDetn17RdrDetnCntr : 335|4@0+ (1.0,0.0) [0.0|15.0] "Unitless" ASDM
 SG_ FrntSideRdrLeDetn17RdrDetnConf : 391|7@0+ (1.0,0.0) [0.0|100.0] "%" ASDM
 SG_ FrntSideRdrLeDetn17RdrDetnElevn : 399|5@0+ (1.0,-15.0) [-15.0|15.0] "Deg" ASDM
 SG_ FrntSideRdrLeDetn17RdrDetnPwr : 329|9@0+ (0.1,0.0) [0.0|51.1] "dB" ASDM
 SG_ FrntSideRdrLeDetn17RdrDetnRng : 351|14@0+ (0.02,-1.0) [-1.0|200.0] "m" ASDM
 SG_ FrntSideRdrLeDetn17RdrDetnRngV : 372|13@0+ (0.02,-80.0) [-80.0|80.0] "m/s" ASDM
 SG_ FrntSideRdrLeDetn17RdrDetnSts : 331|2@0+ (1,0) [0|3] "" ASDM
 SG_ FrntSideRdrLeDetn18_UB : 474|1@0+ (1,0) [0|1] "" ASDM
 SG_ FrntSideRdrLeDetn18RdrDetnAzi : 447|11@0+ (0.1,-90.0) [-90.0|90.0] "Deg" ASDM
 SG_ FrntSideRdrLeDetn18RdrDetnChks : 407|8@0+ (1.0,0.0) [0.0|255.0] "Unitless" ASDM
 SG_ FrntSideRdrLeDetn18RdrDetnCntr : 415|4@0+ (1.0,0.0) [0.0|15.0] "Unitless" ASDM
 SG_ FrntSideRdrLeDetn18RdrDetnConf : 471|7@0+ (1.0,0.0) [0.0|100.0] "%" ASDM
 SG_ FrntSideRdrLeDetn18RdrDetnElevn : 479|5@0+ (1.0,-15.0) [-15.0|15.0] "Deg" ASDM
 SG_ FrntSideRdrLeDetn18RdrDetnPwr : 409|9@0+ (0.1,0.0) [0.0|51.1] "dB" ASDM
 SG_ FrntSideRdrLeDetn18RdrDetnRng : 431|14@0+ (0.02,-1.0) [-1.0|200.0] "m" ASDM
 SG_ FrntSideRdrLeDetn18RdrDetnRngV : 452|13@0+ (0.02,-80.0) [-80.0|80.0] "m/s" ASDM
 SG_ FrntSideRdrLeDetn18RdrDetnSts : 411|2@0+ (1,0) [0|3] "" ASDM

BO_ 310 FSRLSafetyCANFD1Frame04 : 64 FSRL
 SG_ FrntSideRdrLeDetn19_UB : 74|1@0+ (1,0) [0|1] "" ASDM
 SG_ FrntSideRdrLeDetn19RdrDetnAzi : 31|11@0+ (0.1,-90.0) [-90.0|90.0] "Deg" ASDM
 SG_ FrntSideRdrLeDetn19RdrDetnChks : 7|8@0+ (1.0,0.0) [0.0|255.0] "Unitless" ASDM
 SG_ FrntSideRdrLeDetn19RdrDetnCntr : 15|4@0+ (1.0,0.0) [0.0|15.0] "Unitless" ASDM
 SG_ FrntSideRdrLeDetn19RdrDetnConf : 71|7@0+ (1.0,0.0) [0.0|100.0] "%" ASDM
 SG_ FrntSideRdrLeDetn19RdrDetnElevn : 79|5@0+ (1.0,-15.0) [-15.0|15.0] "Deg" ASDM
 SG_ FrntSideRdrLeDetn19RdrDetnPwr : 8|9@0+ (0.1,0.0) [0.0|51.1] "dB" ASDM
 SG_ FrntSideRdrLeDetn19RdrDetnRng : 55|14@0+ (0.02,-1.0) [-1.0|200.0] "m" ASDM
 SG_ FrntSideRdrLeDetn19RdrDetnRngV : 36|13@0+ (0.02,-80.0) [-80.0|80.0] "m/s" ASDM
 SG_ FrntSideRdrLeDetn19RdrDetnSts : 11|2@0+ (1,0) [0|3] "" ASDM
 SG_ FrntSideRdrLeDetn20_UB : 154|1@0+ (1,0) [0|1] "" ASDM
 SG_ FrntSideRdrLeDetn20RdrDetnAzi : 119|11@0+ (0.1,-90.0) [-90.0|90.0] "Deg" ASDM
 SG_ FrntSideRdrLeDetn20RdrDetnChks : 87|8@0+ (1.0,0.0) [0.0|255.0] "Unitless" ASDM
 SG_ FrntSideRdrLeDetn20RdrDetnCntr : 95|4@0+ (1.0,0.0) [0.0|15.0] "Unitless" ASDM
 SG_ FrntSideRdrLeDetn20RdrDetnConf : 111|7@0+ (1.0,0.0) [0.0|100.0] "%" ASDM
 SG_ FrntSideRdrLeDetn20RdrDetnElevn : 159|5@0+ (1.0,-15.0) [-15.0|15.0] "Deg" ASDM
 SG_ FrntSideRdrLeDetn20RdrDetnPwr : 89|9@0+ (0.1,0.0) [0.0|51.1] "dB" ASDM
 SG_ FrntSideRdrLeDetn20RdrDetnRng : 143|14@0+ (0.02,-1.0) [-1.0|200.0] "m" ASDM
 SG_ FrntSideRdrLeDetn20RdrDetnRngV : 124|13@0+ (0.02,-80.0) [-80.0|80.0] "m/s" ASDM
 SG_ FrntSideRdrLeDetn20RdrDetnSts : 91|2@0+ (1,0) [0|3] "" ASDM
 SG_ FrntSideRdrLeDetn21_UB : 234|1@0+ (1,0) [0|1] "" ASDM
 SG_ FrntSideRdrLeDetn21RdrDetnAzi : 199|11@0+ (0.1,-90.0) [-90.0|90.0] "Deg" ASDM
 SG_ FrntSideRdrLeDetn21RdrDetnChks : 167|8@0+ (1.0,0.0) [0.0|255.0] "Unitless" ASDM
 SG_ FrntSideRdrLeDetn21RdrDetnCntr : 175|4@0+ (1.0,0.0) [0.0|15.0] "Unitless" ASDM
 SG_ FrntSideRdrLeDetn21RdrDetnConf : 191|7@0+ (1.0,0.0) [0.0|100.0] "%" ASDM
 SG_ FrntSideRdrLeDetn21RdrDetnElevn : 239|5@0+ (1.0,-15.0) [-15.0|15.0] "Deg" ASDM
 SG_ FrntSideRdrLeDetn21RdrDetnPwr : 169|9@0+ (0.1,0.0) [0.0|51.1] "dB" ASDM
 SG_ FrntSideRdrLeDetn21RdrDetnRng : 223|14@0+ (0.02,-1.0) [-1.0|200.0] "m" ASDM
 SG_ FrntSideRdrLeDetn21RdrDetnRngV : 204|13@0+ (0.02,-80.0) [-80.0|80.0] "m/s" ASDM
 SG_ FrntSideRdrLeDetn21RdrDetnSts : 171|2@0+ (1,0) [0|3] "" ASDM
 SG_ FrntSideRdrLeDetn22_UB : 314|1@0+ (1,0) [0|1] "" ASDM
 SG_ FrntSideRdrLeDetn22RdrDetnAzi : 287|11@0+ (0.1,-90.0) [-90.0|90.0] "Deg" ASDM
 SG_ FrntSideRdrLeDetn22RdrDetnChks : 247|8@0+ (1.0,0.0) [0.0|255.0] "Unitless" ASDM
 SG_ FrntSideRdrLeDetn22RdrDetnCntr : 255|4@0+ (1.0,0.0) [0.0|15.0] "Unitless" ASDM
 SG_ FrntSideRdrLeDetn22RdrDetnConf : 311|7@0+ (1.0,0.0) [0.0|100.0] "%" ASDM
 SG_ FrntSideRdrLeDetn22RdrDetnElevn : 319|5@0+ (1.0,-15.0) [-15.0|15.0] "Deg" ASDM
 SG_ FrntSideRdrLeDetn22RdrDetnPwr : 249|9@0+ (0.1,0.0) [0.0|51.1] "dB" ASDM
 SG_ FrntSideRdrLeDetn22RdrDetnRng : 271|14@0+ (0.02,-1.0) [-1.0|200.0] "m" ASDM
 SG_ FrntSideRdrLeDetn22RdrDetnRngV : 292|13@0+ (0.02,-80.0) [-80.0|80.0] "m/s" ASDM
 SG_ FrntSideRdrLeDetn22RdrDetnSts : 251|2@0+ (1,0) [0|3] "" ASDM
 SG_ FrntSideRdrLeDetn23_UB : 394|1@0+ (1,0) [0|1] "" ASDM
 SG_ FrntSideRdrLeDetn23RdrDetnAzi : 367|11@0+ (0.1,-90.0) [-90.0|90.0] "Deg" ASDM
 SG_ FrntSideRdrLeDetn23RdrDetnChks : 327|8@0+ (1.0,0.0) [0.0|255.0] "Unitless" ASDM
 SG_ FrntSideRdrLeDetn23RdrDetnCntr : 335|4@0+ (1.0,0.0) [0.0|15.0] "Unitless" ASDM
 SG_ FrntSideRdrLeDetn23RdrDetnConf : 391|7@0+ (1.0,0.0) [0.0|100.0] "%" ASDM
 SG_ FrntSideRdrLeDetn23RdrDetnElevn : 399|5@0+ (1.0,-15.0) [-15.0|15.0] "Deg" ASDM
 SG_ FrntSideRdrLeDetn23RdrDetnPwr : 329|9@0+ (0.1,0.0) [0.0|51.1] "dB" ASDM
 SG_ FrntSideRdrLeDetn23RdrDetnRng : 351|14@0+ (0.02,-1.0) [-1.0|200.0] "m" ASDM
 SG_ FrntSideRdrLeDetn23RdrDetnRngV : 372|13@0+ (0.02,-80.0) [-80.0|80.0] "m/s" ASDM
 SG_ FrntSideRdrLeDetn23RdrDetnSts : 331|2@0+ (1,0) [0|3] "" ASDM
 SG_ FrntSideRdrLeDetn24_UB : 474|1@0+ (1,0) [0|1] "" ASDM
 SG_ FrntSideRdrLeDetn24RdrDetnAzi : 447|11@0+ (0.1,-90.0) [-90.0|90.0] "Deg" ASDM
 SG_ FrntSideRdrLeDetn24RdrDetnChks : 407|8@0+ (1.0,0.0) [0.0|255.0] "Unitless" ASDM
 SG_ FrntSideRdrLeDetn24RdrDetnCntr : 415|4@0+ (1.0,0.0) [0.0|15.0] "Unitless" ASDM
 SG_ FrntSideRdrLeDetn24RdrDetnConf : 471|7@0+ (1.0,0.0) [0.0|100.0] "%" ASDM
 SG_ FrntSideRdrLeDetn24RdrDetnElevn : 479|5@0+ (1.0,-15.0) [-15.0|15.0] "Deg" ASDM
 SG_ FrntSideRdrLeDetn24RdrDetnPwr : 409|9@0+ (0.1,0.0) [0.0|51.1] "dB" ASDM
 SG_ FrntSideRdrLeDetn24RdrDetnRng : 431|14@0+ (0.02,-1.0) [-1.0|200.0] "m" ASDM
 SG_ FrntSideRdrLeDetn24RdrDetnRngV : 452|13@0+ (0.02,-80.0) [-80.0|80.0] "m/s" ASDM
 SG_ FrntSideRdrLeDetn24RdrDetnSts : 411|2@0+ (1,0) [0|3] "" ASDM

BO_ 312 FSRLSafetyCANFD1Frame05 : 64 FSRL
 SG_ FrntSideRdrLeDetn25_UB : 74|1@0+ (1,0) [0|1] "" ASDM
 SG_ FrntSideRdrLeDetn25RdrDetnAzi : 31|11@0+ (0.1,-90.0) [-90.0|90.0] "Deg" ASDM
 SG_ FrntSideRdrLeDetn25RdrDetnChks : 7|8@0+ (1.0,0.0) [0.0|255.0] "Unitless" ASDM
 SG_ FrntSideRdrLeDetn25RdrDetnCntr : 15|4@0+ (1.0,0.0) [0.0|15.0] "Unitless" ASDM
 SG_ FrntSideRdrLeDetn25RdrDetnConf : 71|7@0+ (1.0,0.0) [0.0|100.0] "%" ASDM
 SG_ FrntSideRdrLeDetn25RdrDetnElevn : 79|5@0+ (1.0,-15.0) [-15.0|15.0] "Deg" ASDM
 SG_ FrntSideRdrLeDetn25RdrDetnPwr : 8|9@0+ (0.1,0.0) [0.0|51.1] "dB" ASDM
 SG_ FrntSideRdrLeDetn25RdrDetnRng : 55|14@0+ (0.02,-1.0) [-1.0|200.0] "m" ASDM
 SG_ FrntSideRdrLeDetn25RdrDetnRngV : 36|13@0+ (0.02,-80.0) [-80.0|80.0] "m/s" ASDM
 SG_ FrntSideRdrLeDetn25RdrDetnSts : 11|2@0+ (1,0) [0|3] "" ASDM
 SG_ FrntSideRdrLeDetn26_UB : 154|1@0+ (1,0) [0|1] "" ASDM
 SG_ FrntSideRdrLeDetn26RdrDetnAzi : 119|11@0+ (0.1,-90.0) [-90.0|90.0] "Deg" ASDM
 SG_ FrntSideRdrLeDetn26RdrDetnChks : 87|8@0+ (1.0,0.0) [0.0|255.0] "Unitless" ASDM
 SG_ FrntSideRdrLeDetn26RdrDetnCntr : 95|4@0+ (1.0,0.0) [0.0|15.0] "Unitless" ASDM
 SG_ FrntSideRdrLeDetn26RdrDetnConf : 111|7@0+ (1.0,0.0) [0.0|100.0] "%" ASDM
 SG_ FrntSideRdrLeDetn26RdrDetnElevn : 159|5@0+ (1.0,-15.0) [-15.0|15.0] "Deg" ASDM
 SG_ FrntSideRdrLeDetn26RdrDetnPwr : 89|9@0+ (0.1,0.0) [0.0|51.1] "dB" ASDM
 SG_ FrntSideRdrLeDetn26RdrDetnRng : 143|14@0+ (0.02,-1.0) [-1.0|200.0] "m" ASDM
 SG_ FrntSideRdrLeDetn26RdrDetnRngV : 124|13@0+ (0.02,-80.0) [-80.0|80.0] "m/s" ASDM
 SG_ FrntSideRdrLeDetn26RdrDetnSts : 91|2@0+ (1,0) [0|3] "" ASDM
 SG_ FrntSideRdrLeDetn27_UB : 234|1@0+ (1,0) [0|1] "" ASDM
 SG_ FrntSideRdrLeDetn27RdrDetnAzi : 199|11@0+ (0.1,-90.0) [-90.0|90.0] "Deg" ASDM
 SG_ FrntSideRdrLeDetn27RdrDetnChks : 167|8@0+ (1.0,0.0) [0.0|255.0] "Unitless" ASDM
 SG_ FrntSideRdrLeDetn27RdrDetnCntr : 175|4@0+ (1.0,0.0) [0.0|15.0] "Unitless" ASDM
 SG_ FrntSideRdrLeDetn27RdrDetnConf : 191|7@0+ (1.0,0.0) [0.0|100.0] "%" ASDM
 SG_ FrntSideRdrLeDetn27RdrDetnElevn : 239|5@0+ (1.0,-15.0) [-15.0|15.0] "Deg" ASDM
 SG_ FrntSideRdrLeDetn27RdrDetnPwr : 169|9@0+ (0.1,0.0) [0.0|51.1] "dB" ASDM
 SG_ FrntSideRdrLeDetn27RdrDetnRng : 223|14@0+ (0.02,-1.0) [-1.0|200.0] "m" ASDM
 SG_ FrntSideRdrLeDetn27RdrDetnRngV : 204|13@0+ (0.02,-80.0) [-80.0|80.0] "m/s" ASDM
 SG_ FrntSideRdrLeDetn27RdrDetnSts : 171|2@0+ (1,0) [0|3] "" ASDM
 SG_ FrntSideRdrLeDetn28_UB : 314|1@0+ (1,0) [0|1] "" ASDM
 SG_ FrntSideRdrLeDetn28RdrDetnAzi : 287|11@0+ (0.1,-90.0) [-90.0|90.0] "Deg" ASDM
 SG_ FrntSideRdrLeDetn28RdrDetnChks : 247|8@0+ (1.0,0.0) [0.0|255.0] "Unitless" ASDM
 SG_ FrntSideRdrLeDetn28RdrDetnCntr : 255|4@0+ (1.0,0.0) [0.0|15.0] "Unitless" ASDM
 SG_ FrntSideRdrLeDetn28RdrDetnConf : 311|7@0+ (1.0,0.0) [0.0|100.0] "%" ASDM
 SG_ FrntSideRdrLeDetn28RdrDetnElevn : 319|5@0+ (1.0,-15.0) [-15.0|15.0] "Deg" ASDM
 SG_ FrntSideRdrLeDetn28RdrDetnPwr : 249|9@0+ (0.1,0.0) [0.0|51.1] "dB" ASDM
 SG_ FrntSideRdrLeDetn28RdrDetnRng : 271|14@0+ (0.02,-1.0) [-1.0|200.0] "m" ASDM
 SG_ FrntSideRdrLeDetn28RdrDetnRngV : 292|13@0+ (0.02,-80.0) [-80.0|80.0] "m/s" ASDM
 SG_ FrntSideRdrLeDetn28RdrDetnSts : 251|2@0+ (1,0) [0|3] "" ASDM
 SG_ FrntSideRdrLeDetn29_UB : 394|1@0+ (1,0) [0|1] "" ASDM
 SG_ FrntSideRdrLeDetn29RdrDetnAzi : 367|11@0+ (0.1,-90.0) [-90.0|90.0] "Deg" ASDM
 SG_ FrntSideRdrLeDetn29RdrDetnChks : 327|8@0+ (1.0,0.0) [0.0|255.0] "Unitless" ASDM
 SG_ FrntSideRdrLeDetn29RdrDetnCntr : 335|4@0+ (1.0,0.0) [0.0|15.0] "Unitless" ASDM
 SG_ FrntSideRdrLeDetn29RdrDetnConf : 391|7@0+ (1.0,0.0) [0.0|100.0] "%" ASDM
 SG_ FrntSideRdrLeDetn29RdrDetnElevn : 399|5@0+ (1.0,-15.0) [-15.0|15.0] "Deg" ASDM
 SG_ FrntSideRdrLeDetn29RdrDetnPwr : 329|9@0+ (0.1,0.0) [0.0|51.1] "dB" ASDM
 SG_ FrntSideRdrLeDetn29RdrDetnRng : 351|14@0+ (0.02,-1.0) [-1.0|200.0] "m" ASDM
 SG_ FrntSideRdrLeDetn29RdrDetnRngV : 372|13@0+ (0.02,-80.0) [-80.0|80.0] "m/s" ASDM
 SG_ FrntSideRdrLeDetn29RdrDetnSts : 331|2@0+ (1,0) [0|3] "" ASDM
 SG_ FrntSideRdrLeDetn30_UB : 474|1@0+ (1,0) [0|1] "" ASDM
 SG_ FrntSideRdrLeDetn30RdrDetnAzi : 447|11@0+ (0.1,-90.0) [-90.0|90.0] "Deg" ASDM
 SG_ FrntSideRdrLeDetn30RdrDetnChks : 407|8@0+ (1.0,0.0) [0.0|255.0] "Unitless" ASDM
 SG_ FrntSideRdrLeDetn30RdrDetnCntr : 415|4@0+ (1.0,0.0) [0.0|15.0] "Unitless" ASDM
 SG_ FrntSideRdrLeDetn30RdrDetnConf : 471|7@0+ (1.0,0.0) [0.0|100.0] "%" ASDM
 SG_ FrntSideRdrLeDetn30RdrDetnElevn : 479|5@0+ (1.0,-15.0) [-15.0|15.0] "Deg" ASDM
 SG_ FrntSideRdrLeDetn30RdrDetnPwr : 409|9@0+ (0.1,0.0) [0.0|51.1] "dB" ASDM
 SG_ FrntSideRdrLeDetn30RdrDetnRng : 431|14@0+ (0.02,-1.0) [-1.0|200.0] "m" ASDM
 SG_ FrntSideRdrLeDetn30RdrDetnRngV : 452|13@0+ (0.02,-80.0) [-80.0|80.0] "m/s" ASDM
 SG_ FrntSideRdrLeDetn30RdrDetnSts : 411|2@0+ (1,0) [0|3] "" ASDM

BO_ 314 FSRLSafetyCANFD1Frame06 : 64 FSRL
 SG_ FrntSideRdrLeDetn31_UB : 74|1@0+ (1,0) [0|1] "" ASDM
 SG_ FrntSideRdrLeDetn31RdrDetnAzi : 31|11@0+ (0.1,-90.0) [-90.0|90.0] "Deg" ASDM
 SG_ FrntSideRdrLeDetn31RdrDetnChks : 7|8@0+ (1.0,0.0) [0.0|255.0] "Unitless" ASDM
 SG_ FrntSideRdrLeDetn31RdrDetnCntr : 15|4@0+ (1.0,0.0) [0.0|15.0] "Unitless" ASDM
 SG_ FrntSideRdrLeDetn31RdrDetnConf : 71|7@0+ (1.0,0.0) [0.0|100.0] "%" ASDM
 SG_ FrntSideRdrLeDetn31RdrDetnElevn : 79|5@0+ (1.0,-15.0) [-15.0|15.0] "Deg" ASDM
 SG_ FrntSideRdrLeDetn31RdrDetnPwr : 8|9@0+ (0.1,0.0) [0.0|51.1] "dB" ASDM
 SG_ FrntSideRdrLeDetn31RdrDetnRng : 55|14@0+ (0.02,-1.0) [-1.0|200.0] "m" ASDM
 SG_ FrntSideRdrLeDetn31RdrDetnRngV : 36|13@0+ (0.02,-80.0) [-80.0|80.0] "m/s" ASDM
 SG_ FrntSideRdrLeDetn31RdrDetnSts : 11|2@0+ (1,0) [0|3] "" ASDM
 SG_ FrntSideRdrLeDetn32_UB : 154|1@0+ (1,0) [0|1] "" ASDM
 SG_ FrntSideRdrLeDetn32RdrDetnAzi : 119|11@0+ (0.1,-90.0) [-90.0|90.0] "Deg" ASDM
 SG_ FrntSideRdrLeDetn32RdrDetnChks : 87|8@0+ (1.0,0.0) [0.0|255.0] "Unitless" ASDM
 SG_ FrntSideRdrLeDetn32RdrDetnCntr : 95|4@0+ (1.0,0.0) [0.0|15.0] "Unitless" ASDM
 SG_ FrntSideRdrLeDetn32RdrDetnConf : 111|7@0+ (1.0,0.0) [0.0|100.0] "%" ASDM
 SG_ FrntSideRdrLeDetn32RdrDetnElevn : 159|5@0+ (1.0,-15.0) [-15.0|15.0] "Deg" ASDM
 SG_ FrntSideRdrLeDetn32RdrDetnPwr : 89|9@0+ (0.1,0.0) [0.0|51.1] "dB" ASDM
 SG_ FrntSideRdrLeDetn32RdrDetnRng : 143|14@0+ (0.02,-1.0) [-1.0|200.0] "m" ASDM
 SG_ FrntSideRdrLeDetn32RdrDetnRngV : 124|13@0+ (0.02,-80.0) [-80.0|80.0] "m/s" ASDM
 SG_ FrntSideRdrLeDetn32RdrDetnSts : 91|2@0+ (1,0) [0|3] "" ASDM
 SG_ FrntSideRdrLeDetn33_UB : 234|1@0+ (1,0) [0|1] "" ASDM
 SG_ FrntSideRdrLeDetn33RdrDetnAzi : 199|11@0+ (0.1,-90.0) [-90.0|90.0] "Deg" ASDM
 SG_ FrntSideRdrLeDetn33RdrDetnChks : 167|8@0+ (1.0,0.0) [0.0|255.0] "Unitless" ASDM
 SG_ FrntSideRdrLeDetn33RdrDetnCntr : 175|4@0+ (1.0,0.0) [0.0|15.0] "Unitless" ASDM
 SG_ FrntSideRdrLeDetn33RdrDetnConf : 191|7@0+ (1.0,0.0) [0.0|100.0] "%" ASDM
 SG_ FrntSideRdrLeDetn33RdrDetnElevn : 239|5@0+ (1.0,-15.0) [-15.0|15.0] "Deg" ASDM
 SG_ FrntSideRdrLeDetn33RdrDetnPwr : 169|9@0+ (0.1,0.0) [0.0|51.1] "dB" ASDM
 SG_ FrntSideRdrLeDetn33RdrDetnRng : 223|14@0+ (0.02,-1.0) [-1.0|200.0] "m" ASDM
 SG_ FrntSideRdrLeDetn33RdrDetnRngV : 204|13@0+ (0.02,-80.0) [-80.0|80.0] "m/s" ASDM
 SG_ FrntSideRdrLeDetn33RdrDetnSts : 171|2@0+ (1,0) [0|3] "" ASDM
 SG_ FrntSideRdrLeDetn34_UB : 314|1@0+ (1,0) [0|1] "" ASDM
 SG_ FrntSideRdrLeDetn34RdrDetnAzi : 287|11@0+ (0.1,-90.0) [-90.0|90.0] "Deg" ASDM
 SG_ FrntSideRdrLeDetn34RdrDetnChks : 247|8@0+ (1.0,0.0) [0.0|255.0] "Unitless" ASDM
 SG_ FrntSideRdrLeDetn34RdrDetnCntr : 255|4@0+ (1.0,0.0) [0.0|15.0] "Unitless" ASDM
 SG_ FrntSideRdrLeDetn34RdrDetnConf : 311|7@0+ (1.0,0.0) [0.0|100.0] "%" ASDM
 SG_ FrntSideRdrLeDetn34RdrDetnElevn : 319|5@0+ (1.0,-15.0) [-15.0|15.0] "Deg" ASDM
 SG_ FrntSideRdrLeDetn34RdrDetnPwr : 249|9@0+ (0.1,0.0) [0.0|51.1] "dB" ASDM
 SG_ FrntSideRdrLeDetn34RdrDetnRng : 271|14@0+ (0.02,-1.0) [-1.0|200.0] "m" ASDM
 SG_ FrntSideRdrLeDetn34RdrDetnRngV : 292|13@0+ (0.02,-80.0) [-80.0|80.0] "m/s" ASDM
 SG_ FrntSideRdrLeDetn34RdrDetnSts : 251|2@0+ (1,0) [0|3] "" ASDM
 SG_ FrntSideRdrLeDetn35_UB : 394|1@0+ (1,0) [0|1] "" ASDM
 SG_ FrntSideRdrLeDetn35RdrDetnAzi : 367|11@0+ (0.1,-90.0) [-90.0|90.0] "Deg" ASDM
 SG_ FrntSideRdrLeDetn35RdrDetnChks : 327|8@0+ (1.0,0.0) [0.0|255.0] "Unitless" ASDM
 SG_ FrntSideRdrLeDetn35RdrDetnCntr : 335|4@0+ (1.0,0.0) [0.0|15.0] "Unitless" ASDM
 SG_ FrntSideRdrLeDetn35RdrDetnConf : 391|7@0+ (1.0,0.0) [0.0|100.0] "%" ASDM
 SG_ FrntSideRdrLeDetn35RdrDetnElevn : 399|5@0+ (1.0,-15.0) [-15.0|15.0] "Deg" ASDM
 SG_ FrntSideRdrLeDetn35RdrDetnPwr : 329|9@0+ (0.1,0.0) [0.0|51.1] "dB" ASDM
 SG_ FrntSideRdrLeDetn35RdrDetnRng : 351|14@0+ (0.02,-1.0) [-1.0|200.0] "m" ASDM
 SG_ FrntSideRdrLeDetn35RdrDetnRngV : 372|13@0+ (0.02,-80.0) [-80.0|80.0] "m/s" ASDM
 SG_ FrntSideRdrLeDetn35RdrDetnSts : 331|2@0+ (1,0) [0|3] "" ASDM
 SG_ FrntSideRdrLeDetn36_UB : 474|1@0+ (1,0) [0|1] "" ASDM
 SG_ FrntSideRdrLeDetn36RdrDetnAzi : 447|11@0+ (0.1,-90.0) [-90.0|90.0] "Deg" ASDM
 SG_ FrntSideRdrLeDetn36RdrDetnChks : 407|8@0+ (1.0,0.0) [0.0|255.0] "Unitless" ASDM
 SG_ FrntSideRdrLeDetn36RdrDetnCntr : 415|4@0+ (1.0,0.0) [0.0|15.0] "Unitless" ASDM
 SG_ FrntSideRdrLeDetn36RdrDetnConf : 471|7@0+ (1.0,0.0) [0.0|100.0] "%" ASDM
 SG_ FrntSideRdrLeDetn36RdrDetnElevn : 479|5@0+ (1.0,-15.0) [-15.0|15.0] "Deg" ASDM
 SG_ FrntSideRdrLeDetn36RdrDetnPwr : 409|9@0+ (0.1,0.0) [0.0|51.1] "dB" ASDM
 SG_ FrntSideRdrLeDetn36RdrDetnRng : 431|14@0+ (0.02,-1.0) [-1.0|200.0] "m" ASDM
 SG_ FrntSideRdrLeDetn36RdrDetnRngV : 452|13@0+ (0.02,-80.0) [-80.0|80.0] "m/s" ASDM
 SG_ FrntSideRdrLeDetn36RdrDetnSts : 411|2@0+ (1,0) [0|3] "" ASDM

// Node Comments
CM_ BU_ ETC "External Tester Connector";

// Signal Comments
CM_ SG_ 288 ADataRawSafeALat "IMU acceleration data Lateral acceleration";
CM_ SG_ 288 ADataRawSafeALat1Qf "IMU acceleration data Quality factor for Lateral acceleration signal";
CM_ SG_ 288 ADataRawSafeALgt "IMU acceleration data Longitudinal acceleration";
CM_ SG_ 288 ADataRawSafeALgt1Qf "IMU acceleration data Quality factor for Longitudinal acceleration";
CM_ SG_ 288 ADataRawSafeAVert "IMU acceleration data Vertical acceleration";
CM_ SG_ 288 ADataRawSafeAVertQf "IMU acceleration data Quality factor for Vertical acceleration";
CM_ SG_ 288 ADataRawSafeChks "IMU acceleration data Check sum";
CM_ SG_ 288 ADataRawSafeCntr "IMU acceleration data Counter";
CM_ SG_ 288 ALgtStdFromWhlSpdALgtStdFromWhlSpd "Longitudinal acceleration over ground.
end2endprotection=profile1A dataid= 12345 Longitudinal acceleration over ground";
CM_ SG_ 288 ALgtStdFromWhlSpdChks "Longitudinal acceleration over ground.
end2endprotection=profile1A dataid=12345 Checksum for longitudinal acceleration over ground";
CM_ SG_ 288 ALgtStdFromWhlSpdCntr "Longitudinal acceleration over ground.
end2endprotection=profile1A dataid=12345 Counter for longitudinal acceleration over ground";
CM_ SG_ 288 ALgtStdFromWhlSpdQf "Longitudinal acceleration over ground.
end2endprotection=profile1A dataid=12345 Qf for longitudinal acceleration over ground";
CM_ SG_ 288 AmbTRawAmbTVal "Unfiltered ambient temp raw data in deg C. Ambient temp value";
CM_ SG_ 288 AmbTRawQly "Unfiltered ambient temp raw data in deg C. Quality Factor of the ambient temp";
CM_ SG_ 288 AsyDataWithCmpSafeALat1Qf "IMU processed special data. Quality factor for Lateral acceleration signal";
CM_ SG_ 288 AsyDataWithCmpSafeALatWithCmp "IMU processed special data.  Compensated Lateral acceleration";
CM_ SG_ 288 AsyDataWithCmpSafeALgt1Qf "IMU processed special data. Quality factor for Longitudinal acceleration";
CM_ SG_ 288 AsyDataWithCmpSafeChks "IMU processed special data. Check sum";
CM_ SG_ 288 AsyDataWithCmpSafeCntr "IMU processed special data. Counter";
CM_ SG_ 288 AsyDataWithCmpSafeGrdtOfALgt "IMU processed special data. Derivative of Longitudinal acceleration";
CM_ SG_ 288 AsyDataWithCmpSafeYawRateQf "IMU processed special data. Quality Factor for Yaw Rate";
CM_ SG_ 288 AsyDataWithCmpSafeYawRateWithCmp "IMU processed special data. Compensated Yaw rate";
CM_ SG_ 288 BkpOfDstTrvld "total traveled distance.";
CM_ SG_ 288 CarTiGlb "Presents a tiime value that shall be used by all ECUs to time-stamp diagnsotic trouble codes (DTC) according to the requirements for Global DTC snapshot data.";
CM_ SG_ 288 DrvModReq "drive mode";
CM_ SG_ 288 PinionSteerAgGroupChks "Checksum for PinionSteerAgGroup";
CM_ SG_ 288 PinionSteerAgGroupCntr "Counter for PinionSteerAgGroup";
CM_ SG_ 288 PinionSteerAgGroupPinionSteerAg1 "Calculated pinion steer angle at the front steering device";
CM_ SG_ 288 PinionSteerAgGroupPinionSteerAg1Qf "Quality factor for PinionSteerAg1";
CM_ SG_ 288 PinionSteerAgGroupPinionSteerAgSpd1 "Calculated pinion steer angle speed at the front steering device ";
CM_ SG_ 288 PinionSteerAgGroupPinionSteerAgSpd1Qf "Quality factor for PinionSteerAgSpd1";
CM_ SG_ 288 PinionSteerAgGroupSteerWhlTq "Torque on steering wheel";
CM_ SG_ 288 PinionSteerAgGroupSteerWhlTqQf "Quality factor for SteerWhlTq";
CM_ SG_ 288 RainfallAmnt "The signal describe the amount of rain falling";
CM_ SG_ 288 SteerWhlSnsrAg "Actual steering wheel angle from the actual centre position of the steering wheel. ";
CM_ SG_ 288 SteerWhlSnsrAgSpd "Actual steering wheel angle from the actual centre position of the steering wheel. Steering angle speed with steering wheel rotation direction.  ";
CM_ SG_ 288 SteerWhlSnsrChks "Checksum for steering wheel sensor data.";
CM_ SG_ 288 SteerWhlSnsrCntr "Counter value for steering wheel sensor data.";
CM_ SG_ 288 SteerWhlSnsrQf "Qf for steering wheel sensor information";
CM_ SG_ 288 VehBattUSysU "Vehicle System Voltage At 12V side";
CM_ SG_ 288 VehBattUSysUQf "Present vehicle voltage measured by CEM with QF";
CM_ SG_ 288 VehModMngtGlbSafe1CarModSts1 "CarMode Status";
CM_ SG_ 288 VehModMngtGlbSafe1CarModSubtypWdCarModSubtyp "CarMode substate status";
CM_ SG_ 288 VehModMngtGlbSafe1Chks "Checksum";
CM_ SG_ 288 VehModMngtGlbSafe1Cntr "Counter";
CM_ SG_ 288 VehModMngtGlbSafe1EgyLvlElecMai "Main energy level in the vehicle.";
CM_ SG_ 288 VehModMngtGlbSafe1EgyLvlElecSubtyp "Substate of the energy level in the vehicle.";
CM_ SG_ 288 VehModMngtGlbSafe1FltEgyCnsWdSts "High quiescent current detected by CEM via BMS.";
CM_ SG_ 288 VehModMngtGlbSafe1PwrLvlElecMai "Main Power level in the vehicle.";
CM_ SG_ 288 VehModMngtGlbSafe1PwrLvlElecSubtyp "Substate of the power level in the vehicle.";
CM_ SG_ 288 VehModMngtGlbSafe1UsgModSts "UsageMode Status";
CM_ SG_ 288 VehMtnStChks "Vehicle motion state information based on wheel speed sensors. Provides information about vehicle stand still and vehicle rolling direction. Checksum for vehicle motion state";
CM_ SG_ 288 VehMtnStCntr "Vehicle motion state information based on wheel speed sensors. Provides information about vehicle stand still and vehicle rolling direction. Counter for vehicle motion state";
CM_ SG_ 288 VehMtnStVehMtnSt "Vehicle motion state information based on wheel speed sensors. Provides information about vehicle stand still and vehicle rolling direction. Vehicle motion state";
CM_ SG_ 288 VehSpdLgtA "Vehicle speed longitudinal based on wheel speed sensors and longitudinal acceleration.";
CM_ SG_ 288 VehSpdLgtChks "Checksum";
CM_ SG_ 288 VehSpdLgtCntr "Counter";
CM_ SG_ 288 VehSpdLgtQf "Quality factor for vehicle speed as measured by wheel speed sensors and longitudinal acceleration.";
CM_ SG_ 288 WipgInfoWipgSpdInfo "Information regarding how the wipers are run";
CM_ SG_ 288 WipgInfoWiprActv " 0 No wiping, 1 Wiping";
CM_ SG_ 288 WipgInfoWiprInWipgAr " 0 Wiper in lower reversing area or parked, 1 Wiper in wiping area";
CM_ SG_ 1007 FrntSideRdrLeVehPrmRdrVehPrmChks "CRC";
CM_ SG_ 1007 FrntSideRdrLeVehPrmRdrVehPrmCntr "Counter";
CM_ SG_ 1007 FrntSideRdrLeVehPrmRdrVehPrmRdrDynCalPrmForAgOffs "Angle offset due to facia effects";
CM_ SG_ 1007 FrntSideRdrLeVehPrmRdrVehPrmRdrDynCalPrmForAxleDstReToVehFrnt "Distance from rear axel to vehicle front";
CM_ SG_ 1007 FrntSideRdrLeVehPrmRdrVehPrmRdrDynCalPrmForPinoinAgRat "Ration between pinion angle and wheel angle";
CM_ SG_ 1007 FrntSideRdrLeVehPrmRdrVehPrmRdrDynCalPrmForRollAgGain "the compliance of the rear corner suspension";
CM_ SG_ 1007 FrntSideRdrLeVehPrmRdrVehPrmRdrDynCalPrmForSnsrDir "Sensor direction in relation to the vehicle driving direction";
CM_ SG_ 1007 FrntSideRdrLeVehPrmRdrVehPrmRdrDynCalPrmForSnsrOrntn "Direction of Sensor connector point.";
CM_ SG_ 1007 FrntSideRdrLeVehPrmRdrVehPrmRdrDynCalPrmForSnsrPosnLat "Sensor lateral position in relation to the vehicle reference point";
CM_ SG_ 1007 FrntSideRdrLeVehPrmRdrVehPrmRdrDynCalPrmForSnsrPosnLgt "Sensor longitudinal position in relation to the vehicle reference point";
CM_ SG_ 1007 FrntSideRdrLeVehPrmRdrVehPrmRdrDynCalPrmForSnsrPosnVert "Sensor vertical position in relation to ground";
CM_ SG_ 1007 FrntSideRdrLeVehPrmRdrVehPrmRdrDynCalPrmForSnsrRot1 "Sensor rotation";
CM_ SG_ 1007 FrntSideRdrLeVehPrmRdrVehPrmRdrDynCalPrmForVehLen "Vehicle length";
CM_ SG_ 1007 FrntSideRdrLeVehPrmRdrVehPrmRdrDynCalPrmForVehTyp "Vehicle type";
CM_ SG_ 1007 FrntSideRdrLeVehPrmRdrVehPrmRdrDynCalPrmForVehWidth "Vehicle width";
CM_ SG_ 1007 FrntSideRdrLeVehPrmRdrVehPrmRdrDynCalPrmForVersMajor "Major version for dynamic calibration parameters.";
CM_ SG_ 1007 FrntSideRdrLeVehPrmRdrVehPrmRdrDynCalPrmForVersMinor "Minor version for dynamic calibration parameters";
CM_ SG_ 1007 FrntSideRdrLeVehPrmRdrVehPrmRdrDynCalPrmForWhlBas "Vehicle wheel base";
CM_ SG_ 1007 FrntSideRdrLeVehPrmRdrVehPrmVld "Validity of data, if it is not valid, then set to 0";
CM_ SG_ 1007 FrntSideRdrRiVehPrmRdrVehPrmChks "CRC";
CM_ SG_ 1007 FrntSideRdrRiVehPrmRdrVehPrmCntr "Counter";
CM_ SG_ 1007 FrntSideRdrRiVehPrmRdrVehPrmRdrDynCalPrmForAgOffs "Angle offset due to facia effects";
CM_ SG_ 1007 FrntSideRdrRiVehPrmRdrVehPrmRdrDynCalPrmForAxleDstReToVehFrnt "Distance from rear axel to vehicle front";
CM_ SG_ 1007 FrntSideRdrRiVehPrmRdrVehPrmRdrDynCalPrmForPinoinAgRat "Ration between pinion angle and wheel angle";
CM_ SG_ 1007 FrntSideRdrRiVehPrmRdrVehPrmRdrDynCalPrmForRollAgGain "the compliance of the rear corner suspension";
CM_ SG_ 1007 FrntSideRdrRiVehPrmRdrVehPrmRdrDynCalPrmForSnsrDir "Sensor direction in relation to the vehicle driving direction";
CM_ SG_ 1007 FrntSideRdrRiVehPrmRdrVehPrmRdrDynCalPrmForSnsrOrntn "Direction of Sensor connector point.";
CM_ SG_ 1007 FrntSideRdrRiVehPrmRdrVehPrmRdrDynCalPrmForSnsrPosnLat "Sensor lateral position in relation to the vehicle reference point";
CM_ SG_ 1007 FrntSideRdrRiVehPrmRdrVehPrmRdrDynCalPrmForSnsrPosnLgt "Sensor longitudinal position in relation to the vehicle reference point";
CM_ SG_ 1007 FrntSideRdrRiVehPrmRdrVehPrmRdrDynCalPrmForSnsrPosnVert "Sensor vertical position in relation to ground";
CM_ SG_ 1007 FrntSideRdrRiVehPrmRdrVehPrmRdrDynCalPrmForSnsrRot1 "Sensor rotation";
CM_ SG_ 1007 FrntSideRdrRiVehPrmRdrVehPrmRdrDynCalPrmForVehLen "Vehicle length";
CM_ SG_ 1007 FrntSideRdrRiVehPrmRdrVehPrmRdrDynCalPrmForVehTyp "Vehicle type";
CM_ SG_ 1007 FrntSideRdrRiVehPrmRdrVehPrmRdrDynCalPrmForVehWidth "Vehicle width";
CM_ SG_ 1007 FrntSideRdrRiVehPrmRdrVehPrmRdrDynCalPrmForVersMajor "Major version for dynamic calibration parameters.";
CM_ SG_ 1007 FrntSideRdrRiVehPrmRdrVehPrmRdrDynCalPrmForVersMinor "Minor version for dynamic calibration parameters";
CM_ SG_ 1007 FrntSideRdrRiVehPrmRdrVehPrmRdrDynCalPrmForWhlBas "Vehicle wheel base";
CM_ SG_ 1007 FrntSideRdrRiVehPrmRdrVehPrmVld "Validity of data, if it is not valid, then set to 0";
CM_ SG_ 1007 TiAndDateIndcnDataValid "Current time (Hr, Min and Sec) and date (Year, Months and days) data for indication. See requirement for more information about the signals. Signal qualifier, No means values should be ignored.";
CM_ SG_ 1007 TiAndDateIndcnDay "Current time (Hr, Min and Sec) and date (Year, Months and days) data for indication. See requirement for more information about the signals. Day";
CM_ SG_ 1007 TiAndDateIndcnHr1 "Current time (Hr, Min and Sec) and date (Year, Months and days) data for indication. See requirement for more information about the signals. Hour";
CM_ SG_ 1007 TiAndDateIndcnMins1 "Current time (Hr, Min and Sec) and date (Year, Months and days) data for indication. See requirement for more information about the signals. Minutes";
CM_ SG_ 1007 TiAndDateIndcnMth1 "Current time (Hr, Min and Sec) and date (Year, Months and days) data for indication. See requirement for more information about the signals. Month, 1-12";
CM_ SG_ 1007 TiAndDateIndcnSec1 "Current time (Hr, Min and Sec) and date (Year, Months and days) data for indication. See requirement for more information about the signals. Seconds";
CM_ SG_ 1007 TiAndDateIndcnYr1 "Current time (Hr, Min and Sec) and date (Year, Months and days) data for indication. See requirement for more information about the signals. Year, 0-99";
CM_ SG_ 297 FrntSideRdrLeStsForDim "Front side left radar state information which will be shown on DIM or IHU";
CM_ SG_ 297 FrntSideRdrLeStsRdrNrDetn "Number of detections";
CM_ SG_ 297 FrntSideRdrLeStsRdrNrObj "Number of objects";
CM_ SG_ 297 FrntSideRdrLeStsRdrStsBlkd0bin "Blockage flag for 0bin";
CM_ SG_ 297 FrntSideRdrLeStsRdrStsBlkdConf "Confidence of radar blockage";
CM_ SG_ 297 FrntSideRdrLeStsRdrStsChks "Checksum";
CM_ SG_ 297 FrntSideRdrLeStsRdrStsCntr "Counter";
CM_ SG_ 297 FrntSideRdrLeStsRdrStsDstbc "Indication of radar interference, 0 means no interference, 100 means the radar fully saturated from interference";
CM_ SG_ 297 FrntSideRdrLeStsRdrStsEna "Indication whether radar functionality is enabled";
CM_ SG_ 297 FrntSideRdrLeStsRdrStsFaulty "Indication whether radar is faulty";
CM_ SG_ 297 FrntSideRdrLeStsRdrStsIfVersMajor "Interface version major";
CM_ SG_ 297 FrntSideRdrLeStsRdrStsIfVersMinor "Interface version minor";
CM_ SG_ 297 FrntSideRdrLeStsRdrStsLatency "The latency definition is the time instance starting from the end of the last measurement acquisition per cycle to the CAN-FD frames being outputted on the CAN-FD bus. The unit of latency is ms.";
CM_ SG_ 297 FrntSideRdrLeStsRdrStsMisAlign "0, calibration not start. 1, successfully calibrated in factory or after-sales. 2, successfully auto-calibrated. 3, misalignment degree is larger than threshold, static calibration fail. 4, can not be calibrated statically cause other reason. 5, auto-calibrate fail (cause the misalignment degree is larger than threshold or other reason). 6, misalignment degree is larger than threshold, dynamic calibration fail in factory or after-sales. 7, can not be calibrated dynamically cause other reason.";
CM_ SG_ 297 FrntSideRdrLeStsRdrStsMissCom "Signal used to detect missing communication from radar. Reserved.";
CM_ SG_ 297 FrntSideRdrLeStsRdrStsSftyFlt "Safety faulty status";
CM_ SG_ 297 FrntSideRdrLeStsRdrStsTiStamp "Timestamp";
CM_ SG_ 297 FrntSideRdrLeStsRdrStsTiStampStsGlbTiBas "Time synchronization status - synchronized to global time base";
CM_ SG_ 297 FrntSideRdrLeStsRdrStsTiStampStsSyncToGatewy "Time synchronization status - synchronized to gateway";
CM_ SG_ 297 FrntSideRdrLeStsRdrStsTiStampStsTiLeap "Time synchronization status - time leap";
CM_ SG_ 297 FrntSideRdrLeStsRdrStsTiStampStsTiOut "Time synchronization status - time out";
CM_ SG_ 297 FrntSideRdrLeStsRdrStsWhlSpdCmpFac "reserved, not use";
CM_ SG_ 304 FrntSideRdrLeDetn1RdrDetnAzi "Azimuth Angle";
CM_ SG_ 304 FrntSideRdrLeDetn1RdrDetnChks "CRC";
CM_ SG_ 304 FrntSideRdrLeDetn1RdrDetnCntr "Counter";
CM_ SG_ 304 FrntSideRdrLeDetn1RdrDetnConf "Quality";
CM_ SG_ 304 FrntSideRdrLeDetn1RdrDetnElevn "Elevation Angle";
CM_ SG_ 304 FrntSideRdrLeDetn1RdrDetnPwr "Signal noise ratio";
CM_ SG_ 304 FrntSideRdrLeDetn1RdrDetnRng "Range";
CM_ SG_ 304 FrntSideRdrLeDetn1RdrDetnRngV "Range velocity ";
CM_ SG_ 304 FrntSideRdrLeDetn1RdrDetnSts "Detection type";
CM_ SG_ 304 FrntSideRdrLeDetn2RdrDetnAzi "Refer to the data element description in FrntSideRdrLeDetn1 with the same data element name.";
CM_ SG_ 304 FrntSideRdrLeDetn2RdrDetnChks "Refer to the data element description in FrntSideRdrLeDetn1 with the same data element name.";
CM_ SG_ 304 FrntSideRdrLeDetn2RdrDetnCntr "Refer to the data element description in FrntSideRdrLeDetn1 with the same data element name.";
CM_ SG_ 304 FrntSideRdrLeDetn2RdrDetnConf "Refer to the data element description in FrntSideRdrLeDetn1 with the same data element name.";
CM_ SG_ 304 FrntSideRdrLeDetn2RdrDetnElevn "Refer to the data element description in FrntSideRdrLeDetn1 with the same data element name.";
CM_ SG_ 304 FrntSideRdrLeDetn2RdrDetnPwr "Refer to the data element description in FrntSideRdrLeDetn1 with the same data element name.";
CM_ SG_ 304 FrntSideRdrLeDetn2RdrDetnRng "Refer to the data element description in FrntSideRdrLeDetn1 with the same data element name.";
CM_ SG_ 304 FrntSideRdrLeDetn2RdrDetnRngV "Range velocity ";
CM_ SG_ 304 FrntSideRdrLeDetn2RdrDetnSts "Refer to the data element description in FrntSideRdrLeDetn1 with the same data element name.";
CM_ SG_ 304 FrntSideRdrLeDetn3RdrDetnAzi "Refer to the data element description in FrntSideRdrLeDetn1 with the same data element name.";
CM_ SG_ 304 FrntSideRdrLeDetn3RdrDetnChks "Refer to the data element description in FrntSideRdrLeDetn1 with the same data element name.";
CM_ SG_ 304 FrntSideRdrLeDetn3RdrDetnCntr "Refer to the data element description in FrntSideRdrLeDetn1 with the same data element name.";
CM_ SG_ 304 FrntSideRdrLeDetn3RdrDetnConf "Refer to the data element description in FrntSideRdrLeDetn1 with the same data element name.";
CM_ SG_ 304 FrntSideRdrLeDetn3RdrDetnElevn "Refer to the data element description in FrntSideRdrLeDetn1 with the same data element name.";
CM_ SG_ 304 FrntSideRdrLeDetn3RdrDetnPwr "Refer to the data element description in FrntSideRdrLeDetn1 with the same data element name.";
CM_ SG_ 304 FrntSideRdrLeDetn3RdrDetnRng "Refer to the data element description in FrntSideRdrLeDetn1 with the same data element name.";
CM_ SG_ 304 FrntSideRdrLeDetn3RdrDetnRngV "Range velocity ";
CM_ SG_ 304 FrntSideRdrLeDetn3RdrDetnSts "Refer to the data element description in FrntSideRdrLeDetn1 with the same data element name.";
CM_ SG_ 304 FrntSideRdrLeDetn4RdrDetnAzi "Refer to the data element description in FrntSideRdrLeDetn1 with the same data element name.";
CM_ SG_ 304 FrntSideRdrLeDetn4RdrDetnChks "Refer to the data element description in FrntSideRdrLeDetn1 with the same data element name.";
CM_ SG_ 304 FrntSideRdrLeDetn4RdrDetnCntr "Refer to the data element description in FrntSideRdrLeDetn1 with the same data element name.";
CM_ SG_ 304 FrntSideRdrLeDetn4RdrDetnConf "Refer to the data element description in FrntSideRdrLeDetn1 with the same data element name.";
CM_ SG_ 304 FrntSideRdrLeDetn4RdrDetnElevn "Refer to the data element description in FrntSideRdrLeDetn1 with the same data element name.";
CM_ SG_ 304 FrntSideRdrLeDetn4RdrDetnPwr "Refer to the data element description in FrntSideRdrLeDetn1 with the same data element name.";
CM_ SG_ 304 FrntSideRdrLeDetn4RdrDetnRng "Refer to the data element description in FrntSideRdrLeDetn1 with the same data element name.";
CM_ SG_ 304 FrntSideRdrLeDetn4RdrDetnRngV "Range velocity ";
CM_ SG_ 304 FrntSideRdrLeDetn4RdrDetnSts "Refer to the data element description in FrntSideRdrLeDetn1 with the same data element name.";
CM_ SG_ 304 FrntSideRdrLeDetn5RdrDetnAzi "Refer to the data element description in FrntSideRdrLeDetn1 with the same data element name.";
CM_ SG_ 304 FrntSideRdrLeDetn5RdrDetnChks "Refer to the data element description in FrntSideRdrLeDetn1 with the same data element name.";
CM_ SG_ 304 FrntSideRdrLeDetn5RdrDetnCntr "Refer to the data element description in FrntSideRdrLeDetn1 with the same data element name.";
CM_ SG_ 304 FrntSideRdrLeDetn5RdrDetnConf "Refer to the data element description in FrntSideRdrLeDetn1 with the same data element name.";
CM_ SG_ 304 FrntSideRdrLeDetn5RdrDetnElevn "Refer to the data element description in FrntSideRdrLeDetn1 with the same data element name.";
CM_ SG_ 304 FrntSideRdrLeDetn5RdrDetnPwr "Refer to the data element description in FrntSideRdrLeDetn1 with the same data element name.";
CM_ SG_ 304 FrntSideRdrLeDetn5RdrDetnRng "Refer to the data element description in FrntSideRdrLeDetn1 with the same data element name.";
CM_ SG_ 304 FrntSideRdrLeDetn5RdrDetnRngV "Range velocity ";
CM_ SG_ 304 FrntSideRdrLeDetn5RdrDetnSts "Refer to the data element description in FrntSideRdrLeDetn1 with the same data element name.";
CM_ SG_ 304 FrntSideRdrLeDetn6RdrDetnAzi "Refer to the data element description in FrntSideRdrLeDetn1 with the same data element name.";
CM_ SG_ 304 FrntSideRdrLeDetn6RdrDetnChks "Refer to the data element description in FrntSideRdrLeDetn1 with the same data element name.";
CM_ SG_ 304 FrntSideRdrLeDetn6RdrDetnCntr "Refer to the data element description in FrntSideRdrLeDetn1 with the same data element name.";
CM_ SG_ 304 FrntSideRdrLeDetn6RdrDetnConf "Refer to the data element description in FrntSideRdrLeDetn1 with the same data element name.";
CM_ SG_ 304 FrntSideRdrLeDetn6RdrDetnElevn "Refer to the data element description in FrntSideRdrLeDetn1 with the same data element name.";
CM_ SG_ 304 FrntSideRdrLeDetn6RdrDetnPwr "Refer to the data element description in FrntSideRdrLeDetn1 with the same data element name.";
CM_ SG_ 304 FrntSideRdrLeDetn6RdrDetnRng "Refer to the data element description in FrntSideRdrLeDetn1 with the same data element name.";
CM_ SG_ 304 FrntSideRdrLeDetn6RdrDetnRngV "Range velocity ";
CM_ SG_ 304 FrntSideRdrLeDetn6RdrDetnSts "Refer to the data element description in FrntSideRdrLeDetn1 with the same data element name.";
CM_ SG_ 306 FrntSideRdrLeDetn10RdrDetnAzi "Refer to the data element description in FrntSideRdrLeDetn1 with the same data element name.";
CM_ SG_ 306 FrntSideRdrLeDetn10RdrDetnChks "Refer to the data element description in FrntSideRdrLeDetn1 with the same data element name.";
CM_ SG_ 306 FrntSideRdrLeDetn10RdrDetnCntr "Refer to the data element description in FrntSideRdrLeDetn1 with the same data element name.";
CM_ SG_ 306 FrntSideRdrLeDetn10RdrDetnConf "Refer to the data element description in FrntSideRdrLeDetn1 with the same data element name.";
CM_ SG_ 306 FrntSideRdrLeDetn10RdrDetnElevn "Refer to the data element description in FrntSideRdrLeDetn1 with the same data element name.";
CM_ SG_ 306 FrntSideRdrLeDetn10RdrDetnPwr "Refer to the data element description in FrntSideRdrLeDetn1 with the same data element name.";
CM_ SG_ 306 FrntSideRdrLeDetn10RdrDetnRng "Refer to the data element description in FrntSideRdrLeDetn1 with the same data element name.";
CM_ SG_ 306 FrntSideRdrLeDetn10RdrDetnRngV "Refer to the data element description in FrntSideRdrLeDetn1 with the same data element name.";
CM_ SG_ 306 FrntSideRdrLeDetn10RdrDetnSts "Refer to the data element description in FrntSideRdrLeDetn1 with the same data element name.";
CM_ SG_ 306 FrntSideRdrLeDetn11RdrDetnAzi "Refer to the data element description in FrntSideRdrLeDetn1 with the same data element name.";
CM_ SG_ 306 FrntSideRdrLeDetn11RdrDetnChks "Refer to the data element description in FrntSideRdrLeDetn1 with the same data element name.";
CM_ SG_ 306 FrntSideRdrLeDetn11RdrDetnCntr "Refer to the data element description in FrntSideRdrLeDetn1 with the same data element name.";
CM_ SG_ 306 FrntSideRdrLeDetn11RdrDetnConf "Refer to the data element description in FrntSideRdrLeDetn1 with the same data element name.";
CM_ SG_ 306 FrntSideRdrLeDetn11RdrDetnElevn "Refer to the data element description in FrntSideRdrLeDetn1 with the same data element name.";
CM_ SG_ 306 FrntSideRdrLeDetn11RdrDetnPwr "Refer to the data element description in FrntSideRdrLeDetn1 with the same data element name.";
CM_ SG_ 306 FrntSideRdrLeDetn11RdrDetnRng "Refer to the data element description in FrntSideRdrLeDetn1 with the same data element name.";
CM_ SG_ 306 FrntSideRdrLeDetn11RdrDetnRngV "Refer to the data element description in FrntSideRdrLeDetn1 with the same data element name.";
CM_ SG_ 306 FrntSideRdrLeDetn11RdrDetnSts "Refer to the data element description in FrntSideRdrLeDetn1 with the same data element name.";
CM_ SG_ 306 FrntSideRdrLeDetn12RdrDetnAzi "Refer to the data element description in FrntSideRdrLeDetn1 with the same data element name.";
CM_ SG_ 306 FrntSideRdrLeDetn12RdrDetnChks "Refer to the data element description in FrntSideRdrLeDetn1 with the same data element name.";
CM_ SG_ 306 FrntSideRdrLeDetn12RdrDetnCntr "Refer to the data element description in FrntSideRdrLeDetn1 with the same data element name.";
CM_ SG_ 306 FrntSideRdrLeDetn12RdrDetnConf "Refer to the data element description in FrntSideRdrLeDetn1 with the same data element name.";
CM_ SG_ 306 FrntSideRdrLeDetn12RdrDetnElevn "Refer to the data element description in FrntSideRdrLeDetn1 with the same data element name.";
CM_ SG_ 306 FrntSideRdrLeDetn12RdrDetnPwr "Refer to the data element description in FrntSideRdrLeDetn1 with the same data element name.";
CM_ SG_ 306 FrntSideRdrLeDetn12RdrDetnRng "Refer to the data element description in FrntSideRdrLeDetn1 with the same data element name.";
CM_ SG_ 306 FrntSideRdrLeDetn12RdrDetnRngV "Refer to the data element description in FrntSideRdrLeDetn1 with the same data element name.";
CM_ SG_ 306 FrntSideRdrLeDetn12RdrDetnSts "Refer to the data element description in FrntSideRdrLeDetn1 with the same data element name.";
CM_ SG_ 306 FrntSideRdrLeDetn7RdrDetnAzi "Refer to the data element description in FrntSideRdrLeDetn1 with the same data element name.";
CM_ SG_ 306 FrntSideRdrLeDetn7RdrDetnChks "Refer to the data element description in FrntSideRdrLeDetn1 with the same data element name.";
CM_ SG_ 306 FrntSideRdrLeDetn7RdrDetnCntr "Refer to the data element description in FrntSideRdrLeDetn1 with the same data element name.";
CM_ SG_ 306 FrntSideRdrLeDetn7RdrDetnConf "Refer to the data element description in FrntSideRdrLeDetn1 with the same data element name.";
CM_ SG_ 306 FrntSideRdrLeDetn7RdrDetnElevn "Refer to the data element description in FrntSideRdrLeDetn1 with the same data element name.";
CM_ SG_ 306 FrntSideRdrLeDetn7RdrDetnPwr "Refer to the data element description in FrntSideRdrLeDetn1 with the same data element name.";
CM_ SG_ 306 FrntSideRdrLeDetn7RdrDetnRng "Refer to the data element description in FrntSideRdrLeDetn1 with the same data element name.";
CM_ SG_ 306 FrntSideRdrLeDetn7RdrDetnRngV "Range velocity ";
CM_ SG_ 306 FrntSideRdrLeDetn7RdrDetnSts "Refer to the data element description in FrntSideRdrLeDetn1 with the same data element name.";
CM_ SG_ 306 FrntSideRdrLeDetn8RdrDetnAzi "Refer to the data element description in FrntSideRdrLeDetn1 with the same data element name.";
CM_ SG_ 306 FrntSideRdrLeDetn8RdrDetnChks "Refer to the data element description in FrntSideRdrLeDetn1 with the same data element name.";
CM_ SG_ 306 FrntSideRdrLeDetn8RdrDetnCntr "Refer to the data element description in FrntSideRdrLeDetn1 with the same data element name.";
CM_ SG_ 306 FrntSideRdrLeDetn8RdrDetnConf "Refer to the data element description in FrntSideRdrLeDetn1 with the same data element name.";
CM_ SG_ 306 FrntSideRdrLeDetn8RdrDetnElevn "Refer to the data element description in FrntSideRdrLeDetn1 with the same data element name.";
CM_ SG_ 306 FrntSideRdrLeDetn8RdrDetnPwr "Refer to the data element description in FrntSideRdrLeDetn1 with the same data element name.";
CM_ SG_ 306 FrntSideRdrLeDetn8RdrDetnRng "Refer to the data element description in FrntSideRdrLeDetn1 with the same data element name.";
CM_ SG_ 306 FrntSideRdrLeDetn8RdrDetnRngV "Range velocity ";
CM_ SG_ 306 FrntSideRdrLeDetn8RdrDetnSts "Refer to the data element description in FrntSideRdrLeDetn1 with the same data element name.";
CM_ SG_ 306 FrntSideRdrLeDetn9RdrDetnAzi "Refer to the data element description in FrntSideRdrLeDetn1 with the same data element name.";
CM_ SG_ 306 FrntSideRdrLeDetn9RdrDetnChks "Refer to the data element description in FrntSideRdrLeDetn1 with the same data element name.";
CM_ SG_ 306 FrntSideRdrLeDetn9RdrDetnCntr "Refer to the data element description in FrntSideRdrLeDetn1 with the same data element name.";
CM_ SG_ 306 FrntSideRdrLeDetn9RdrDetnConf "Refer to the data element description in FrntSideRdrLeDetn1 with the same data element name.";
CM_ SG_ 306 FrntSideRdrLeDetn9RdrDetnElevn "Refer to the data element description in FrntSideRdrLeDetn1 with the same data element name.";
CM_ SG_ 306 FrntSideRdrLeDetn9RdrDetnPwr "Refer to the data element description in FrntSideRdrLeDetn1 with the same data element name.";
CM_ SG_ 306 FrntSideRdrLeDetn9RdrDetnRng "Refer to the data element description in FrntSideRdrLeDetn1 with the same data element name.";
CM_ SG_ 306 FrntSideRdrLeDetn9RdrDetnRngV "Range velocity ";
CM_ SG_ 306 FrntSideRdrLeDetn9RdrDetnSts "Refer to the data element description in FrntSideRdrLeDetn1 with the same data element name.";
CM_ SG_ 308 FrntSideRdrLeDetn13RdrDetnAzi "Refer to the data element description in FrntSideRdrLeDetn1 with the same data element name.";
CM_ SG_ 308 FrntSideRdrLeDetn13RdrDetnChks "Refer to the data element description in FrntSideRdrLeDetn1 with the same data element name.";
CM_ SG_ 308 FrntSideRdrLeDetn13RdrDetnCntr "Refer to the data element description in FrntSideRdrLeDetn1 with the same data element name.";
CM_ SG_ 308 FrntSideRdrLeDetn13RdrDetnConf "Refer to the data element description in FrntSideRdrLeDetn1 with the same data element name.";
CM_ SG_ 308 FrntSideRdrLeDetn13RdrDetnElevn "Refer to the data element description in FrntSideRdrLeDetn1 with the same data element name.";
CM_ SG_ 308 FrntSideRdrLeDetn13RdrDetnPwr "Refer to the data element description in FrntSideRdrLeDetn1 with the same data element name.";
CM_ SG_ 308 FrntSideRdrLeDetn13RdrDetnRng "Refer to the data element description in FrntSideRdrLeDetn1 with the same data element name.";
CM_ SG_ 308 FrntSideRdrLeDetn13RdrDetnRngV "Range velocity ";
CM_ SG_ 308 FrntSideRdrLeDetn13RdrDetnSts "Refer to the data element description in FrntSideRdrLeDetn1 with the same data element name.";
CM_ SG_ 308 FrntSideRdrLeDetn14RdrDetnAzi "Refer to the data element description in FrntSideRdrLeDetn1 with the same data element name.";
CM_ SG_ 308 FrntSideRdrLeDetn14RdrDetnChks "Refer to the data element description in FrntSideRdrLeDetn1 with the same data element name.";
CM_ SG_ 308 FrntSideRdrLeDetn14RdrDetnCntr "Refer to the data element description in FrntSideRdrLeDetn1 with the same data element name.";
CM_ SG_ 308 FrntSideRdrLeDetn14RdrDetnConf "Refer to the data element description in FrntSideRdrLeDetn1 with the same data element name.";
CM_ SG_ 308 FrntSideRdrLeDetn14RdrDetnElevn "Refer to the data element description in FrntSideRdrLeDetn1 with the same data element name.";
CM_ SG_ 308 FrntSideRdrLeDetn14RdrDetnPwr "Refer to the data element description in FrntSideRdrLeDetn1 with the same data element name.";
CM_ SG_ 308 FrntSideRdrLeDetn14RdrDetnRng "Refer to the data element description in FrntSideRdrLeDetn1 with the same data element name.";
CM_ SG_ 308 FrntSideRdrLeDetn14RdrDetnRngV "Range velocity ";
CM_ SG_ 308 FrntSideRdrLeDetn14RdrDetnSts "Refer to the data element description in FrntSideRdrLeDetn1 with the same data element name.";
CM_ SG_ 308 FrntSideRdrLeDetn15RdrDetnAzi "Refer to the data element description in FrntSideRdrLeDetn1 with the same data element name.";
CM_ SG_ 308 FrntSideRdrLeDetn15RdrDetnChks "Refer to the data element description in FrntSideRdrLeDetn1 with the same data element name.";
CM_ SG_ 308 FrntSideRdrLeDetn15RdrDetnCntr "Refer to the data element description in FrntSideRdrLeDetn1 with the same data element name.";
CM_ SG_ 308 FrntSideRdrLeDetn15RdrDetnConf "Refer to the data element description in FrntSideRdrLeDetn1 with the same data element name.";
CM_ SG_ 308 FrntSideRdrLeDetn15RdrDetnElevn "Refer to the data element description in FrntSideRdrLeDetn1 with the same data element name.";
CM_ SG_ 308 FrntSideRdrLeDetn15RdrDetnPwr "Refer to the data element description in FrntSideRdrLeDetn1 with the same data element name.";
CM_ SG_ 308 FrntSideRdrLeDetn15RdrDetnRng "Refer to the data element description in FrntSideRdrLeDetn1 with the same data element name.";
CM_ SG_ 308 FrntSideRdrLeDetn15RdrDetnRngV "Range velocity ";
CM_ SG_ 308 FrntSideRdrLeDetn15RdrDetnSts "Refer to the data element description in FrntSideRdrLeDetn1 with the same data element name.";
CM_ SG_ 308 FrntSideRdrLeDetn16RdrDetnAzi "Refer to the data element description in FrntSideRdrLeDetn1 with the same data element name.";
CM_ SG_ 308 FrntSideRdrLeDetn16RdrDetnChks "Refer to the data element description in FrntSideRdrLeDetn1 with the same data element name.";
CM_ SG_ 308 FrntSideRdrLeDetn16RdrDetnCntr "Refer to the data element description in FrntSideRdrLeDetn1 with the same data element name.";
CM_ SG_ 308 FrntSideRdrLeDetn16RdrDetnConf "Refer to the data element description in FrntSideRdrLeDetn1 with the same data element name.";
CM_ SG_ 308 FrntSideRdrLeDetn16RdrDetnElevn "Refer to the data element description in FrntSideRdrLeDetn1 with the same data element name.";
CM_ SG_ 308 FrntSideRdrLeDetn16RdrDetnPwr "Refer to the data element description in FrntSideRdrLeDetn1 with the same data element name.";
CM_ SG_ 308 FrntSideRdrLeDetn16RdrDetnRng "Refer to the data element description in FrntSideRdrLeDetn1 with the same data element name.";
CM_ SG_ 308 FrntSideRdrLeDetn16RdrDetnRngV "Range velocity ";
CM_ SG_ 308 FrntSideRdrLeDetn16RdrDetnSts "Refer to the data element description in FrntSideRdrLeDetn1 with the same data element name.";
CM_ SG_ 308 FrntSideRdrLeDetn17RdrDetnAzi "Refer to the data element description in FrntSideRdrLeDetn1 with the same data element name.";
CM_ SG_ 308 FrntSideRdrLeDetn17RdrDetnChks "Refer to the data element description in FrntSideRdrLeDetn1 with the same data element name.";
CM_ SG_ 308 FrntSideRdrLeDetn17RdrDetnCntr "Refer to the data element description in FrntSideRdrLeDetn1 with the same data element name.";
CM_ SG_ 308 FrntSideRdrLeDetn17RdrDetnConf "Refer to the data element description in FrntSideRdrLeDetn1 with the same data element name.";
CM_ SG_ 308 FrntSideRdrLeDetn17RdrDetnElevn "Refer to the data element description in FrntSideRdrLeDetn1 with the same data element name.";
CM_ SG_ 308 FrntSideRdrLeDetn17RdrDetnPwr "Refer to the data element description in FrntSideRdrLeDetn1 with the same data element name.";
CM_ SG_ 308 FrntSideRdrLeDetn17RdrDetnRng "Refer to the data element description in FrntSideRdrLeDetn1 with the same data element name.";
CM_ SG_ 308 FrntSideRdrLeDetn17RdrDetnRngV "Range velocity ";
CM_ SG_ 308 FrntSideRdrLeDetn17RdrDetnSts "Refer to the data element description in FrntSideRdrLeDetn1 with the same data element name.";
CM_ SG_ 308 FrntSideRdrLeDetn18RdrDetnAzi "Refer to the data element description in FrntSideRdrLeDetn1 with the same data element name.";
CM_ SG_ 308 FrntSideRdrLeDetn18RdrDetnChks "Refer to the data element description in FrntSideRdrLeDetn1 with the same data element name.";
CM_ SG_ 308 FrntSideRdrLeDetn18RdrDetnCntr "Refer to the data element description in FrntSideRdrLeDetn1 with the same data element name.";
CM_ SG_ 308 FrntSideRdrLeDetn18RdrDetnConf "Refer to the data element description in FrntSideRdrLeDetn1 with the same data element name.";
CM_ SG_ 308 FrntSideRdrLeDetn18RdrDetnElevn "Refer to the data element description in FrntSideRdrLeDetn1 with the same data element name.";
CM_ SG_ 308 FrntSideRdrLeDetn18RdrDetnPwr "Refer to the data element description in FrntSideRdrLeDetn1 with the same data element name.";
CM_ SG_ 308 FrntSideRdrLeDetn18RdrDetnRng "Refer to the data element description in FrntSideRdrLeDetn1 with the same data element name.";
CM_ SG_ 308 FrntSideRdrLeDetn18RdrDetnRngV "Range velocity ";
CM_ SG_ 308 FrntSideRdrLeDetn18RdrDetnSts "Refer to the data element description in FrntSideRdrLeDetn1 with the same data element name.";
CM_ SG_ 310 FrntSideRdrLeDetn19RdrDetnAzi "Refer to the data element description in FrntSideRdrLeDetn1 with the same data element name.";
CM_ SG_ 310 FrntSideRdrLeDetn19RdrDetnChks "Refer to the data element description in FrntSideRdrLeDetn1 with the same data element name.";
CM_ SG_ 310 FrntSideRdrLeDetn19RdrDetnCntr "Refer to the data element description in FrntSideRdrLeDetn1 with the same data element name.";
CM_ SG_ 310 FrntSideRdrLeDetn19RdrDetnConf "Refer to the data element description in FrntSideRdrLeDetn1 with the same data element name.";
CM_ SG_ 310 FrntSideRdrLeDetn19RdrDetnElevn "Refer to the data element description in FrntSideRdrLeDetn1 with the same data element name.";
CM_ SG_ 310 FrntSideRdrLeDetn19RdrDetnPwr "Refer to the data element description in FrntSideRdrLeDetn1 with the same data element name.";
CM_ SG_ 310 FrntSideRdrLeDetn19RdrDetnRng "Refer to the data element description in FrntSideRdrLeDetn1 with the same data element name.";
CM_ SG_ 310 FrntSideRdrLeDetn19RdrDetnRngV "Range velocity ";
CM_ SG_ 310 FrntSideRdrLeDetn19RdrDetnSts "Refer to the data element description in FrntSideRdrLeDetn1 with the same data element name.";
CM_ SG_ 310 FrntSideRdrLeDetn20RdrDetnAzi "Refer to the data element description in FrntSideRdrLeDetn1 with the same data element name.";
CM_ SG_ 310 FrntSideRdrLeDetn20RdrDetnChks "Refer to the data element description in FrntSideRdrLeDetn1 with the same data element name.";
CM_ SG_ 310 FrntSideRdrLeDetn20RdrDetnCntr "Refer to the data element description in FrntSideRdrLeDetn1 with the same data element name.";
CM_ SG_ 310 FrntSideRdrLeDetn20RdrDetnConf "Refer to the data element description in FrntSideRdrLeDetn1 with the same data element name.";
CM_ SG_ 310 FrntSideRdrLeDetn20RdrDetnElevn "Refer to the data element description in FrntSideRdrLeDetn1 with the same data element name.";
CM_ SG_ 310 FrntSideRdrLeDetn20RdrDetnPwr "Refer to the data element description in FrntSideRdrLeDetn1 with the same data element name.";
CM_ SG_ 310 FrntSideRdrLeDetn20RdrDetnRng "Refer to the data element description in FrntSideRdrLeDetn1 with the same data element name.";
CM_ SG_ 310 FrntSideRdrLeDetn20RdrDetnRngV "Range velocity ";
CM_ SG_ 310 FrntSideRdrLeDetn20RdrDetnSts "Refer to the data element description in FrntSideRdrLeDetn1 with the same data element name.";
CM_ SG_ 310 FrntSideRdrLeDetn21RdrDetnAzi "Refer to the data element description in FrntSideRdrLeDetn1 with the same data element name.";
CM_ SG_ 310 FrntSideRdrLeDetn21RdrDetnChks "Refer to the data element description in FrntSideRdrLeDetn1 with the same data element name.";
CM_ SG_ 310 FrntSideRdrLeDetn21RdrDetnCntr "Refer to the data element description in FrntSideRdrLeDetn1 with the same data element name.";
CM_ SG_ 310 FrntSideRdrLeDetn21RdrDetnConf "Refer to the data element description in FrntSideRdrLeDetn1 with the same data element name.";
CM_ SG_ 310 FrntSideRdrLeDetn21RdrDetnElevn "Refer to the data element description in FrntSideRdrLeDetn1 with the same data element name.";
CM_ SG_ 310 FrntSideRdrLeDetn21RdrDetnPwr "Refer to the data element description in FrntSideRdrLeDetn1 with the same data element name.";
CM_ SG_ 310 FrntSideRdrLeDetn21RdrDetnRng "Refer to the data element description in FrntSideRdrLeDetn1 with the same data element name.";
CM_ SG_ 310 FrntSideRdrLeDetn21RdrDetnRngV "Range velocity ";
CM_ SG_ 310 FrntSideRdrLeDetn21RdrDetnSts "Refer to the data element description in FrntSideRdrLeDetn1 with the same data element name.";
CM_ SG_ 310 FrntSideRdrLeDetn22RdrDetnAzi "Refer to the data element description in FrntSideRdrLeDetn1 with the same data element name.";
CM_ SG_ 310 FrntSideRdrLeDetn22RdrDetnChks "Refer to the data element description in FrntSideRdrLeDetn1 with the same data element name.";
CM_ SG_ 310 FrntSideRdrLeDetn22RdrDetnCntr "Refer to the data element description in FrntSideRdrLeDetn1 with the same data element name.";
CM_ SG_ 310 FrntSideRdrLeDetn22RdrDetnConf "Refer to the data element description in FrntSideRdrLeDetn1 with the same data element name.";
CM_ SG_ 310 FrntSideRdrLeDetn22RdrDetnElevn "Refer to the data element description in FrntSideRdrLeDetn1 with the same data element name.";
CM_ SG_ 310 FrntSideRdrLeDetn22RdrDetnPwr "Refer to the data element description in FrntSideRdrLeDetn1 with the same data element name.";
CM_ SG_ 310 FrntSideRdrLeDetn22RdrDetnRng "Refer to the data element description in FrntSideRdrLeDetn1 with the same data element name.";
CM_ SG_ 310 FrntSideRdrLeDetn22RdrDetnRngV "Range velocity ";
CM_ SG_ 310 FrntSideRdrLeDetn22RdrDetnSts "Refer to the data element description in FrntSideRdrLeDetn1 with the same data element name.";
CM_ SG_ 310 FrntSideRdrLeDetn23RdrDetnAzi "Refer to the data element description in FrntSideRdrLeDetn1 with the same data element name.";
CM_ SG_ 310 FrntSideRdrLeDetn23RdrDetnChks "Refer to the data element description in FrntSideRdrLeDetn1 with the same data element name.";
CM_ SG_ 310 FrntSideRdrLeDetn23RdrDetnCntr "Refer to the data element description in FrntSideRdrLeDetn1 with the same data element name.";
CM_ SG_ 310 FrntSideRdrLeDetn23RdrDetnConf "Refer to the data element description in FrntSideRdrLeDetn1 with the same data element name.";
CM_ SG_ 310 FrntSideRdrLeDetn23RdrDetnElevn "Refer to the data element description in FrntSideRdrLeDetn1 with the same data element name.";
CM_ SG_ 310 FrntSideRdrLeDetn23RdrDetnPwr "Refer to the data element description in FrntSideRdrLeDetn1 with the same data element name.";
CM_ SG_ 310 FrntSideRdrLeDetn23RdrDetnRng "Refer to the data element description in FrntSideRdrLeDetn1 with the same data element name.";
CM_ SG_ 310 FrntSideRdrLeDetn23RdrDetnRngV "Range velocity ";
CM_ SG_ 310 FrntSideRdrLeDetn23RdrDetnSts "Refer to the data element description in FrntSideRdrLeDetn1 with the same data element name.";
CM_ SG_ 310 FrntSideRdrLeDetn24RdrDetnAzi "Refer to the data element description in FrntSideRdrLeDetn1 with the same data element name.";
CM_ SG_ 310 FrntSideRdrLeDetn24RdrDetnChks "Refer to the data element description in FrntSideRdrLeDetn1 with the same data element name.";
CM_ SG_ 310 FrntSideRdrLeDetn24RdrDetnCntr "Refer to the data element description in FrntSideRdrLeDetn1 with the same data element name.";
CM_ SG_ 310 FrntSideRdrLeDetn24RdrDetnConf "Refer to the data element description in FrntSideRdrLeDetn1 with the same data element name.";
CM_ SG_ 310 FrntSideRdrLeDetn24RdrDetnElevn "Refer to the data element description in FrntSideRdrLeDetn1 with the same data element name.";
CM_ SG_ 310 FrntSideRdrLeDetn24RdrDetnPwr "Refer to the data element description in FrntSideRdrLeDetn1 with the same data element name.";
CM_ SG_ 310 FrntSideRdrLeDetn24RdrDetnRng "Refer to the data element description in FrntSideRdrLeDetn1 with the same data element name.";
CM_ SG_ 310 FrntSideRdrLeDetn24RdrDetnRngV "Range velocity ";
CM_ SG_ 310 FrntSideRdrLeDetn24RdrDetnSts "Refer to the data element description in FrntSideRdrLeDetn1 with the same data element name.";
CM_ SG_ 312 FrntSideRdrLeDetn25RdrDetnAzi "Refer to the data element description in FrntSideRdrLeDetn1 with the same data element name.";
CM_ SG_ 312 FrntSideRdrLeDetn25RdrDetnChks "Refer to the data element description in FrntSideRdrLeDetn1 with the same data element name.";
CM_ SG_ 312 FrntSideRdrLeDetn25RdrDetnCntr "Refer to the data element description in FrntSideRdrLeDetn1 with the same data element name.";
CM_ SG_ 312 FrntSideRdrLeDetn25RdrDetnConf "Refer to the data element description in FrntSideRdrLeDetn1 with the same data element name.";
CM_ SG_ 312 FrntSideRdrLeDetn25RdrDetnElevn "Refer to the data element description in FrntSideRdrLeDetn1 with the same data element name.";
CM_ SG_ 312 FrntSideRdrLeDetn25RdrDetnPwr "Refer to the data element description in FrntSideRdrLeDetn1 with the same data element name.";
CM_ SG_ 312 FrntSideRdrLeDetn25RdrDetnRng "Refer to the data element description in FrntSideRdrLeDetn1 with the same data element name.";
CM_ SG_ 312 FrntSideRdrLeDetn25RdrDetnRngV "Range velocity ";
CM_ SG_ 312 FrntSideRdrLeDetn25RdrDetnSts "Refer to the data element description in FrntSideRdrLeDetn1 with the same data element name.";
CM_ SG_ 312 FrntSideRdrLeDetn26RdrDetnAzi "Refer to the data element description in FrntSideRdrLeDetn1 with the same data element name.";
CM_ SG_ 312 FrntSideRdrLeDetn26RdrDetnChks "Refer to the data element description in FrntSideRdrLeDetn1 with the same data element name.";
CM_ SG_ 312 FrntSideRdrLeDetn26RdrDetnCntr "Refer to the data element description in FrntSideRdrLeDetn1 with the same data element name.";
CM_ SG_ 312 FrntSideRdrLeDetn26RdrDetnConf "Refer to the data element description in FrntSideRdrLeDetn1 with the same data element name.";
CM_ SG_ 312 FrntSideRdrLeDetn26RdrDetnElevn "Refer to the data element description in FrntSideRdrLeDetn1 with the same data element name.";
CM_ SG_ 312 FrntSideRdrLeDetn26RdrDetnPwr "Refer to the data element description in FrntSideRdrLeDetn1 with the same data element name.";
CM_ SG_ 312 FrntSideRdrLeDetn26RdrDetnRng "Refer to the data element description in FrntSideRdrLeDetn1 with the same data element name.";
CM_ SG_ 312 FrntSideRdrLeDetn26RdrDetnRngV "Range velocity ";
CM_ SG_ 312 FrntSideRdrLeDetn26RdrDetnSts "Refer to the data element description in FrntSideRdrLeDetn1 with the same data element name.";
CM_ SG_ 312 FrntSideRdrLeDetn27RdrDetnAzi "Refer to the data element description in FrntSideRdrLeDetn1 with the same data element name.";
CM_ SG_ 312 FrntSideRdrLeDetn27RdrDetnChks "Refer to the data element description in FrntSideRdrLeDetn1 with the same data element name.";
CM_ SG_ 312 FrntSideRdrLeDetn27RdrDetnCntr "Refer to the data element description in FrntSideRdrLeDetn1 with the same data element name.";
CM_ SG_ 312 FrntSideRdrLeDetn27RdrDetnConf "Refer to the data element description in FrntSideRdrLeDetn1 with the same data element name.";
CM_ SG_ 312 FrntSideRdrLeDetn27RdrDetnElevn "Refer to the data element description in FrntSideRdrLeDetn1 with the same data element name.";
CM_ SG_ 312 FrntSideRdrLeDetn27RdrDetnPwr "Refer to the data element description in FrntSideRdrLeDetn1 with the same data element name.";
CM_ SG_ 312 FrntSideRdrLeDetn27RdrDetnRng "Refer to the data element description in FrntSideRdrLeDetn1 with the same data element name.";
CM_ SG_ 312 FrntSideRdrLeDetn27RdrDetnRngV "Range velocity ";
CM_ SG_ 312 FrntSideRdrLeDetn27RdrDetnSts "Refer to the data element description in FrntSideRdrLeDetn1 with the same data element name.";
CM_ SG_ 312 FrntSideRdrLeDetn28RdrDetnAzi "Refer to the data element description in FrntSideRdrLeDetn1 with the same data element name.";
CM_ SG_ 312 FrntSideRdrLeDetn28RdrDetnChks "Refer to the data element description in FrntSideRdrLeDetn1 with the same data element name.";
CM_ SG_ 312 FrntSideRdrLeDetn28RdrDetnCntr "Refer to the data element description in FrntSideRdrLeDetn1 with the same data element name.";
CM_ SG_ 312 FrntSideRdrLeDetn28RdrDetnConf "Refer to the data element description in FrntSideRdrLeDetn1 with the same data element name.";
CM_ SG_ 312 FrntSideRdrLeDetn28RdrDetnElevn "Refer to the data element description in FrntSideRdrLeDetn1 with the same data element name.";
CM_ SG_ 312 FrntSideRdrLeDetn28RdrDetnPwr "Refer to the data element description in FrntSideRdrLeDetn1 with the same data element name.";
CM_ SG_ 312 FrntSideRdrLeDetn28RdrDetnRng "Refer to the data element description in FrntSideRdrLeDetn1 with the same data element name.";
CM_ SG_ 312 FrntSideRdrLeDetn28RdrDetnRngV "Range velocity ";
CM_ SG_ 312 FrntSideRdrLeDetn28RdrDetnSts "Refer to the data element description in FrntSideRdrLeDetn1 with the same data element name.";
CM_ SG_ 312 FrntSideRdrLeDetn29RdrDetnAzi "Refer to the data element description in FrntSideRdrLeDetn1 with the same data element name.";
CM_ SG_ 312 FrntSideRdrLeDetn29RdrDetnChks "Refer to the data element description in FrntSideRdrLeDetn1 with the same data element name.";
CM_ SG_ 312 FrntSideRdrLeDetn29RdrDetnCntr "Refer to the data element description in FrntSideRdrLeDetn1 with the same data element name.";
CM_ SG_ 312 FrntSideRdrLeDetn29RdrDetnConf "Refer to the data element description in FrntSideRdrLeDetn1 with the same data element name.";
CM_ SG_ 312 FrntSideRdrLeDetn29RdrDetnElevn "Refer to the data element description in FrntSideRdrLeDetn1 with the same data element name.";
CM_ SG_ 312 FrntSideRdrLeDetn29RdrDetnPwr "Refer to the data element description in FrntSideRdrLeDetn1 with the same data element name.";
CM_ SG_ 312 FrntSideRdrLeDetn29RdrDetnRng "Refer to the data element description in FrntSideRdrLeDetn1 with the same data element name.";
CM_ SG_ 312 FrntSideRdrLeDetn29RdrDetnRngV "Range velocity ";
CM_ SG_ 312 FrntSideRdrLeDetn29RdrDetnSts "Refer to the data element description in FrntSideRdrLeDetn1 with the same data element name.";
CM_ SG_ 312 FrntSideRdrLeDetn30RdrDetnAzi "Refer to the data element description in FrntSideRdrLeDetn1 with the same data element name.";
CM_ SG_ 312 FrntSideRdrLeDetn30RdrDetnChks "Refer to the data element description in FrntSideRdrLeDetn1 with the same data element name.";
CM_ SG_ 312 FrntSideRdrLeDetn30RdrDetnCntr "Refer to the data element description in FrntSideRdrLeDetn1 with the same data element name.";
CM_ SG_ 312 FrntSideRdrLeDetn30RdrDetnConf "Refer to the data element description in FrntSideRdrLeDetn1 with the same data element name.";
CM_ SG_ 312 FrntSideRdrLeDetn30RdrDetnElevn "Refer to the data element description in FrntSideRdrLeDetn1 with the same data element name.";
CM_ SG_ 312 FrntSideRdrLeDetn30RdrDetnPwr "Refer to the data element description in FrntSideRdrLeDetn1 with the same data element name.";
CM_ SG_ 312 FrntSideRdrLeDetn30RdrDetnRng "Refer to the data element description in FrntSideRdrLeDetn1 with the same data element name.";
CM_ SG_ 312 FrntSideRdrLeDetn30RdrDetnRngV "Range velocity ";
CM_ SG_ 312 FrntSideRdrLeDetn30RdrDetnSts "Refer to the data element description in FrntSideRdrLeDetn1 with the same data element name.";
CM_ SG_ 314 FrntSideRdrLeDetn31RdrDetnAzi "Refer to the data element description in FrntSideRdrLeDetn1 with the same data element name.";
CM_ SG_ 314 FrntSideRdrLeDetn31RdrDetnChks "Refer to the data element description in FrntSideRdrLeDetn1 with the same data element name.";
CM_ SG_ 314 FrntSideRdrLeDetn31RdrDetnCntr "Refer to the data element description in FrntSideRdrLeDetn1 with the same data element name.";
CM_ SG_ 314 FrntSideRdrLeDetn31RdrDetnConf "Refer to the data element description in FrntSideRdrLeDetn1 with the same data element name.";
CM_ SG_ 314 FrntSideRdrLeDetn31RdrDetnElevn "Refer to the data element description in FrntSideRdrLeDetn1 with the same data element name.";
CM_ SG_ 314 FrntSideRdrLeDetn31RdrDetnPwr "Refer to the data element description in FrntSideRdrLeDetn1 with the same data element name.";
CM_ SG_ 314 FrntSideRdrLeDetn31RdrDetnRng "Refer to the data element description in FrntSideRdrLeDetn1 with the same data element name.";
CM_ SG_ 314 FrntSideRdrLeDetn31RdrDetnRngV "Range velocity";
CM_ SG_ 314 FrntSideRdrLeDetn31RdrDetnSts "Refer to the data element description in FrntSideRdrLeDetn1 with the same data element name.";
CM_ SG_ 314 FrntSideRdrLeDetn32RdrDetnAzi "Refer to the data element description in FrntSideRdrLeDetn1 with the same data element name.";
CM_ SG_ 314 FrntSideRdrLeDetn32RdrDetnChks "Refer to the data element description in FrntSideRdrLeDetn1 with the same data element name.";
CM_ SG_ 314 FrntSideRdrLeDetn32RdrDetnCntr "Refer to the data element description in FrntSideRdrLeDetn1 with the same data element name.";
CM_ SG_ 314 FrntSideRdrLeDetn32RdrDetnConf "Refer to the data element description in FrntSideRdrLeDetn1 with the same data element name.";
CM_ SG_ 314 FrntSideRdrLeDetn32RdrDetnElevn "Refer to the data element description in FrntSideRdrLeDetn1 with the same data element name.";
CM_ SG_ 314 FrntSideRdrLeDetn32RdrDetnPwr "Refer to the data element description in FrntSideRdrLeDetn1 with the same data element name.";
CM_ SG_ 314 FrntSideRdrLeDetn32RdrDetnRng "Refer to the data element description in FrntSideRdrLeDetn1 with the same data element name.";
CM_ SG_ 314 FrntSideRdrLeDetn32RdrDetnRngV "Range velocity";
CM_ SG_ 314 FrntSideRdrLeDetn32RdrDetnSts "Refer to the data element description in FrntSideRdrLeDetn1 with the same data element name.";
CM_ SG_ 314 FrntSideRdrLeDetn33RdrDetnAzi "Refer to the data element description in FrntSideRdrLeDetn1 with the same data element name.";
CM_ SG_ 314 FrntSideRdrLeDetn33RdrDetnChks "Refer to the data element description in FrntSideRdrLeDetn1 with the same data element name.";
CM_ SG_ 314 FrntSideRdrLeDetn33RdrDetnCntr "Refer to the data element description in FrntSideRdrLeDetn1 with the same data element name.";
CM_ SG_ 314 FrntSideRdrLeDetn33RdrDetnConf "Refer to the data element description in FrntSideRdrLeDetn1 with the same data element name.";
CM_ SG_ 314 FrntSideRdrLeDetn33RdrDetnElevn "Refer to the data element description in FrntSideRdrLeDetn1 with the same data element name.";
CM_ SG_ 314 FrntSideRdrLeDetn33RdrDetnPwr "Refer to the data element description in FrntSideRdrLeDetn1 with the same data element name.";
CM_ SG_ 314 FrntSideRdrLeDetn33RdrDetnRng "Refer to the data element description in FrntSideRdrLeDetn1 with the same data element name.";
CM_ SG_ 314 FrntSideRdrLeDetn33RdrDetnRngV "Range velocity";
CM_ SG_ 314 FrntSideRdrLeDetn33RdrDetnSts "Refer to the data element description in FrntSideRdrLeDetn1 with the same data element name.";
CM_ SG_ 314 FrntSideRdrLeDetn34RdrDetnAzi "Refer to the data element description in FrntSideRdrLeDetn1 with the same data element name.";
CM_ SG_ 314 FrntSideRdrLeDetn34RdrDetnChks "Refer to the data element description in FrntSideRdrLeDetn1 with the same data element name.";
CM_ SG_ 314 FrntSideRdrLeDetn34RdrDetnCntr "Refer to the data element description in FrntSideRdrLeDetn1 with the same data element name.";
CM_ SG_ 314 FrntSideRdrLeDetn34RdrDetnConf "Refer to the data element description in FrntSideRdrLeDetn1 with the same data element name.";
CM_ SG_ 314 FrntSideRdrLeDetn34RdrDetnElevn "Refer to the data element description in FrntSideRdrLeDetn1 with the same data element name.";
CM_ SG_ 314 FrntSideRdrLeDetn34RdrDetnPwr "Refer to the data element description in FrntSideRdrLeDetn1 with the same data element name.";
CM_ SG_ 314 FrntSideRdrLeDetn34RdrDetnRng "Refer to the data element description in FrntSideRdrLeDetn1 with the same data element name.";
CM_ SG_ 314 FrntSideRdrLeDetn34RdrDetnRngV "Range velocity";
CM_ SG_ 314 FrntSideRdrLeDetn34RdrDetnSts "Refer to the data element description in FrntSideRdrLeDetn1 with the same data element name.";
CM_ SG_ 314 FrntSideRdrLeDetn35RdrDetnAzi "Refer to the data element description in FrntSideRdrLeDetn1 with the same data element name.";
CM_ SG_ 314 FrntSideRdrLeDetn35RdrDetnChks "Refer to the data element description in FrntSideRdrLeDetn1 with the same data element name.";
CM_ SG_ 314 FrntSideRdrLeDetn35RdrDetnCntr "Refer to the data element description in FrntSideRdrLeDetn1 with the same data element name.";
CM_ SG_ 314 FrntSideRdrLeDetn35RdrDetnConf "Refer to the data element description in FrntSideRdrLeDetn1 with the same data element name.";
CM_ SG_ 314 FrntSideRdrLeDetn35RdrDetnElevn "Refer to the data element description in FrntSideRdrLeDetn1 with the same data element name.";
CM_ SG_ 314 FrntSideRdrLeDetn35RdrDetnPwr "Refer to the data element description in FrntSideRdrLeDetn1 with the same data element name.";
CM_ SG_ 314 FrntSideRdrLeDetn35RdrDetnRng "Refer to the data element description in FrntSideRdrLeDetn1 with the same data element name.";
CM_ SG_ 314 FrntSideRdrLeDetn35RdrDetnRngV "Range velocity ";
CM_ SG_ 314 FrntSideRdrLeDetn35RdrDetnSts "Refer to the data element description in FrntSideRdrLeDetn1 with the same data element name.";
CM_ SG_ 314 FrntSideRdrLeDetn36RdrDetnAzi "Refer to the data element description in FrntSideRdrLeDetn1 with the same data element name.";
CM_ SG_ 314 FrntSideRdrLeDetn36RdrDetnChks "Refer to the data element description in FrntSideRdrLeDetn1 with the same data element name.";
CM_ SG_ 314 FrntSideRdrLeDetn36RdrDetnCntr "Refer to the data element description in FrntSideRdrLeDetn1 with the same data element name.";
CM_ SG_ 314 FrntSideRdrLeDetn36RdrDetnConf "Refer to the data element description in FrntSideRdrLeDetn1 with the same data element name.";
CM_ SG_ 314 FrntSideRdrLeDetn36RdrDetnElevn "Refer to the data element description in FrntSideRdrLeDetn1 with the same data element name.";
CM_ SG_ 314 FrntSideRdrLeDetn36RdrDetnPwr "Refer to the data element description in FrntSideRdrLeDetn1 with the same data element name.";
CM_ SG_ 314 FrntSideRdrLeDetn36RdrDetnRng "Refer to the data element description in FrntSideRdrLeDetn1 with the same data element name.";
CM_ SG_ 314 FrntSideRdrLeDetn36RdrDetnRngV "Range velocity ";
CM_ SG_ 314 FrntSideRdrLeDetn36RdrDetnSts "Refer to the data element description in FrntSideRdrLeDetn1 with the same data element name.";

// Attribute definitions
BA_DEF_  "BaudRateCANFD" FLOAT 1000 10000000; // [bps]
BA_DEF_  "Baudrate" INT 1000 1000000; // [bps]
BA_DEF_  "BusType" STRING;
BA_DEF_  "DBName" STRING;
BA_DEF_  "ProtocolType" STRING;
BA_DEF_ BU_ "NmAsrNode" ENUM "No","Yes";
BA_DEF_ BU_ "NmAsrNodeIdentifier" INT 0 255;
BA_DEF_ BO_ "CANFD_BRS" ENUM "0","1";
BA_DEF_ BO_ "GenMsgCycleTime" INT 0 65536; // [ms]
BA_DEF_ BO_ "GenMsgDelayTime" INT 0 65536; // [ms]
BA_DEF_ BO_ "GenMsgSendType" ENUM "cyclic", "spontaneous", "not-used", "not-used", "not-used", "cyclicAndSpontaneous", "not-used", "cyclicIfActive", "NoMsgSendType"; // [us]
BA_DEF_ BO_ "GenMsgStartDelayTime" INT 0 65536; // [ms]
BA_DEF_ BO_ "VFrameFormat" ENUM "StandardCAN","ExtendedCAN","reserved","J1939PG","reserved","reserved","reserved","reserved","reserved","reserved","reserved","reserved","reserved","reserved","StandardCAN_FD","ExtendedCAN_FD";
BA_DEF_ SG_ "GenSigSendType" ENUM "Cyclic","OnWrite","OnWriteWithRepetition","OnChange","OnChangeWithRepetition","IfActive","IfActiveWithRepetition","NoSigSendType";
BA_DEF_ SG_ "GenSigStartValue" HEX 0 80000000;
BA_DEF_ BO_ "GenMsgILSupport" ENUM "No","Yes";
BA_DEF_ BO_ "NmAsrMessage" ENUM "No","Yes";
BA_DEF_  "NmAsrBaseAddress" HEX 0 536870911;
BA_DEF_  "NmAsrMessageCount" INT 0 255;
BA_DEF_ BU_ "NodeLayerModules" STRING;
BA_DEF_ BU_ "ILused" ENUM "No","Yes";
BA_DEF_ SG_ "GenSigFuncType" ENUM "NoFunction","n/a","n/a","n/a","n/a","n/a","n/a","n/a","n/a","n/a","n/a","n/a","n/a","n/a","n/a","CHK","CNTR","n/a","n/a","n/a","CNTR_AR_01","CRC_AR_01_BOTH","CRC_AR_01_ALT","CRC_AR_01_LOW","CRC_AR_01_NIBBLE","CNTR_AR_04","CRC_AR_04A","CNTR_AR_05","CRC_AR_05";
BA_DEF_ SG_ "GenSigDataID" STRING;

BA_DEF_DEF_ "BusType" "";
BA_DEF_DEF_ "DBName" "";
BA_DEF_DEF_ "ProtocolType" "";
BA_DEF_DEF_ "NmAsrNode" "No";
BA_DEF_DEF_ "NmAsrNodeIdentifier" 0;
BA_DEF_DEF_ "CANFD_BRS" "1";
BA_DEF_DEF_ "GenSigStartValue" 0;
BA_DEF_DEF_ "VFrameFormat" "J1939PG";
BA_DEF_DEF_ "GenSigSendType" "NoSigSendType";
BA_DEF_DEF_ "GenMsgCycleTime" 0;
BA_DEF_DEF_ "GenMsgDelayTime" 0;
BA_DEF_DEF_ "GenMsgStartDelayTime" 0;
BA_DEF_DEF_ "GenMsgSendType" "NoMsgSendType";
BA_DEF_DEF_ "GenMsgILSupport" "Yes";
BA_DEF_DEF_ "NmAsrMessage" "No";
BA_DEF_DEF_ "NmAsrBaseAddress" 1280;
BA_DEF_DEF_ "NmAsrMessageCount" 64;
BA_DEF_DEF_ "NodeLayerModules" "CANoeILNLSPA.dll";
BA_DEF_DEF_ "ILused" "Yes";
BA_DEF_DEF_ "GenSigFuncType" "NoFunction";
BA_DEF_DEF_ "GenSigDataID" "";

BA_ "BaudRateCANFD" 2000000;
BA_ "Baudrate" 500000;
BA_ "BusType" "CAN FD";
BA_ "DBName" "SafetyCANFD1";
BA_ "ProtocolType" "CAN";
// Network
// ECU: ASDM
BA_ "NmAsrNode" BU_ ASDM 1;
BA_ "NmAsrNodeIdentifier" BU_ ASDM 1;
BA_ "NodeLayerModules" BU_ ASDM "CANoeILNLSPA.dll,AsrNM33.dll";
// ECU: ETC
BA_ "ILused" BU_ ETC 0;
// ECU: FSRL
BA_ "NmAsrNode" BU_ FSRL 1;
BA_ "NmAsrNodeIdentifier" BU_ FSRL 3;
BA_ "NodeLayerModules" BU_ FSRL "CANoeILNLSPA.dll,AsrNM33.dll";
// ECU: FSRR
BA_ "NmAsrNode" BU_ FSRR 1;
BA_ "NmAsrNodeIdentifier" BU_ FSRR 2;
BA_ "NodeLayerModules" BU_ FSRR "CANoeILNLSPA.dll,AsrNM33.dll";
// Frame: ASDMCanFD1TimeSyncFr
BA_ "GenMsgDelayTime" BO_ 33 50.000;
BA_ "GenMsgSendType" BO_ 33 1;
BA_ "VFrameFormat" BO_ 33 14;
// Frame: AsdmSafetyCANFD1Fr01
BA_ "GenMsgCycleTime" BO_ 288 50.000;
BA_ "GenMsgSendType" BO_ 288 0;
BA_ "VFrameFormat" BO_ 288 14;
// Frame: AsdmSafetyCANFD1Fr02
BA_ "GenMsgCycleTime" BO_ 1007 500.000;
BA_ "GenMsgSendType" BO_ 1007 0;
BA_ "VFrameFormat" BO_ 1007 14;
// Frame: AsdmSafetyCanFD1NMFr
BA_ "GenMsgDelayTime" BO_ 1281 20.000;
BA_ "GenMsgSendType" BO_ 1281 1;
BA_ "VFrameFormat" BO_ 1281 0;
// Frame: AsdmToAllFuncSafetyCanFD1DiagReqFrame
BA_ "GenMsgDelayTime" BO_ 2047 5.000;
BA_ "GenMsgSendType" BO_ 2047 1;
BA_ "VFrameFormat" BO_ 2047 14;
// Frame: AsdmToFsrlSafetyCanFD1DiagReqFrame
BA_ "GenMsgDelayTime" BO_ 1841 5.000;
BA_ "GenMsgSendType" BO_ 1841 1;
BA_ "VFrameFormat" BO_ 1841 14;
// Frame: AsdmToFsrrSafetyCanFD1DiagReqFrame
BA_ "GenMsgDelayTime" BO_ 1840 5.000;
BA_ "GenMsgSendType" BO_ 1840 1;
BA_ "VFrameFormat" BO_ 1840 14;
// Frame: EtcToFsrlXcpFr01
BA_ "GenMsgDelayTime" BO_ 1413 5.000;
BA_ "GenMsgSendType" BO_ 1413 1;
BA_ "VFrameFormat" BO_ 1413 0;
// Frame: EtcToFsrrXcpFr01
BA_ "GenMsgDelayTime" BO_ 1414 5.000;
BA_ "GenMsgSendType" BO_ 1414 1;
BA_ "VFrameFormat" BO_ 1414 0;
// Frame: FSRLSafetyCANFD1Frame00
BA_ "GenMsgCycleTime" BO_ 297 50.000;
BA_ "GenMsgSendType" BO_ 297 0;
BA_ "VFrameFormat" BO_ 297 14;
// Frame: FSRLSafetyCANFD1Frame01
BA_ "GenMsgCycleTime" BO_ 304 50.000;
BA_ "GenMsgSendType" BO_ 304 0;
BA_ "VFrameFormat" BO_ 304 14;
// Frame: FSRLSafetyCANFD1Frame02
BA_ "GenMsgCycleTime" BO_ 306 50.000;
BA_ "GenMsgSendType" BO_ 306 0;
BA_ "VFrameFormat" BO_ 306 14;
// Frame: FSRLSafetyCANFD1Frame03
BA_ "GenMsgCycleTime" BO_ 308 50.000;
BA_ "GenMsgSendType" BO_ 308 0;
BA_ "VFrameFormat" BO_ 308 14;
// Frame: FSRLSafetyCANFD1Frame04
BA_ "GenMsgCycleTime" BO_ 310 50.000;
BA_ "GenMsgSendType" BO_ 310 0;
BA_ "VFrameFormat" BO_ 310 14;
// Frame: FSRLSafetyCANFD1Frame05
BA_ "GenMsgCycleTime" BO_ 312 50.000;
BA_ "GenMsgSendType" BO_ 312 0;
BA_ "VFrameFormat" BO_ 312 14;
// Frame: FSRLSafetyCANFD1Frame06
BA_ "GenMsgCycleTime" BO_ 314 50.000;
BA_ "GenMsgSendType" BO_ 314 0;
BA_ "VFrameFormat" BO_ 314 14;
BA_ "GenMsgILSupport" BO_ 1281 0;
BA_ "NmAsrMessage" BO_ 1281 1;
BA_ "GenSigSendType" SG_ 288 ADataRawSafeALat 0;
BA_ "GenSigSendType" SG_ 288 ADataRawSafeALat1Qf 0;
BA_ "GenSigStartValue" SG_ 288 ADataRawSafeALat1Qf 1;
BA_ "GenSigSendType" SG_ 288 ADataRawSafeALgt 0;
BA_ "GenSigSendType" SG_ 288 ADataRawSafeALgt1Qf 0;
BA_ "GenSigStartValue" SG_ 288 ADataRawSafeALgt1Qf 1;
BA_ "GenSigSendType" SG_ 288 ADataRawSafeAVert 0;
BA_ "GenSigSendType" SG_ 288 ADataRawSafeAVertQf 0;
BA_ "GenSigStartValue" SG_ 288 ADataRawSafeAVertQf 1;
BA_ "GenSigDataID" SG_ 288 ADataRawSafeChks "0x22";
BA_ "GenSigFuncType" SG_ 288 ADataRawSafeChks 15;
BA_ "GenSigSendType" SG_ 288 ADataRawSafeChks 0;
BA_ "GenSigStartValue" SG_ 288 ADataRawSafeChks 255;
BA_ "GenSigFuncType" SG_ 288 ADataRawSafeCntr 16;
BA_ "GenSigSendType" SG_ 288 ADataRawSafeCntr 0;
BA_ "GenSigSendType" SG_ 288 ALgtStdFromWhlSpdALgtStdFromWhlSpd 0;
BA_ "GenSigDataID" SG_ 288 ALgtStdFromWhlSpdChks "0x34";
BA_ "GenSigFuncType" SG_ 288 ALgtStdFromWhlSpdChks 15;
BA_ "GenSigSendType" SG_ 288 ALgtStdFromWhlSpdChks 0;
BA_ "GenSigFuncType" SG_ 288 ALgtStdFromWhlSpdCntr 16;
BA_ "GenSigSendType" SG_ 288 ALgtStdFromWhlSpdCntr 0;
BA_ "GenSigSendType" SG_ 288 ALgtStdFromWhlSpdQf 0;
BA_ "GenSigStartValue" SG_ 288 ALgtStdFromWhlSpdQf 1;
BA_ "GenSigSendType" SG_ 288 AmbTRawAmbTVal 0;
BA_ "GenSigStartValue" SG_ 288 AmbTRawAmbTVal 700;
BA_ "GenSigSendType" SG_ 288 AmbTRawQly 0;
BA_ "GenSigSendType" SG_ 288 AsyDataWithCmpSafeALat1Qf 0;
BA_ "GenSigStartValue" SG_ 288 AsyDataWithCmpSafeALat1Qf 1;
BA_ "GenSigSendType" SG_ 288 AsyDataWithCmpSafeALatWithCmp 0;
BA_ "GenSigSendType" SG_ 288 AsyDataWithCmpSafeALgt1Qf 0;
BA_ "GenSigStartValue" SG_ 288 AsyDataWithCmpSafeALgt1Qf 1;
BA_ "GenSigDataID" SG_ 288 AsyDataWithCmpSafeChks "0x24";
BA_ "GenSigFuncType" SG_ 288 AsyDataWithCmpSafeChks 15;
BA_ "GenSigSendType" SG_ 288 AsyDataWithCmpSafeChks 0;
BA_ "GenSigStartValue" SG_ 288 AsyDataWithCmpSafeChks 255;
BA_ "GenSigFuncType" SG_ 288 AsyDataWithCmpSafeCntr 16;
BA_ "GenSigSendType" SG_ 288 AsyDataWithCmpSafeCntr 0;
BA_ "GenSigSendType" SG_ 288 AsyDataWithCmpSafeGrdtOfALgt 0;
BA_ "GenSigSendType" SG_ 288 AsyDataWithCmpSafeYawRateQf 0;
BA_ "GenSigStartValue" SG_ 288 AsyDataWithCmpSafeYawRateQf 1;
BA_ "GenSigSendType" SG_ 288 AsyDataWithCmpSafeYawRateWithCmp 0;
BA_ "GenSigSendType" SG_ 288 BkpOfDstTrvld 0;
BA_ "GenSigSendType" SG_ 288 CarTiGlb 0;
BA_ "GenSigSendType" SG_ 288 DrvModReq 0;
BA_ "GenSigSendType" SG_ 306 FrntSideRdrLeDetn10RdrDetnAzi 0;
BA_ "GenSigStartValue" SG_ 306 FrntSideRdrLeDetn10RdrDetnAzi 900;
BA_ "GenSigDataID" SG_ 306 FrntSideRdrLeDetn10RdrDetnChks "0x83D";
BA_ "GenSigFuncType" SG_ 306 FrntSideRdrLeDetn10RdrDetnChks 15;
BA_ "GenSigSendType" SG_ 306 FrntSideRdrLeDetn10RdrDetnChks 0;
BA_ "GenSigFuncType" SG_ 306 FrntSideRdrLeDetn10RdrDetnCntr 16;
BA_ "GenSigSendType" SG_ 306 FrntSideRdrLeDetn10RdrDetnCntr 0;
BA_ "GenSigSendType" SG_ 306 FrntSideRdrLeDetn10RdrDetnConf 0;
BA_ "GenSigSendType" SG_ 306 FrntSideRdrLeDetn10RdrDetnElevn 0;
BA_ "GenSigStartValue" SG_ 306 FrntSideRdrLeDetn10RdrDetnElevn 15;
BA_ "GenSigSendType" SG_ 306 FrntSideRdrLeDetn10RdrDetnPwr 0;
BA_ "GenSigSendType" SG_ 306 FrntSideRdrLeDetn10RdrDetnRng 0;
BA_ "GenSigStartValue" SG_ 306 FrntSideRdrLeDetn10RdrDetnRng 10050;
BA_ "GenSigSendType" SG_ 306 FrntSideRdrLeDetn10RdrDetnRngV 0;
BA_ "GenSigStartValue" SG_ 306 FrntSideRdrLeDetn10RdrDetnRngV 4000;
BA_ "GenSigSendType" SG_ 306 FrntSideRdrLeDetn10RdrDetnSts 0;
BA_ "GenSigStartValue" SG_ 306 FrntSideRdrLeDetn10RdrDetnSts 3;
BA_ "GenSigSendType" SG_ 306 FrntSideRdrLeDetn11RdrDetnAzi 0;
BA_ "GenSigStartValue" SG_ 306 FrntSideRdrLeDetn11RdrDetnAzi 900;
BA_ "GenSigDataID" SG_ 306 FrntSideRdrLeDetn11RdrDetnChks "0x83E";
BA_ "GenSigFuncType" SG_ 306 FrntSideRdrLeDetn11RdrDetnChks 15;
BA_ "GenSigSendType" SG_ 306 FrntSideRdrLeDetn11RdrDetnChks 0;
BA_ "GenSigFuncType" SG_ 306 FrntSideRdrLeDetn11RdrDetnCntr 16;
BA_ "GenSigSendType" SG_ 306 FrntSideRdrLeDetn11RdrDetnCntr 0;
BA_ "GenSigSendType" SG_ 306 FrntSideRdrLeDetn11RdrDetnConf 0;
BA_ "GenSigSendType" SG_ 306 FrntSideRdrLeDetn11RdrDetnElevn 0;
BA_ "GenSigStartValue" SG_ 306 FrntSideRdrLeDetn11RdrDetnElevn 15;
BA_ "GenSigSendType" SG_ 306 FrntSideRdrLeDetn11RdrDetnPwr 0;
BA_ "GenSigSendType" SG_ 306 FrntSideRdrLeDetn11RdrDetnRng 0;
BA_ "GenSigStartValue" SG_ 306 FrntSideRdrLeDetn11RdrDetnRng 10050;
BA_ "GenSigSendType" SG_ 306 FrntSideRdrLeDetn11RdrDetnRngV 0;
BA_ "GenSigStartValue" SG_ 306 FrntSideRdrLeDetn11RdrDetnRngV 4000;
BA_ "GenSigSendType" SG_ 306 FrntSideRdrLeDetn11RdrDetnSts 0;
BA_ "GenSigStartValue" SG_ 306 FrntSideRdrLeDetn11RdrDetnSts 3;
BA_ "GenSigSendType" SG_ 306 FrntSideRdrLeDetn12RdrDetnAzi 0;
BA_ "GenSigStartValue" SG_ 306 FrntSideRdrLeDetn12RdrDetnAzi 900;
BA_ "GenSigDataID" SG_ 306 FrntSideRdrLeDetn12RdrDetnChks "0x83F";
BA_ "GenSigFuncType" SG_ 306 FrntSideRdrLeDetn12RdrDetnChks 15;
BA_ "GenSigSendType" SG_ 306 FrntSideRdrLeDetn12RdrDetnChks 0;
BA_ "GenSigFuncType" SG_ 306 FrntSideRdrLeDetn12RdrDetnCntr 16;
BA_ "GenSigSendType" SG_ 306 FrntSideRdrLeDetn12RdrDetnCntr 0;
BA_ "GenSigSendType" SG_ 306 FrntSideRdrLeDetn12RdrDetnConf 0;
BA_ "GenSigSendType" SG_ 306 FrntSideRdrLeDetn12RdrDetnElevn 0;
BA_ "GenSigStartValue" SG_ 306 FrntSideRdrLeDetn12RdrDetnElevn 15;
BA_ "GenSigSendType" SG_ 306 FrntSideRdrLeDetn12RdrDetnPwr 0;
BA_ "GenSigSendType" SG_ 306 FrntSideRdrLeDetn12RdrDetnRng 0;
BA_ "GenSigStartValue" SG_ 306 FrntSideRdrLeDetn12RdrDetnRng 10050;
BA_ "GenSigSendType" SG_ 306 FrntSideRdrLeDetn12RdrDetnRngV 0;
BA_ "GenSigStartValue" SG_ 306 FrntSideRdrLeDetn12RdrDetnRngV 4000;
BA_ "GenSigSendType" SG_ 306 FrntSideRdrLeDetn12RdrDetnSts 0;
BA_ "GenSigStartValue" SG_ 306 FrntSideRdrLeDetn12RdrDetnSts 3;
BA_ "GenSigSendType" SG_ 308 FrntSideRdrLeDetn13RdrDetnAzi 0;
BA_ "GenSigStartValue" SG_ 308 FrntSideRdrLeDetn13RdrDetnAzi 900;
BA_ "GenSigDataID" SG_ 308 FrntSideRdrLeDetn13RdrDetnChks "0x840";
BA_ "GenSigFuncType" SG_ 308 FrntSideRdrLeDetn13RdrDetnChks 15;
BA_ "GenSigSendType" SG_ 308 FrntSideRdrLeDetn13RdrDetnChks 0;
BA_ "GenSigFuncType" SG_ 308 FrntSideRdrLeDetn13RdrDetnCntr 16;
BA_ "GenSigSendType" SG_ 308 FrntSideRdrLeDetn13RdrDetnCntr 0;
BA_ "GenSigSendType" SG_ 308 FrntSideRdrLeDetn13RdrDetnConf 0;
BA_ "GenSigSendType" SG_ 308 FrntSideRdrLeDetn13RdrDetnElevn 0;
BA_ "GenSigStartValue" SG_ 308 FrntSideRdrLeDetn13RdrDetnElevn 15;
BA_ "GenSigSendType" SG_ 308 FrntSideRdrLeDetn13RdrDetnPwr 0;
BA_ "GenSigSendType" SG_ 308 FrntSideRdrLeDetn13RdrDetnRng 0;
BA_ "GenSigStartValue" SG_ 308 FrntSideRdrLeDetn13RdrDetnRng 10050;
BA_ "GenSigSendType" SG_ 308 FrntSideRdrLeDetn13RdrDetnRngV 0;
BA_ "GenSigStartValue" SG_ 308 FrntSideRdrLeDetn13RdrDetnRngV 4000;
BA_ "GenSigSendType" SG_ 308 FrntSideRdrLeDetn13RdrDetnSts 0;
BA_ "GenSigStartValue" SG_ 308 FrntSideRdrLeDetn13RdrDetnSts 3;
BA_ "GenSigSendType" SG_ 308 FrntSideRdrLeDetn14RdrDetnAzi 0;
BA_ "GenSigStartValue" SG_ 308 FrntSideRdrLeDetn14RdrDetnAzi 900;
BA_ "GenSigDataID" SG_ 308 FrntSideRdrLeDetn14RdrDetnChks "0x841";
BA_ "GenSigFuncType" SG_ 308 FrntSideRdrLeDetn14RdrDetnChks 15;
BA_ "GenSigSendType" SG_ 308 FrntSideRdrLeDetn14RdrDetnChks 0;
BA_ "GenSigFuncType" SG_ 308 FrntSideRdrLeDetn14RdrDetnCntr 16;
BA_ "GenSigSendType" SG_ 308 FrntSideRdrLeDetn14RdrDetnCntr 0;
BA_ "GenSigSendType" SG_ 308 FrntSideRdrLeDetn14RdrDetnConf 0;
BA_ "GenSigSendType" SG_ 308 FrntSideRdrLeDetn14RdrDetnElevn 0;
BA_ "GenSigStartValue" SG_ 308 FrntSideRdrLeDetn14RdrDetnElevn 15;
BA_ "GenSigSendType" SG_ 308 FrntSideRdrLeDetn14RdrDetnPwr 0;
BA_ "GenSigSendType" SG_ 308 FrntSideRdrLeDetn14RdrDetnRng 0;
BA_ "GenSigStartValue" SG_ 308 FrntSideRdrLeDetn14RdrDetnRng 10050;
BA_ "GenSigSendType" SG_ 308 FrntSideRdrLeDetn14RdrDetnRngV 0;
BA_ "GenSigStartValue" SG_ 308 FrntSideRdrLeDetn14RdrDetnRngV 4000;
BA_ "GenSigSendType" SG_ 308 FrntSideRdrLeDetn14RdrDetnSts 0;
BA_ "GenSigStartValue" SG_ 308 FrntSideRdrLeDetn14RdrDetnSts 3;
BA_ "GenSigSendType" SG_ 308 FrntSideRdrLeDetn15RdrDetnAzi 0;
BA_ "GenSigStartValue" SG_ 308 FrntSideRdrLeDetn15RdrDetnAzi 900;
BA_ "GenSigDataID" SG_ 308 FrntSideRdrLeDetn15RdrDetnChks "0x842";
BA_ "GenSigFuncType" SG_ 308 FrntSideRdrLeDetn15RdrDetnChks 15;
BA_ "GenSigSendType" SG_ 308 FrntSideRdrLeDetn15RdrDetnChks 0;
BA_ "GenSigFuncType" SG_ 308 FrntSideRdrLeDetn15RdrDetnCntr 16;
BA_ "GenSigSendType" SG_ 308 FrntSideRdrLeDetn15RdrDetnCntr 0;
BA_ "GenSigSendType" SG_ 308 FrntSideRdrLeDetn15RdrDetnConf 0;
BA_ "GenSigSendType" SG_ 308 FrntSideRdrLeDetn15RdrDetnElevn 0;
BA_ "GenSigStartValue" SG_ 308 FrntSideRdrLeDetn15RdrDetnElevn 15;
BA_ "GenSigSendType" SG_ 308 FrntSideRdrLeDetn15RdrDetnPwr 0;
BA_ "GenSigSendType" SG_ 308 FrntSideRdrLeDetn15RdrDetnRng 0;
BA_ "GenSigStartValue" SG_ 308 FrntSideRdrLeDetn15RdrDetnRng 10050;
BA_ "GenSigSendType" SG_ 308 FrntSideRdrLeDetn15RdrDetnRngV 0;
BA_ "GenSigStartValue" SG_ 308 FrntSideRdrLeDetn15RdrDetnRngV 4000;
BA_ "GenSigSendType" SG_ 308 FrntSideRdrLeDetn15RdrDetnSts 0;
BA_ "GenSigStartValue" SG_ 308 FrntSideRdrLeDetn15RdrDetnSts 3;
BA_ "GenSigSendType" SG_ 308 FrntSideRdrLeDetn16RdrDetnAzi 0;
BA_ "GenSigStartValue" SG_ 308 FrntSideRdrLeDetn16RdrDetnAzi 900;
BA_ "GenSigDataID" SG_ 308 FrntSideRdrLeDetn16RdrDetnChks "0x843";
BA_ "GenSigFuncType" SG_ 308 FrntSideRdrLeDetn16RdrDetnChks 15;
BA_ "GenSigSendType" SG_ 308 FrntSideRdrLeDetn16RdrDetnChks 0;
BA_ "GenSigFuncType" SG_ 308 FrntSideRdrLeDetn16RdrDetnCntr 16;
BA_ "GenSigSendType" SG_ 308 FrntSideRdrLeDetn16RdrDetnCntr 0;
BA_ "GenSigSendType" SG_ 308 FrntSideRdrLeDetn16RdrDetnConf 0;
BA_ "GenSigSendType" SG_ 308 FrntSideRdrLeDetn16RdrDetnElevn 0;
BA_ "GenSigStartValue" SG_ 308 FrntSideRdrLeDetn16RdrDetnElevn 15;
BA_ "GenSigSendType" SG_ 308 FrntSideRdrLeDetn16RdrDetnPwr 0;
BA_ "GenSigSendType" SG_ 308 FrntSideRdrLeDetn16RdrDetnRng 0;
BA_ "GenSigStartValue" SG_ 308 FrntSideRdrLeDetn16RdrDetnRng 10050;
BA_ "GenSigSendType" SG_ 308 FrntSideRdrLeDetn16RdrDetnRngV 0;
BA_ "GenSigStartValue" SG_ 308 FrntSideRdrLeDetn16RdrDetnRngV 4000;
BA_ "GenSigSendType" SG_ 308 FrntSideRdrLeDetn16RdrDetnSts 0;
BA_ "GenSigStartValue" SG_ 308 FrntSideRdrLeDetn16RdrDetnSts 3;
BA_ "GenSigSendType" SG_ 308 FrntSideRdrLeDetn17RdrDetnAzi 0;
BA_ "GenSigStartValue" SG_ 308 FrntSideRdrLeDetn17RdrDetnAzi 900;
BA_ "GenSigDataID" SG_ 308 FrntSideRdrLeDetn17RdrDetnChks "0x844";
BA_ "GenSigFuncType" SG_ 308 FrntSideRdrLeDetn17RdrDetnChks 15;
BA_ "GenSigSendType" SG_ 308 FrntSideRdrLeDetn17RdrDetnChks 0;
BA_ "GenSigFuncType" SG_ 308 FrntSideRdrLeDetn17RdrDetnCntr 16;
BA_ "GenSigSendType" SG_ 308 FrntSideRdrLeDetn17RdrDetnCntr 0;
BA_ "GenSigSendType" SG_ 308 FrntSideRdrLeDetn17RdrDetnConf 0;
BA_ "GenSigSendType" SG_ 308 FrntSideRdrLeDetn17RdrDetnElevn 0;
BA_ "GenSigStartValue" SG_ 308 FrntSideRdrLeDetn17RdrDetnElevn 15;
BA_ "GenSigSendType" SG_ 308 FrntSideRdrLeDetn17RdrDetnPwr 0;
BA_ "GenSigSendType" SG_ 308 FrntSideRdrLeDetn17RdrDetnRng 0;
BA_ "GenSigStartValue" SG_ 308 FrntSideRdrLeDetn17RdrDetnRng 10050;
BA_ "GenSigSendType" SG_ 308 FrntSideRdrLeDetn17RdrDetnRngV 0;
BA_ "GenSigStartValue" SG_ 308 FrntSideRdrLeDetn17RdrDetnRngV 4000;
BA_ "GenSigSendType" SG_ 308 FrntSideRdrLeDetn17RdrDetnSts 0;
BA_ "GenSigStartValue" SG_ 308 FrntSideRdrLeDetn17RdrDetnSts 3;
BA_ "GenSigSendType" SG_ 308 FrntSideRdrLeDetn18RdrDetnAzi 0;
BA_ "GenSigStartValue" SG_ 308 FrntSideRdrLeDetn18RdrDetnAzi 900;
BA_ "GenSigDataID" SG_ 308 FrntSideRdrLeDetn18RdrDetnChks "0x845";
BA_ "GenSigFuncType" SG_ 308 FrntSideRdrLeDetn18RdrDetnChks 15;
BA_ "GenSigSendType" SG_ 308 FrntSideRdrLeDetn18RdrDetnChks 0;
BA_ "GenSigFuncType" SG_ 308 FrntSideRdrLeDetn18RdrDetnCntr 16;
BA_ "GenSigSendType" SG_ 308 FrntSideRdrLeDetn18RdrDetnCntr 0;
BA_ "GenSigSendType" SG_ 308 FrntSideRdrLeDetn18RdrDetnConf 0;
BA_ "GenSigSendType" SG_ 308 FrntSideRdrLeDetn18RdrDetnElevn 0;
BA_ "GenSigStartValue" SG_ 308 FrntSideRdrLeDetn18RdrDetnElevn 15;
BA_ "GenSigSendType" SG_ 308 FrntSideRdrLeDetn18RdrDetnPwr 0;
BA_ "GenSigSendType" SG_ 308 FrntSideRdrLeDetn18RdrDetnRng 0;
BA_ "GenSigStartValue" SG_ 308 FrntSideRdrLeDetn18RdrDetnRng 10050;
BA_ "GenSigSendType" SG_ 308 FrntSideRdrLeDetn18RdrDetnRngV 0;
BA_ "GenSigStartValue" SG_ 308 FrntSideRdrLeDetn18RdrDetnRngV 4000;
BA_ "GenSigSendType" SG_ 308 FrntSideRdrLeDetn18RdrDetnSts 0;
BA_ "GenSigStartValue" SG_ 308 FrntSideRdrLeDetn18RdrDetnSts 3;
BA_ "GenSigSendType" SG_ 310 FrntSideRdrLeDetn19RdrDetnAzi 0;
BA_ "GenSigStartValue" SG_ 310 FrntSideRdrLeDetn19RdrDetnAzi 900;
BA_ "GenSigDataID" SG_ 310 FrntSideRdrLeDetn19RdrDetnChks "0x846";
BA_ "GenSigFuncType" SG_ 310 FrntSideRdrLeDetn19RdrDetnChks 15;
BA_ "GenSigSendType" SG_ 310 FrntSideRdrLeDetn19RdrDetnChks 0;
BA_ "GenSigFuncType" SG_ 310 FrntSideRdrLeDetn19RdrDetnCntr 16;
BA_ "GenSigSendType" SG_ 310 FrntSideRdrLeDetn19RdrDetnCntr 0;
BA_ "GenSigSendType" SG_ 310 FrntSideRdrLeDetn19RdrDetnConf 0;
BA_ "GenSigSendType" SG_ 310 FrntSideRdrLeDetn19RdrDetnElevn 0;
BA_ "GenSigStartValue" SG_ 310 FrntSideRdrLeDetn19RdrDetnElevn 15;
BA_ "GenSigSendType" SG_ 310 FrntSideRdrLeDetn19RdrDetnPwr 0;
BA_ "GenSigSendType" SG_ 310 FrntSideRdrLeDetn19RdrDetnRng 0;
BA_ "GenSigStartValue" SG_ 310 FrntSideRdrLeDetn19RdrDetnRng 10050;
BA_ "GenSigSendType" SG_ 310 FrntSideRdrLeDetn19RdrDetnRngV 0;
BA_ "GenSigStartValue" SG_ 310 FrntSideRdrLeDetn19RdrDetnRngV 4000;
BA_ "GenSigSendType" SG_ 310 FrntSideRdrLeDetn19RdrDetnSts 0;
BA_ "GenSigStartValue" SG_ 310 FrntSideRdrLeDetn19RdrDetnSts 3;
BA_ "GenSigSendType" SG_ 304 FrntSideRdrLeDetn1RdrDetnAzi 0;
BA_ "GenSigStartValue" SG_ 304 FrntSideRdrLeDetn1RdrDetnAzi 900;
BA_ "GenSigDataID" SG_ 304 FrntSideRdrLeDetn1RdrDetnChks "0x834";
BA_ "GenSigFuncType" SG_ 304 FrntSideRdrLeDetn1RdrDetnChks 15;
BA_ "GenSigSendType" SG_ 304 FrntSideRdrLeDetn1RdrDetnChks 0;
BA_ "GenSigFuncType" SG_ 304 FrntSideRdrLeDetn1RdrDetnCntr 16;
BA_ "GenSigSendType" SG_ 304 FrntSideRdrLeDetn1RdrDetnCntr 0;
BA_ "GenSigSendType" SG_ 304 FrntSideRdrLeDetn1RdrDetnConf 0;
BA_ "GenSigSendType" SG_ 304 FrntSideRdrLeDetn1RdrDetnElevn 0;
BA_ "GenSigStartValue" SG_ 304 FrntSideRdrLeDetn1RdrDetnElevn 15;
BA_ "GenSigSendType" SG_ 304 FrntSideRdrLeDetn1RdrDetnPwr 0;
BA_ "GenSigSendType" SG_ 304 FrntSideRdrLeDetn1RdrDetnRng 0;
BA_ "GenSigStartValue" SG_ 304 FrntSideRdrLeDetn1RdrDetnRng 10050;
BA_ "GenSigSendType" SG_ 304 FrntSideRdrLeDetn1RdrDetnRngV 0;
BA_ "GenSigStartValue" SG_ 304 FrntSideRdrLeDetn1RdrDetnRngV 4000;
BA_ "GenSigSendType" SG_ 304 FrntSideRdrLeDetn1RdrDetnSts 0;
BA_ "GenSigStartValue" SG_ 304 FrntSideRdrLeDetn1RdrDetnSts 3;
BA_ "GenSigSendType" SG_ 310 FrntSideRdrLeDetn20RdrDetnAzi 0;
BA_ "GenSigStartValue" SG_ 310 FrntSideRdrLeDetn20RdrDetnAzi 900;
BA_ "GenSigDataID" SG_ 310 FrntSideRdrLeDetn20RdrDetnChks "0x847";
BA_ "GenSigFuncType" SG_ 310 FrntSideRdrLeDetn20RdrDetnChks 15;
BA_ "GenSigSendType" SG_ 310 FrntSideRdrLeDetn20RdrDetnChks 0;
BA_ "GenSigFuncType" SG_ 310 FrntSideRdrLeDetn20RdrDetnCntr 16;
BA_ "GenSigSendType" SG_ 310 FrntSideRdrLeDetn20RdrDetnCntr 0;
BA_ "GenSigSendType" SG_ 310 FrntSideRdrLeDetn20RdrDetnConf 0;
BA_ "GenSigSendType" SG_ 310 FrntSideRdrLeDetn20RdrDetnElevn 0;
BA_ "GenSigStartValue" SG_ 310 FrntSideRdrLeDetn20RdrDetnElevn 15;
BA_ "GenSigSendType" SG_ 310 FrntSideRdrLeDetn20RdrDetnPwr 0;
BA_ "GenSigSendType" SG_ 310 FrntSideRdrLeDetn20RdrDetnRng 0;
BA_ "GenSigStartValue" SG_ 310 FrntSideRdrLeDetn20RdrDetnRng 10050;
BA_ "GenSigSendType" SG_ 310 FrntSideRdrLeDetn20RdrDetnRngV 0;
BA_ "GenSigStartValue" SG_ 310 FrntSideRdrLeDetn20RdrDetnRngV 4000;
BA_ "GenSigSendType" SG_ 310 FrntSideRdrLeDetn20RdrDetnSts 0;
BA_ "GenSigStartValue" SG_ 310 FrntSideRdrLeDetn20RdrDetnSts 3;
BA_ "GenSigSendType" SG_ 310 FrntSideRdrLeDetn21RdrDetnAzi 0;
BA_ "GenSigStartValue" SG_ 310 FrntSideRdrLeDetn21RdrDetnAzi 900;
BA_ "GenSigDataID" SG_ 310 FrntSideRdrLeDetn21RdrDetnChks "0x848";
BA_ "GenSigFuncType" SG_ 310 FrntSideRdrLeDetn21RdrDetnChks 15;
BA_ "GenSigSendType" SG_ 310 FrntSideRdrLeDetn21RdrDetnChks 0;
BA_ "GenSigFuncType" SG_ 310 FrntSideRdrLeDetn21RdrDetnCntr 16;
BA_ "GenSigSendType" SG_ 310 FrntSideRdrLeDetn21RdrDetnCntr 0;
BA_ "GenSigSendType" SG_ 310 FrntSideRdrLeDetn21RdrDetnConf 0;
BA_ "GenSigSendType" SG_ 310 FrntSideRdrLeDetn21RdrDetnElevn 0;
BA_ "GenSigStartValue" SG_ 310 FrntSideRdrLeDetn21RdrDetnElevn 15;
BA_ "GenSigSendType" SG_ 310 FrntSideRdrLeDetn21RdrDetnPwr 0;
BA_ "GenSigSendType" SG_ 310 FrntSideRdrLeDetn21RdrDetnRng 0;
BA_ "GenSigStartValue" SG_ 310 FrntSideRdrLeDetn21RdrDetnRng 10050;
BA_ "GenSigSendType" SG_ 310 FrntSideRdrLeDetn21RdrDetnRngV 0;
BA_ "GenSigStartValue" SG_ 310 FrntSideRdrLeDetn21RdrDetnRngV 4000;
BA_ "GenSigSendType" SG_ 310 FrntSideRdrLeDetn21RdrDetnSts 0;
BA_ "GenSigStartValue" SG_ 310 FrntSideRdrLeDetn21RdrDetnSts 3;
BA_ "GenSigSendType" SG_ 310 FrntSideRdrLeDetn22RdrDetnAzi 0;
BA_ "GenSigStartValue" SG_ 310 FrntSideRdrLeDetn22RdrDetnAzi 900;
BA_ "GenSigDataID" SG_ 310 FrntSideRdrLeDetn22RdrDetnChks "0x849";
BA_ "GenSigFuncType" SG_ 310 FrntSideRdrLeDetn22RdrDetnChks 15;
BA_ "GenSigSendType" SG_ 310 FrntSideRdrLeDetn22RdrDetnChks 0;
BA_ "GenSigFuncType" SG_ 310 FrntSideRdrLeDetn22RdrDetnCntr 16;
BA_ "GenSigSendType" SG_ 310 FrntSideRdrLeDetn22RdrDetnCntr 0;
BA_ "GenSigSendType" SG_ 310 FrntSideRdrLeDetn22RdrDetnConf 0;
BA_ "GenSigSendType" SG_ 310 FrntSideRdrLeDetn22RdrDetnElevn 0;
BA_ "GenSigStartValue" SG_ 310 FrntSideRdrLeDetn22RdrDetnElevn 15;
BA_ "GenSigSendType" SG_ 310 FrntSideRdrLeDetn22RdrDetnPwr 0;
BA_ "GenSigSendType" SG_ 310 FrntSideRdrLeDetn22RdrDetnRng 0;
BA_ "GenSigStartValue" SG_ 310 FrntSideRdrLeDetn22RdrDetnRng 10050;
BA_ "GenSigSendType" SG_ 310 FrntSideRdrLeDetn22RdrDetnRngV 0;
BA_ "GenSigStartValue" SG_ 310 FrntSideRdrLeDetn22RdrDetnRngV 4000;
BA_ "GenSigSendType" SG_ 310 FrntSideRdrLeDetn22RdrDetnSts 0;
BA_ "GenSigStartValue" SG_ 310 FrntSideRdrLeDetn22RdrDetnSts 3;
BA_ "GenSigSendType" SG_ 310 FrntSideRdrLeDetn23RdrDetnAzi 0;
BA_ "GenSigStartValue" SG_ 310 FrntSideRdrLeDetn23RdrDetnAzi 900;
BA_ "GenSigDataID" SG_ 310 FrntSideRdrLeDetn23RdrDetnChks "0x84A";
BA_ "GenSigFuncType" SG_ 310 FrntSideRdrLeDetn23RdrDetnChks 15;
BA_ "GenSigSendType" SG_ 310 FrntSideRdrLeDetn23RdrDetnChks 0;
BA_ "GenSigFuncType" SG_ 310 FrntSideRdrLeDetn23RdrDetnCntr 16;
BA_ "GenSigSendType" SG_ 310 FrntSideRdrLeDetn23RdrDetnCntr 0;
BA_ "GenSigSendType" SG_ 310 FrntSideRdrLeDetn23RdrDetnConf 0;
BA_ "GenSigSendType" SG_ 310 FrntSideRdrLeDetn23RdrDetnElevn 0;
BA_ "GenSigStartValue" SG_ 310 FrntSideRdrLeDetn23RdrDetnElevn 15;
BA_ "GenSigSendType" SG_ 310 FrntSideRdrLeDetn23RdrDetnPwr 0;
BA_ "GenSigSendType" SG_ 310 FrntSideRdrLeDetn23RdrDetnRng 0;
BA_ "GenSigStartValue" SG_ 310 FrntSideRdrLeDetn23RdrDetnRng 10050;
BA_ "GenSigSendType" SG_ 310 FrntSideRdrLeDetn23RdrDetnRngV 0;
BA_ "GenSigStartValue" SG_ 310 FrntSideRdrLeDetn23RdrDetnRngV 4000;
BA_ "GenSigSendType" SG_ 310 FrntSideRdrLeDetn23RdrDetnSts 0;
BA_ "GenSigStartValue" SG_ 310 FrntSideRdrLeDetn23RdrDetnSts 3;
BA_ "GenSigSendType" SG_ 310 FrntSideRdrLeDetn24RdrDetnAzi 0;
BA_ "GenSigStartValue" SG_ 310 FrntSideRdrLeDetn24RdrDetnAzi 900;
BA_ "GenSigDataID" SG_ 310 FrntSideRdrLeDetn24RdrDetnChks "0x84B";
BA_ "GenSigFuncType" SG_ 310 FrntSideRdrLeDetn24RdrDetnChks 15;
BA_ "GenSigSendType" SG_ 310 FrntSideRdrLeDetn24RdrDetnChks 0;
BA_ "GenSigFuncType" SG_ 310 FrntSideRdrLeDetn24RdrDetnCntr 16;
BA_ "GenSigSendType" SG_ 310 FrntSideRdrLeDetn24RdrDetnCntr 0;
BA_ "GenSigSendType" SG_ 310 FrntSideRdrLeDetn24RdrDetnConf 0;
BA_ "GenSigSendType" SG_ 310 FrntSideRdrLeDetn24RdrDetnElevn 0;
BA_ "GenSigStartValue" SG_ 310 FrntSideRdrLeDetn24RdrDetnElevn 15;
BA_ "GenSigSendType" SG_ 310 FrntSideRdrLeDetn24RdrDetnPwr 0;
BA_ "GenSigSendType" SG_ 310 FrntSideRdrLeDetn24RdrDetnRng 0;
BA_ "GenSigStartValue" SG_ 310 FrntSideRdrLeDetn24RdrDetnRng 10050;
BA_ "GenSigSendType" SG_ 310 FrntSideRdrLeDetn24RdrDetnRngV 0;
BA_ "GenSigStartValue" SG_ 310 FrntSideRdrLeDetn24RdrDetnRngV 4000;
BA_ "GenSigSendType" SG_ 310 FrntSideRdrLeDetn24RdrDetnSts 0;
BA_ "GenSigStartValue" SG_ 310 FrntSideRdrLeDetn24RdrDetnSts 3;
BA_ "GenSigSendType" SG_ 312 FrntSideRdrLeDetn25RdrDetnAzi 0;
BA_ "GenSigStartValue" SG_ 312 FrntSideRdrLeDetn25RdrDetnAzi 900;
BA_ "GenSigDataID" SG_ 312 FrntSideRdrLeDetn25RdrDetnChks "0x84C";
BA_ "GenSigFuncType" SG_ 312 FrntSideRdrLeDetn25RdrDetnChks 15;
BA_ "GenSigSendType" SG_ 312 FrntSideRdrLeDetn25RdrDetnChks 0;
BA_ "GenSigFuncType" SG_ 312 FrntSideRdrLeDetn25RdrDetnCntr 16;
BA_ "GenSigSendType" SG_ 312 FrntSideRdrLeDetn25RdrDetnCntr 0;
BA_ "GenSigSendType" SG_ 312 FrntSideRdrLeDetn25RdrDetnConf 0;
BA_ "GenSigSendType" SG_ 312 FrntSideRdrLeDetn25RdrDetnElevn 0;
BA_ "GenSigStartValue" SG_ 312 FrntSideRdrLeDetn25RdrDetnElevn 15;
BA_ "GenSigSendType" SG_ 312 FrntSideRdrLeDetn25RdrDetnPwr 0;
BA_ "GenSigSendType" SG_ 312 FrntSideRdrLeDetn25RdrDetnRng 0;
BA_ "GenSigStartValue" SG_ 312 FrntSideRdrLeDetn25RdrDetnRng 10050;
BA_ "GenSigSendType" SG_ 312 FrntSideRdrLeDetn25RdrDetnRngV 0;
BA_ "GenSigStartValue" SG_ 312 FrntSideRdrLeDetn25RdrDetnRngV 4000;
BA_ "GenSigSendType" SG_ 312 FrntSideRdrLeDetn25RdrDetnSts 0;
BA_ "GenSigStartValue" SG_ 312 FrntSideRdrLeDetn25RdrDetnSts 3;
BA_ "GenSigSendType" SG_ 312 FrntSideRdrLeDetn26RdrDetnAzi 0;
BA_ "GenSigStartValue" SG_ 312 FrntSideRdrLeDetn26RdrDetnAzi 900;
BA_ "GenSigDataID" SG_ 312 FrntSideRdrLeDetn26RdrDetnChks "0x84D";
BA_ "GenSigFuncType" SG_ 312 FrntSideRdrLeDetn26RdrDetnChks 15;
BA_ "GenSigSendType" SG_ 312 FrntSideRdrLeDetn26RdrDetnChks 0;
BA_ "GenSigFuncType" SG_ 312 FrntSideRdrLeDetn26RdrDetnCntr 16;
BA_ "GenSigSendType" SG_ 312 FrntSideRdrLeDetn26RdrDetnCntr 0;
BA_ "GenSigSendType" SG_ 312 FrntSideRdrLeDetn26RdrDetnConf 0;
BA_ "GenSigSendType" SG_ 312 FrntSideRdrLeDetn26RdrDetnElevn 0;
BA_ "GenSigStartValue" SG_ 312 FrntSideRdrLeDetn26RdrDetnElevn 15;
BA_ "GenSigSendType" SG_ 312 FrntSideRdrLeDetn26RdrDetnPwr 0;
BA_ "GenSigSendType" SG_ 312 FrntSideRdrLeDetn26RdrDetnRng 0;
BA_ "GenSigStartValue" SG_ 312 FrntSideRdrLeDetn26RdrDetnRng 10050;
BA_ "GenSigSendType" SG_ 312 FrntSideRdrLeDetn26RdrDetnRngV 0;
BA_ "GenSigStartValue" SG_ 312 FrntSideRdrLeDetn26RdrDetnRngV 4000;
BA_ "GenSigSendType" SG_ 312 FrntSideRdrLeDetn26RdrDetnSts 0;
BA_ "GenSigStartValue" SG_ 312 FrntSideRdrLeDetn26RdrDetnSts 3;
BA_ "GenSigSendType" SG_ 312 FrntSideRdrLeDetn27RdrDetnAzi 0;
BA_ "GenSigStartValue" SG_ 312 FrntSideRdrLeDetn27RdrDetnAzi 900;
BA_ "GenSigDataID" SG_ 312 FrntSideRdrLeDetn27RdrDetnChks "0x84E";
BA_ "GenSigFuncType" SG_ 312 FrntSideRdrLeDetn27RdrDetnChks 15;
BA_ "GenSigSendType" SG_ 312 FrntSideRdrLeDetn27RdrDetnChks 0;
BA_ "GenSigFuncType" SG_ 312 FrntSideRdrLeDetn27RdrDetnCntr 16;
BA_ "GenSigSendType" SG_ 312 FrntSideRdrLeDetn27RdrDetnCntr 0;
BA_ "GenSigSendType" SG_ 312 FrntSideRdrLeDetn27RdrDetnConf 0;
BA_ "GenSigSendType" SG_ 312 FrntSideRdrLeDetn27RdrDetnElevn 0;
BA_ "GenSigStartValue" SG_ 312 FrntSideRdrLeDetn27RdrDetnElevn 15;
BA_ "GenSigSendType" SG_ 312 FrntSideRdrLeDetn27RdrDetnPwr 0;
BA_ "GenSigSendType" SG_ 312 FrntSideRdrLeDetn27RdrDetnRng 0;
BA_ "GenSigStartValue" SG_ 312 FrntSideRdrLeDetn27RdrDetnRng 10050;
BA_ "GenSigSendType" SG_ 312 FrntSideRdrLeDetn27RdrDetnRngV 0;
BA_ "GenSigStartValue" SG_ 312 FrntSideRdrLeDetn27RdrDetnRngV 4000;
BA_ "GenSigSendType" SG_ 312 FrntSideRdrLeDetn27RdrDetnSts 0;
BA_ "GenSigStartValue" SG_ 312 FrntSideRdrLeDetn27RdrDetnSts 3;
BA_ "GenSigSendType" SG_ 312 FrntSideRdrLeDetn28RdrDetnAzi 0;
BA_ "GenSigStartValue" SG_ 312 FrntSideRdrLeDetn28RdrDetnAzi 900;
BA_ "GenSigDataID" SG_ 312 FrntSideRdrLeDetn28RdrDetnChks "0x84F";
BA_ "GenSigFuncType" SG_ 312 FrntSideRdrLeDetn28RdrDetnChks 15;
BA_ "GenSigSendType" SG_ 312 FrntSideRdrLeDetn28RdrDetnChks 0;
BA_ "GenSigFuncType" SG_ 312 FrntSideRdrLeDetn28RdrDetnCntr 16;
BA_ "GenSigSendType" SG_ 312 FrntSideRdrLeDetn28RdrDetnCntr 0;
BA_ "GenSigSendType" SG_ 312 FrntSideRdrLeDetn28RdrDetnConf 0;
BA_ "GenSigSendType" SG_ 312 FrntSideRdrLeDetn28RdrDetnElevn 0;
BA_ "GenSigStartValue" SG_ 312 FrntSideRdrLeDetn28RdrDetnElevn 15;
BA_ "GenSigSendType" SG_ 312 FrntSideRdrLeDetn28RdrDetnPwr 0;
BA_ "GenSigSendType" SG_ 312 FrntSideRdrLeDetn28RdrDetnRng 0;
BA_ "GenSigStartValue" SG_ 312 FrntSideRdrLeDetn28RdrDetnRng 10050;
BA_ "GenSigSendType" SG_ 312 FrntSideRdrLeDetn28RdrDetnRngV 0;
BA_ "GenSigStartValue" SG_ 312 FrntSideRdrLeDetn28RdrDetnRngV 4000;
BA_ "GenSigSendType" SG_ 312 FrntSideRdrLeDetn28RdrDetnSts 0;
BA_ "GenSigStartValue" SG_ 312 FrntSideRdrLeDetn28RdrDetnSts 3;
BA_ "GenSigSendType" SG_ 312 FrntSideRdrLeDetn29RdrDetnAzi 0;
BA_ "GenSigStartValue" SG_ 312 FrntSideRdrLeDetn29RdrDetnAzi 900;
BA_ "GenSigDataID" SG_ 312 FrntSideRdrLeDetn29RdrDetnChks "0x850";
BA_ "GenSigFuncType" SG_ 312 FrntSideRdrLeDetn29RdrDetnChks 15;
BA_ "GenSigSendType" SG_ 312 FrntSideRdrLeDetn29RdrDetnChks 0;
BA_ "GenSigFuncType" SG_ 312 FrntSideRdrLeDetn29RdrDetnCntr 16;
BA_ "GenSigSendType" SG_ 312 FrntSideRdrLeDetn29RdrDetnCntr 0;
BA_ "GenSigSendType" SG_ 312 FrntSideRdrLeDetn29RdrDetnConf 0;
BA_ "GenSigSendType" SG_ 312 FrntSideRdrLeDetn29RdrDetnElevn 0;
BA_ "GenSigStartValue" SG_ 312 FrntSideRdrLeDetn29RdrDetnElevn 15;
BA_ "GenSigSendType" SG_ 312 FrntSideRdrLeDetn29RdrDetnPwr 0;
BA_ "GenSigSendType" SG_ 312 FrntSideRdrLeDetn29RdrDetnRng 0;
BA_ "GenSigStartValue" SG_ 312 FrntSideRdrLeDetn29RdrDetnRng 10050;
BA_ "GenSigSendType" SG_ 312 FrntSideRdrLeDetn29RdrDetnRngV 0;
BA_ "GenSigStartValue" SG_ 312 FrntSideRdrLeDetn29RdrDetnRngV 4000;
BA_ "GenSigSendType" SG_ 312 FrntSideRdrLeDetn29RdrDetnSts 0;
BA_ "GenSigStartValue" SG_ 312 FrntSideRdrLeDetn29RdrDetnSts 3;
BA_ "GenSigSendType" SG_ 304 FrntSideRdrLeDetn2RdrDetnAzi 0;
BA_ "GenSigStartValue" SG_ 304 FrntSideRdrLeDetn2RdrDetnAzi 900;
BA_ "GenSigDataID" SG_ 304 FrntSideRdrLeDetn2RdrDetnChks "0x835";
BA_ "GenSigFuncType" SG_ 304 FrntSideRdrLeDetn2RdrDetnChks 15;
BA_ "GenSigSendType" SG_ 304 FrntSideRdrLeDetn2RdrDetnChks 0;
BA_ "GenSigFuncType" SG_ 304 FrntSideRdrLeDetn2RdrDetnCntr 16;
BA_ "GenSigSendType" SG_ 304 FrntSideRdrLeDetn2RdrDetnCntr 0;
BA_ "GenSigSendType" SG_ 304 FrntSideRdrLeDetn2RdrDetnConf 0;
BA_ "GenSigSendType" SG_ 304 FrntSideRdrLeDetn2RdrDetnElevn 0;
BA_ "GenSigStartValue" SG_ 304 FrntSideRdrLeDetn2RdrDetnElevn 15;
BA_ "GenSigSendType" SG_ 304 FrntSideRdrLeDetn2RdrDetnPwr 0;
BA_ "GenSigSendType" SG_ 304 FrntSideRdrLeDetn2RdrDetnRng 0;
BA_ "GenSigStartValue" SG_ 304 FrntSideRdrLeDetn2RdrDetnRng 10050;
BA_ "GenSigSendType" SG_ 304 FrntSideRdrLeDetn2RdrDetnRngV 0;
BA_ "GenSigStartValue" SG_ 304 FrntSideRdrLeDetn2RdrDetnRngV 4000;
BA_ "GenSigSendType" SG_ 304 FrntSideRdrLeDetn2RdrDetnSts 0;
BA_ "GenSigStartValue" SG_ 304 FrntSideRdrLeDetn2RdrDetnSts 3;
BA_ "GenSigSendType" SG_ 312 FrntSideRdrLeDetn30RdrDetnAzi 0;
BA_ "GenSigStartValue" SG_ 312 FrntSideRdrLeDetn30RdrDetnAzi 900;
BA_ "GenSigDataID" SG_ 312 FrntSideRdrLeDetn30RdrDetnChks "0x851";
BA_ "GenSigFuncType" SG_ 312 FrntSideRdrLeDetn30RdrDetnChks 15;
BA_ "GenSigSendType" SG_ 312 FrntSideRdrLeDetn30RdrDetnChks 0;
BA_ "GenSigFuncType" SG_ 312 FrntSideRdrLeDetn30RdrDetnCntr 16;
BA_ "GenSigSendType" SG_ 312 FrntSideRdrLeDetn30RdrDetnCntr 0;
BA_ "GenSigSendType" SG_ 312 FrntSideRdrLeDetn30RdrDetnConf 0;
BA_ "GenSigSendType" SG_ 312 FrntSideRdrLeDetn30RdrDetnElevn 0;
BA_ "GenSigStartValue" SG_ 312 FrntSideRdrLeDetn30RdrDetnElevn 15;
BA_ "GenSigSendType" SG_ 312 FrntSideRdrLeDetn30RdrDetnPwr 0;
BA_ "GenSigSendType" SG_ 312 FrntSideRdrLeDetn30RdrDetnRng 0;
BA_ "GenSigStartValue" SG_ 312 FrntSideRdrLeDetn30RdrDetnRng 10050;
BA_ "GenSigSendType" SG_ 312 FrntSideRdrLeDetn30RdrDetnRngV 0;
BA_ "GenSigStartValue" SG_ 312 FrntSideRdrLeDetn30RdrDetnRngV 4000;
BA_ "GenSigSendType" SG_ 312 FrntSideRdrLeDetn30RdrDetnSts 0;
BA_ "GenSigStartValue" SG_ 312 FrntSideRdrLeDetn30RdrDetnSts 3;
BA_ "GenSigSendType" SG_ 314 FrntSideRdrLeDetn31RdrDetnAzi 0;
BA_ "GenSigStartValue" SG_ 314 FrntSideRdrLeDetn31RdrDetnAzi 900;
BA_ "GenSigDataID" SG_ 314 FrntSideRdrLeDetn31RdrDetnChks "0x852";
BA_ "GenSigFuncType" SG_ 314 FrntSideRdrLeDetn31RdrDetnChks 15;
BA_ "GenSigSendType" SG_ 314 FrntSideRdrLeDetn31RdrDetnChks 0;
BA_ "GenSigFuncType" SG_ 314 FrntSideRdrLeDetn31RdrDetnCntr 16;
BA_ "GenSigSendType" SG_ 314 FrntSideRdrLeDetn31RdrDetnCntr 0;
BA_ "GenSigSendType" SG_ 314 FrntSideRdrLeDetn31RdrDetnConf 0;
BA_ "GenSigSendType" SG_ 314 FrntSideRdrLeDetn31RdrDetnElevn 0;
BA_ "GenSigStartValue" SG_ 314 FrntSideRdrLeDetn31RdrDetnElevn 15;
BA_ "GenSigSendType" SG_ 314 FrntSideRdrLeDetn31RdrDetnPwr 0;
BA_ "GenSigSendType" SG_ 314 FrntSideRdrLeDetn31RdrDetnRng 0;
BA_ "GenSigStartValue" SG_ 314 FrntSideRdrLeDetn31RdrDetnRng 10050;
BA_ "GenSigSendType" SG_ 314 FrntSideRdrLeDetn31RdrDetnRngV 0;
BA_ "GenSigStartValue" SG_ 314 FrntSideRdrLeDetn31RdrDetnRngV 4000;
BA_ "GenSigSendType" SG_ 314 FrntSideRdrLeDetn31RdrDetnSts 0;
BA_ "GenSigStartValue" SG_ 314 FrntSideRdrLeDetn31RdrDetnSts 3;
BA_ "GenSigSendType" SG_ 314 FrntSideRdrLeDetn32RdrDetnAzi 0;
BA_ "GenSigStartValue" SG_ 314 FrntSideRdrLeDetn32RdrDetnAzi 900;
BA_ "GenSigDataID" SG_ 314 FrntSideRdrLeDetn32RdrDetnChks "0x853";
BA_ "GenSigFuncType" SG_ 314 FrntSideRdrLeDetn32RdrDetnChks 15;
BA_ "GenSigSendType" SG_ 314 FrntSideRdrLeDetn32RdrDetnChks 0;
BA_ "GenSigFuncType" SG_ 314 FrntSideRdrLeDetn32RdrDetnCntr 16;
BA_ "GenSigSendType" SG_ 314 FrntSideRdrLeDetn32RdrDetnCntr 0;
BA_ "GenSigSendType" SG_ 314 FrntSideRdrLeDetn32RdrDetnConf 0;
BA_ "GenSigSendType" SG_ 314 FrntSideRdrLeDetn32RdrDetnElevn 0;
BA_ "GenSigStartValue" SG_ 314 FrntSideRdrLeDetn32RdrDetnElevn 15;
BA_ "GenSigSendType" SG_ 314 FrntSideRdrLeDetn32RdrDetnPwr 0;
BA_ "GenSigSendType" SG_ 314 FrntSideRdrLeDetn32RdrDetnRng 0;
BA_ "GenSigStartValue" SG_ 314 FrntSideRdrLeDetn32RdrDetnRng 10050;
BA_ "GenSigSendType" SG_ 314 FrntSideRdrLeDetn32RdrDetnRngV 0;
BA_ "GenSigStartValue" SG_ 314 FrntSideRdrLeDetn32RdrDetnRngV 4000;
BA_ "GenSigSendType" SG_ 314 FrntSideRdrLeDetn32RdrDetnSts 0;
BA_ "GenSigStartValue" SG_ 314 FrntSideRdrLeDetn32RdrDetnSts 3;
BA_ "GenSigSendType" SG_ 314 FrntSideRdrLeDetn33RdrDetnAzi 0;
BA_ "GenSigStartValue" SG_ 314 FrntSideRdrLeDetn33RdrDetnAzi 900;
BA_ "GenSigDataID" SG_ 314 FrntSideRdrLeDetn33RdrDetnChks "0x854";
BA_ "GenSigFuncType" SG_ 314 FrntSideRdrLeDetn33RdrDetnChks 15;
BA_ "GenSigSendType" SG_ 314 FrntSideRdrLeDetn33RdrDetnChks 0;
BA_ "GenSigFuncType" SG_ 314 FrntSideRdrLeDetn33RdrDetnCntr 16;
BA_ "GenSigSendType" SG_ 314 FrntSideRdrLeDetn33RdrDetnCntr 0;
BA_ "GenSigSendType" SG_ 314 FrntSideRdrLeDetn33RdrDetnConf 0;
BA_ "GenSigSendType" SG_ 314 FrntSideRdrLeDetn33RdrDetnElevn 0;
BA_ "GenSigStartValue" SG_ 314 FrntSideRdrLeDetn33RdrDetnElevn 15;
BA_ "GenSigSendType" SG_ 314 FrntSideRdrLeDetn33RdrDetnPwr 0;
BA_ "GenSigSendType" SG_ 314 FrntSideRdrLeDetn33RdrDetnRng 0;
BA_ "GenSigStartValue" SG_ 314 FrntSideRdrLeDetn33RdrDetnRng 10050;
BA_ "GenSigSendType" SG_ 314 FrntSideRdrLeDetn33RdrDetnRngV 0;
BA_ "GenSigStartValue" SG_ 314 FrntSideRdrLeDetn33RdrDetnRngV 4000;
BA_ "GenSigSendType" SG_ 314 FrntSideRdrLeDetn33RdrDetnSts 0;
BA_ "GenSigStartValue" SG_ 314 FrntSideRdrLeDetn33RdrDetnSts 3;
BA_ "GenSigSendType" SG_ 314 FrntSideRdrLeDetn34RdrDetnAzi 0;
BA_ "GenSigStartValue" SG_ 314 FrntSideRdrLeDetn34RdrDetnAzi 900;
BA_ "GenSigDataID" SG_ 314 FrntSideRdrLeDetn34RdrDetnChks "0x855";
BA_ "GenSigFuncType" SG_ 314 FrntSideRdrLeDetn34RdrDetnChks 15;
BA_ "GenSigSendType" SG_ 314 FrntSideRdrLeDetn34RdrDetnChks 0;
BA_ "GenSigFuncType" SG_ 314 FrntSideRdrLeDetn34RdrDetnCntr 16;
BA_ "GenSigSendType" SG_ 314 FrntSideRdrLeDetn34RdrDetnCntr 0;
BA_ "GenSigSendType" SG_ 314 FrntSideRdrLeDetn34RdrDetnConf 0;
BA_ "GenSigSendType" SG_ 314 FrntSideRdrLeDetn34RdrDetnElevn 0;
BA_ "GenSigStartValue" SG_ 314 FrntSideRdrLeDetn34RdrDetnElevn 15;
BA_ "GenSigSendType" SG_ 314 FrntSideRdrLeDetn34RdrDetnPwr 0;
BA_ "GenSigSendType" SG_ 314 FrntSideRdrLeDetn34RdrDetnRng 0;
BA_ "GenSigStartValue" SG_ 314 FrntSideRdrLeDetn34RdrDetnRng 10050;
BA_ "GenSigSendType" SG_ 314 FrntSideRdrLeDetn34RdrDetnRngV 0;
BA_ "GenSigStartValue" SG_ 314 FrntSideRdrLeDetn34RdrDetnRngV 4000;
BA_ "GenSigSendType" SG_ 314 FrntSideRdrLeDetn34RdrDetnSts 0;
BA_ "GenSigStartValue" SG_ 314 FrntSideRdrLeDetn34RdrDetnSts 3;
BA_ "GenSigSendType" SG_ 314 FrntSideRdrLeDetn35RdrDetnAzi 0;
BA_ "GenSigStartValue" SG_ 314 FrntSideRdrLeDetn35RdrDetnAzi 900;
BA_ "GenSigDataID" SG_ 314 FrntSideRdrLeDetn35RdrDetnChks "0x856";
BA_ "GenSigFuncType" SG_ 314 FrntSideRdrLeDetn35RdrDetnChks 15;
BA_ "GenSigSendType" SG_ 314 FrntSideRdrLeDetn35RdrDetnChks 0;
BA_ "GenSigFuncType" SG_ 314 FrntSideRdrLeDetn35RdrDetnCntr 16;
BA_ "GenSigSendType" SG_ 314 FrntSideRdrLeDetn35RdrDetnCntr 0;
BA_ "GenSigSendType" SG_ 314 FrntSideRdrLeDetn35RdrDetnConf 0;
BA_ "GenSigSendType" SG_ 314 FrntSideRdrLeDetn35RdrDetnElevn 0;
BA_ "GenSigStartValue" SG_ 314 FrntSideRdrLeDetn35RdrDetnElevn 15;
BA_ "GenSigSendType" SG_ 314 FrntSideRdrLeDetn35RdrDetnPwr 0;
BA_ "GenSigSendType" SG_ 314 FrntSideRdrLeDetn35RdrDetnRng 0;
BA_ "GenSigStartValue" SG_ 314 FrntSideRdrLeDetn35RdrDetnRng 10050;
BA_ "GenSigSendType" SG_ 314 FrntSideRdrLeDetn35RdrDetnRngV 0;
BA_ "GenSigStartValue" SG_ 314 FrntSideRdrLeDetn35RdrDetnRngV 4000;
BA_ "GenSigSendType" SG_ 314 FrntSideRdrLeDetn35RdrDetnSts 0;
BA_ "GenSigStartValue" SG_ 314 FrntSideRdrLeDetn35RdrDetnSts 3;
BA_ "GenSigSendType" SG_ 314 FrntSideRdrLeDetn36RdrDetnAzi 0;
BA_ "GenSigStartValue" SG_ 314 FrntSideRdrLeDetn36RdrDetnAzi 900;
BA_ "GenSigDataID" SG_ 314 FrntSideRdrLeDetn36RdrDetnChks "0x857";
BA_ "GenSigFuncType" SG_ 314 FrntSideRdrLeDetn36RdrDetnChks 15;
BA_ "GenSigSendType" SG_ 314 FrntSideRdrLeDetn36RdrDetnChks 0;
BA_ "GenSigFuncType" SG_ 314 FrntSideRdrLeDetn36RdrDetnCntr 16;
BA_ "GenSigSendType" SG_ 314 FrntSideRdrLeDetn36RdrDetnCntr 0;
BA_ "GenSigSendType" SG_ 314 FrntSideRdrLeDetn36RdrDetnConf 0;
BA_ "GenSigSendType" SG_ 314 FrntSideRdrLeDetn36RdrDetnElevn 0;
BA_ "GenSigStartValue" SG_ 314 FrntSideRdrLeDetn36RdrDetnElevn 15;
BA_ "GenSigSendType" SG_ 314 FrntSideRdrLeDetn36RdrDetnPwr 0;
BA_ "GenSigSendType" SG_ 314 FrntSideRdrLeDetn36RdrDetnRng 0;
BA_ "GenSigStartValue" SG_ 314 FrntSideRdrLeDetn36RdrDetnRng 10050;
BA_ "GenSigSendType" SG_ 314 FrntSideRdrLeDetn36RdrDetnRngV 0;
BA_ "GenSigStartValue" SG_ 314 FrntSideRdrLeDetn36RdrDetnRngV 4000;
BA_ "GenSigSendType" SG_ 314 FrntSideRdrLeDetn36RdrDetnSts 0;
BA_ "GenSigStartValue" SG_ 314 FrntSideRdrLeDetn36RdrDetnSts 3;
BA_ "GenSigSendType" SG_ 304 FrntSideRdrLeDetn3RdrDetnAzi 0;
BA_ "GenSigStartValue" SG_ 304 FrntSideRdrLeDetn3RdrDetnAzi 900;
BA_ "GenSigDataID" SG_ 304 FrntSideRdrLeDetn3RdrDetnChks "0x836";
BA_ "GenSigFuncType" SG_ 304 FrntSideRdrLeDetn3RdrDetnChks 15;
BA_ "GenSigSendType" SG_ 304 FrntSideRdrLeDetn3RdrDetnChks 0;
BA_ "GenSigFuncType" SG_ 304 FrntSideRdrLeDetn3RdrDetnCntr 16;
BA_ "GenSigSendType" SG_ 304 FrntSideRdrLeDetn3RdrDetnCntr 0;
BA_ "GenSigSendType" SG_ 304 FrntSideRdrLeDetn3RdrDetnConf 0;
BA_ "GenSigSendType" SG_ 304 FrntSideRdrLeDetn3RdrDetnElevn 0;
BA_ "GenSigStartValue" SG_ 304 FrntSideRdrLeDetn3RdrDetnElevn 15;
BA_ "GenSigSendType" SG_ 304 FrntSideRdrLeDetn3RdrDetnPwr 0;
BA_ "GenSigSendType" SG_ 304 FrntSideRdrLeDetn3RdrDetnRng 0;
BA_ "GenSigStartValue" SG_ 304 FrntSideRdrLeDetn3RdrDetnRng 10050;
BA_ "GenSigSendType" SG_ 304 FrntSideRdrLeDetn3RdrDetnRngV 0;
BA_ "GenSigStartValue" SG_ 304 FrntSideRdrLeDetn3RdrDetnRngV 4000;
BA_ "GenSigSendType" SG_ 304 FrntSideRdrLeDetn3RdrDetnSts 0;
BA_ "GenSigStartValue" SG_ 304 FrntSideRdrLeDetn3RdrDetnSts 3;
BA_ "GenSigSendType" SG_ 304 FrntSideRdrLeDetn4RdrDetnAzi 0;
BA_ "GenSigStartValue" SG_ 304 FrntSideRdrLeDetn4RdrDetnAzi 900;
BA_ "GenSigDataID" SG_ 304 FrntSideRdrLeDetn4RdrDetnChks "0x837";
BA_ "GenSigFuncType" SG_ 304 FrntSideRdrLeDetn4RdrDetnChks 15;
BA_ "GenSigSendType" SG_ 304 FrntSideRdrLeDetn4RdrDetnChks 0;
BA_ "GenSigFuncType" SG_ 304 FrntSideRdrLeDetn4RdrDetnCntr 16;
BA_ "GenSigSendType" SG_ 304 FrntSideRdrLeDetn4RdrDetnCntr 0;
BA_ "GenSigSendType" SG_ 304 FrntSideRdrLeDetn4RdrDetnConf 0;
BA_ "GenSigSendType" SG_ 304 FrntSideRdrLeDetn4RdrDetnElevn 0;
BA_ "GenSigStartValue" SG_ 304 FrntSideRdrLeDetn4RdrDetnElevn 15;
BA_ "GenSigSendType" SG_ 304 FrntSideRdrLeDetn4RdrDetnPwr 0;
BA_ "GenSigSendType" SG_ 304 FrntSideRdrLeDetn4RdrDetnRng 0;
BA_ "GenSigStartValue" SG_ 304 FrntSideRdrLeDetn4RdrDetnRng 10050;
BA_ "GenSigSendType" SG_ 304 FrntSideRdrLeDetn4RdrDetnRngV 0;
BA_ "GenSigStartValue" SG_ 304 FrntSideRdrLeDetn4RdrDetnRngV 4000;
BA_ "GenSigSendType" SG_ 304 FrntSideRdrLeDetn4RdrDetnSts 0;
BA_ "GenSigStartValue" SG_ 304 FrntSideRdrLeDetn4RdrDetnSts 3;
BA_ "GenSigSendType" SG_ 304 FrntSideRdrLeDetn5RdrDetnAzi 0;
BA_ "GenSigStartValue" SG_ 304 FrntSideRdrLeDetn5RdrDetnAzi 900;
BA_ "GenSigDataID" SG_ 304 FrntSideRdrLeDetn5RdrDetnChks "0x838";
BA_ "GenSigFuncType" SG_ 304 FrntSideRdrLeDetn5RdrDetnChks 15;
BA_ "GenSigSendType" SG_ 304 FrntSideRdrLeDetn5RdrDetnChks 0;
BA_ "GenSigFuncType" SG_ 304 FrntSideRdrLeDetn5RdrDetnCntr 16;
BA_ "GenSigSendType" SG_ 304 FrntSideRdrLeDetn5RdrDetnCntr 0;
BA_ "GenSigSendType" SG_ 304 FrntSideRdrLeDetn5RdrDetnConf 0;
BA_ "GenSigSendType" SG_ 304 FrntSideRdrLeDetn5RdrDetnElevn 0;
BA_ "GenSigStartValue" SG_ 304 FrntSideRdrLeDetn5RdrDetnElevn 15;
BA_ "GenSigSendType" SG_ 304 FrntSideRdrLeDetn5RdrDetnPwr 0;
BA_ "GenSigSendType" SG_ 304 FrntSideRdrLeDetn5RdrDetnRng 0;
BA_ "GenSigStartValue" SG_ 304 FrntSideRdrLeDetn5RdrDetnRng 10050;
BA_ "GenSigSendType" SG_ 304 FrntSideRdrLeDetn5RdrDetnRngV 0;
BA_ "GenSigStartValue" SG_ 304 FrntSideRdrLeDetn5RdrDetnRngV 4000;
BA_ "GenSigSendType" SG_ 304 FrntSideRdrLeDetn5RdrDetnSts 0;
BA_ "GenSigStartValue" SG_ 304 FrntSideRdrLeDetn5RdrDetnSts 3;
BA_ "GenSigSendType" SG_ 304 FrntSideRdrLeDetn6RdrDetnAzi 0;
BA_ "GenSigStartValue" SG_ 304 FrntSideRdrLeDetn6RdrDetnAzi 900;
BA_ "GenSigDataID" SG_ 304 FrntSideRdrLeDetn6RdrDetnChks "0x839";
BA_ "GenSigFuncType" SG_ 304 FrntSideRdrLeDetn6RdrDetnChks 15;
BA_ "GenSigSendType" SG_ 304 FrntSideRdrLeDetn6RdrDetnChks 0;
BA_ "GenSigFuncType" SG_ 304 FrntSideRdrLeDetn6RdrDetnCntr 16;
BA_ "GenSigSendType" SG_ 304 FrntSideRdrLeDetn6RdrDetnCntr 0;
BA_ "GenSigSendType" SG_ 304 FrntSideRdrLeDetn6RdrDetnConf 0;
BA_ "GenSigSendType" SG_ 304 FrntSideRdrLeDetn6RdrDetnElevn 0;
BA_ "GenSigStartValue" SG_ 304 FrntSideRdrLeDetn6RdrDetnElevn 15;
BA_ "GenSigSendType" SG_ 304 FrntSideRdrLeDetn6RdrDetnPwr 0;
BA_ "GenSigSendType" SG_ 304 FrntSideRdrLeDetn6RdrDetnRng 0;
BA_ "GenSigStartValue" SG_ 304 FrntSideRdrLeDetn6RdrDetnRng 10050;
BA_ "GenSigSendType" SG_ 304 FrntSideRdrLeDetn6RdrDetnRngV 0;
BA_ "GenSigStartValue" SG_ 304 FrntSideRdrLeDetn6RdrDetnRngV 4000;
BA_ "GenSigSendType" SG_ 304 FrntSideRdrLeDetn6RdrDetnSts 0;
BA_ "GenSigStartValue" SG_ 304 FrntSideRdrLeDetn6RdrDetnSts 3;
BA_ "GenSigSendType" SG_ 306 FrntSideRdrLeDetn7RdrDetnAzi 0;
BA_ "GenSigStartValue" SG_ 306 FrntSideRdrLeDetn7RdrDetnAzi 900;
BA_ "GenSigDataID" SG_ 306 FrntSideRdrLeDetn7RdrDetnChks "0x83A";
BA_ "GenSigFuncType" SG_ 306 FrntSideRdrLeDetn7RdrDetnChks 15;
BA_ "GenSigSendType" SG_ 306 FrntSideRdrLeDetn7RdrDetnChks 0;
BA_ "GenSigFuncType" SG_ 306 FrntSideRdrLeDetn7RdrDetnCntr 16;
BA_ "GenSigSendType" SG_ 306 FrntSideRdrLeDetn7RdrDetnCntr 0;
BA_ "GenSigSendType" SG_ 306 FrntSideRdrLeDetn7RdrDetnConf 0;
BA_ "GenSigSendType" SG_ 306 FrntSideRdrLeDetn7RdrDetnElevn 0;
BA_ "GenSigStartValue" SG_ 306 FrntSideRdrLeDetn7RdrDetnElevn 15;
BA_ "GenSigSendType" SG_ 306 FrntSideRdrLeDetn7RdrDetnPwr 0;
BA_ "GenSigSendType" SG_ 306 FrntSideRdrLeDetn7RdrDetnRng 0;
BA_ "GenSigStartValue" SG_ 306 FrntSideRdrLeDetn7RdrDetnRng 10050;
BA_ "GenSigSendType" SG_ 306 FrntSideRdrLeDetn7RdrDetnRngV 0;
BA_ "GenSigStartValue" SG_ 306 FrntSideRdrLeDetn7RdrDetnRngV 4000;
BA_ "GenSigSendType" SG_ 306 FrntSideRdrLeDetn7RdrDetnSts 0;
BA_ "GenSigStartValue" SG_ 306 FrntSideRdrLeDetn7RdrDetnSts 3;
BA_ "GenSigSendType" SG_ 306 FrntSideRdrLeDetn8RdrDetnAzi 0;
BA_ "GenSigStartValue" SG_ 306 FrntSideRdrLeDetn8RdrDetnAzi 900;
BA_ "GenSigDataID" SG_ 306 FrntSideRdrLeDetn8RdrDetnChks "0x83B";
BA_ "GenSigFuncType" SG_ 306 FrntSideRdrLeDetn8RdrDetnChks 15;
BA_ "GenSigSendType" SG_ 306 FrntSideRdrLeDetn8RdrDetnChks 0;
BA_ "GenSigFuncType" SG_ 306 FrntSideRdrLeDetn8RdrDetnCntr 16;
BA_ "GenSigSendType" SG_ 306 FrntSideRdrLeDetn8RdrDetnCntr 0;
BA_ "GenSigSendType" SG_ 306 FrntSideRdrLeDetn8RdrDetnConf 0;
BA_ "GenSigSendType" SG_ 306 FrntSideRdrLeDetn8RdrDetnElevn 0;
BA_ "GenSigStartValue" SG_ 306 FrntSideRdrLeDetn8RdrDetnElevn 15;
BA_ "GenSigSendType" SG_ 306 FrntSideRdrLeDetn8RdrDetnPwr 0;
BA_ "GenSigSendType" SG_ 306 FrntSideRdrLeDetn8RdrDetnRng 0;
BA_ "GenSigStartValue" SG_ 306 FrntSideRdrLeDetn8RdrDetnRng 10050;
BA_ "GenSigSendType" SG_ 306 FrntSideRdrLeDetn8RdrDetnRngV 0;
BA_ "GenSigStartValue" SG_ 306 FrntSideRdrLeDetn8RdrDetnRngV 4000;
BA_ "GenSigSendType" SG_ 306 FrntSideRdrLeDetn8RdrDetnSts 0;
BA_ "GenSigStartValue" SG_ 306 FrntSideRdrLeDetn8RdrDetnSts 3;
BA_ "GenSigSendType" SG_ 306 FrntSideRdrLeDetn9RdrDetnAzi 0;
BA_ "GenSigStartValue" SG_ 306 FrntSideRdrLeDetn9RdrDetnAzi 900;
BA_ "GenSigDataID" SG_ 306 FrntSideRdrLeDetn9RdrDetnChks "0x83C";
BA_ "GenSigFuncType" SG_ 306 FrntSideRdrLeDetn9RdrDetnChks 15;
BA_ "GenSigSendType" SG_ 306 FrntSideRdrLeDetn9RdrDetnChks 0;
BA_ "GenSigFuncType" SG_ 306 FrntSideRdrLeDetn9RdrDetnCntr 16;
BA_ "GenSigSendType" SG_ 306 FrntSideRdrLeDetn9RdrDetnCntr 0;
BA_ "GenSigSendType" SG_ 306 FrntSideRdrLeDetn9RdrDetnConf 0;
BA_ "GenSigSendType" SG_ 306 FrntSideRdrLeDetn9RdrDetnElevn 0;
BA_ "GenSigStartValue" SG_ 306 FrntSideRdrLeDetn9RdrDetnElevn 15;
BA_ "GenSigSendType" SG_ 306 FrntSideRdrLeDetn9RdrDetnPwr 0;
BA_ "GenSigSendType" SG_ 306 FrntSideRdrLeDetn9RdrDetnRng 0;
BA_ "GenSigStartValue" SG_ 306 FrntSideRdrLeDetn9RdrDetnRng 10050;
BA_ "GenSigSendType" SG_ 306 FrntSideRdrLeDetn9RdrDetnRngV 0;
BA_ "GenSigStartValue" SG_ 306 FrntSideRdrLeDetn9RdrDetnRngV 4000;
BA_ "GenSigSendType" SG_ 306 FrntSideRdrLeDetn9RdrDetnSts 0;
BA_ "GenSigStartValue" SG_ 306 FrntSideRdrLeDetn9RdrDetnSts 3;
BA_ "GenSigSendType" SG_ 297 FrntSideRdrLeStsForDim 0;
BA_ "GenSigStartValue" SG_ 297 FrntSideRdrLeStsForDim 1;
BA_ "GenSigSendType" SG_ 297 FrntSideRdrLeStsRdrNrDetn 0;
BA_ "GenSigSendType" SG_ 297 FrntSideRdrLeStsRdrNrObj 0;
BA_ "GenSigSendType" SG_ 297 FrntSideRdrLeStsRdrStsBlkd0bin 0;
BA_ "GenSigSendType" SG_ 297 FrntSideRdrLeStsRdrStsBlkdConf 0;
BA_ "GenSigDataID" SG_ 297 FrntSideRdrLeStsRdrStsChks "0x8E1";
BA_ "GenSigFuncType" SG_ 297 FrntSideRdrLeStsRdrStsChks 15;
BA_ "GenSigSendType" SG_ 297 FrntSideRdrLeStsRdrStsChks 0;
BA_ "GenSigFuncType" SG_ 297 FrntSideRdrLeStsRdrStsCntr 16;
BA_ "GenSigSendType" SG_ 297 FrntSideRdrLeStsRdrStsCntr 0;
BA_ "GenSigSendType" SG_ 297 FrntSideRdrLeStsRdrStsDstbc 0;
BA_ "GenSigSendType" SG_ 297 FrntSideRdrLeStsRdrStsEna 0;
BA_ "GenSigSendType" SG_ 297 FrntSideRdrLeStsRdrStsFaulty 0;
BA_ "GenSigSendType" SG_ 297 FrntSideRdrLeStsRdrStsIfVersMajor 0;
BA_ "GenSigSendType" SG_ 297 FrntSideRdrLeStsRdrStsIfVersMinor 0;
BA_ "GenSigSendType" SG_ 297 FrntSideRdrLeStsRdrStsLatency 0;
BA_ "GenSigStartValue" SG_ 297 FrntSideRdrLeStsRdrStsLatency 65535;
BA_ "GenSigSendType" SG_ 297 FrntSideRdrLeStsRdrStsMisAlign 0;
BA_ "GenSigSendType" SG_ 297 FrntSideRdrLeStsRdrStsMissCom 0;
BA_ "GenSigSendType" SG_ 297 FrntSideRdrLeStsRdrStsSftyFlt 0;
BA_ "GenSigStartValue" SG_ 297 FrntSideRdrLeStsRdrStsSftyFlt 1;
BA_ "GenSigSendType" SG_ 297 FrntSideRdrLeStsRdrStsTiStamp 0;
BA_ "GenSigSendType" SG_ 297 FrntSideRdrLeStsRdrStsTiStampStsGlbTiBas 0;
BA_ "GenSigSendType" SG_ 297 FrntSideRdrLeStsRdrStsTiStampStsSyncToGatewy 0;
BA_ "GenSigSendType" SG_ 297 FrntSideRdrLeStsRdrStsTiStampStsTiLeap 0;
BA_ "GenSigSendType" SG_ 297 FrntSideRdrLeStsRdrStsTiStampStsTiOut 0;
BA_ "GenSigSendType" SG_ 297 FrntSideRdrLeStsRdrStsWhlSpdCmpFac 0;
BA_ "GenSigStartValue" SG_ 297 FrntSideRdrLeStsRdrStsWhlSpdCmpFac 16;
BA_ "GenSigDataID" SG_ 1007 FrntSideRdrLeVehPrmRdrVehPrmChks "0x80F";
BA_ "GenSigFuncType" SG_ 1007 FrntSideRdrLeVehPrmRdrVehPrmChks 15;
BA_ "GenSigSendType" SG_ 1007 FrntSideRdrLeVehPrmRdrVehPrmChks 0;
BA_ "GenSigFuncType" SG_ 1007 FrntSideRdrLeVehPrmRdrVehPrmCntr 16;
BA_ "GenSigSendType" SG_ 1007 FrntSideRdrLeVehPrmRdrVehPrmCntr 0;
BA_ "GenSigSendType" SG_ 1007 FrntSideRdrLeVehPrmRdrVehPrmRdrDynCalPrmForAgOffs 0;
BA_ "GenSigStartValue" SG_ 1007 FrntSideRdrLeVehPrmRdrVehPrmRdrDynCalPrmForAgOffs 128;
BA_ "GenSigSendType" SG_ 1007 FrntSideRdrLeVehPrmRdrVehPrmRdrDynCalPrmForAxleDstReToVehFrnt 0;
BA_ "GenSigStartValue" SG_ 1007 FrntSideRdrLeVehPrmRdrVehPrmRdrDynCalPrmForAxleDstReToVehFrnt 250;
BA_ "GenSigSendType" SG_ 1007 FrntSideRdrLeVehPrmRdrVehPrmRdrDynCalPrmForPinoinAgRat 0;
BA_ "GenSigStartValue" SG_ 1007 FrntSideRdrLeVehPrmRdrVehPrmRdrDynCalPrmForPinoinAgRat 140;
BA_ "GenSigSendType" SG_ 1007 FrntSideRdrLeVehPrmRdrVehPrmRdrDynCalPrmForRollAgGain 0;
BA_ "GenSigStartValue" SG_ 1007 FrntSideRdrLeVehPrmRdrVehPrmRdrDynCalPrmForRollAgGain 50;
BA_ "GenSigSendType" SG_ 1007 FrntSideRdrLeVehPrmRdrVehPrmRdrDynCalPrmForSnsrDir 0;
BA_ "GenSigSendType" SG_ 1007 FrntSideRdrLeVehPrmRdrVehPrmRdrDynCalPrmForSnsrOrntn 0;
BA_ "GenSigSendType" SG_ 1007 FrntSideRdrLeVehPrmRdrVehPrmRdrDynCalPrmForSnsrPosnLat 0;
BA_ "GenSigStartValue" SG_ 1007 FrntSideRdrLeVehPrmRdrVehPrmRdrDynCalPrmForSnsrPosnLat 2000;
BA_ "GenSigSendType" SG_ 1007 FrntSideRdrLeVehPrmRdrVehPrmRdrDynCalPrmForSnsrPosnLgt 0;
BA_ "GenSigStartValue" SG_ 1007 FrntSideRdrLeVehPrmRdrVehPrmRdrDynCalPrmForSnsrPosnLgt 5000;
BA_ "GenSigSendType" SG_ 1007 FrntSideRdrLeVehPrmRdrVehPrmRdrDynCalPrmForSnsrPosnVert 0;
BA_ "GenSigSendType" SG_ 1007 FrntSideRdrLeVehPrmRdrVehPrmRdrDynCalPrmForSnsrRot1 0;
BA_ "GenSigStartValue" SG_ 1007 FrntSideRdrLeVehPrmRdrVehPrmRdrDynCalPrmForSnsrRot1 900;
BA_ "GenSigSendType" SG_ 1007 FrntSideRdrLeVehPrmRdrVehPrmRdrDynCalPrmForVehLen 0;
BA_ "GenSigStartValue" SG_ 1007 FrntSideRdrLeVehPrmRdrVehPrmRdrDynCalPrmForVehLen 500;
BA_ "GenSigSendType" SG_ 1007 FrntSideRdrLeVehPrmRdrVehPrmRdrDynCalPrmForVehTyp 0;
BA_ "GenSigSendType" SG_ 1007 FrntSideRdrLeVehPrmRdrVehPrmRdrDynCalPrmForVehWidth 0;
BA_ "GenSigStartValue" SG_ 1007 FrntSideRdrLeVehPrmRdrVehPrmRdrDynCalPrmForVehWidth 200;
BA_ "GenSigSendType" SG_ 1007 FrntSideRdrLeVehPrmRdrVehPrmRdrDynCalPrmForVersMajor 0;
BA_ "GenSigSendType" SG_ 1007 FrntSideRdrLeVehPrmRdrVehPrmRdrDynCalPrmForVersMinor 0;
BA_ "GenSigSendType" SG_ 1007 FrntSideRdrLeVehPrmRdrVehPrmRdrDynCalPrmForWhlBas 0;
BA_ "GenSigSendType" SG_ 1007 FrntSideRdrLeVehPrmRdrVehPrmVld 0;
BA_ "GenSigDataID" SG_ 1007 FrntSideRdrRiVehPrmRdrVehPrmChks "0x810";
BA_ "GenSigFuncType" SG_ 1007 FrntSideRdrRiVehPrmRdrVehPrmChks 15;
BA_ "GenSigSendType" SG_ 1007 FrntSideRdrRiVehPrmRdrVehPrmChks 0;
BA_ "GenSigFuncType" SG_ 1007 FrntSideRdrRiVehPrmRdrVehPrmCntr 16;
BA_ "GenSigSendType" SG_ 1007 FrntSideRdrRiVehPrmRdrVehPrmCntr 0;
BA_ "GenSigSendType" SG_ 1007 FrntSideRdrRiVehPrmRdrVehPrmRdrDynCalPrmForAgOffs 0;
BA_ "GenSigStartValue" SG_ 1007 FrntSideRdrRiVehPrmRdrVehPrmRdrDynCalPrmForAgOffs 128;
BA_ "GenSigSendType" SG_ 1007 FrntSideRdrRiVehPrmRdrVehPrmRdrDynCalPrmForAxleDstReToVehFrnt 0;
BA_ "GenSigStartValue" SG_ 1007 FrntSideRdrRiVehPrmRdrVehPrmRdrDynCalPrmForAxleDstReToVehFrnt 250;
BA_ "GenSigSendType" SG_ 1007 FrntSideRdrRiVehPrmRdrVehPrmRdrDynCalPrmForPinoinAgRat 0;
BA_ "GenSigStartValue" SG_ 1007 FrntSideRdrRiVehPrmRdrVehPrmRdrDynCalPrmForPinoinAgRat 140;
BA_ "GenSigSendType" SG_ 1007 FrntSideRdrRiVehPrmRdrVehPrmRdrDynCalPrmForRollAgGain 0;
BA_ "GenSigStartValue" SG_ 1007 FrntSideRdrRiVehPrmRdrVehPrmRdrDynCalPrmForRollAgGain 50;
BA_ "GenSigSendType" SG_ 1007 FrntSideRdrRiVehPrmRdrVehPrmRdrDynCalPrmForSnsrDir 0;
BA_ "GenSigSendType" SG_ 1007 FrntSideRdrRiVehPrmRdrVehPrmRdrDynCalPrmForSnsrOrntn 0;
BA_ "GenSigSendType" SG_ 1007 FrntSideRdrRiVehPrmRdrVehPrmRdrDynCalPrmForSnsrPosnLat 0;
BA_ "GenSigStartValue" SG_ 1007 FrntSideRdrRiVehPrmRdrVehPrmRdrDynCalPrmForSnsrPosnLat 2000;
BA_ "GenSigSendType" SG_ 1007 FrntSideRdrRiVehPrmRdrVehPrmRdrDynCalPrmForSnsrPosnLgt 0;
BA_ "GenSigStartValue" SG_ 1007 FrntSideRdrRiVehPrmRdrVehPrmRdrDynCalPrmForSnsrPosnLgt 5000;
BA_ "GenSigSendType" SG_ 1007 FrntSideRdrRiVehPrmRdrVehPrmRdrDynCalPrmForSnsrPosnVert 0;
BA_ "GenSigSendType" SG_ 1007 FrntSideRdrRiVehPrmRdrVehPrmRdrDynCalPrmForSnsrRot1 0;
BA_ "GenSigStartValue" SG_ 1007 FrntSideRdrRiVehPrmRdrVehPrmRdrDynCalPrmForSnsrRot1 900;
BA_ "GenSigSendType" SG_ 1007 FrntSideRdrRiVehPrmRdrVehPrmRdrDynCalPrmForVehLen 0;
BA_ "GenSigStartValue" SG_ 1007 FrntSideRdrRiVehPrmRdrVehPrmRdrDynCalPrmForVehLen 500;
BA_ "GenSigSendType" SG_ 1007 FrntSideRdrRiVehPrmRdrVehPrmRdrDynCalPrmForVehTyp 0;
BA_ "GenSigSendType" SG_ 1007 FrntSideRdrRiVehPrmRdrVehPrmRdrDynCalPrmForVehWidth 0;
BA_ "GenSigStartValue" SG_ 1007 FrntSideRdrRiVehPrmRdrVehPrmRdrDynCalPrmForVehWidth 200;
BA_ "GenSigSendType" SG_ 1007 FrntSideRdrRiVehPrmRdrVehPrmRdrDynCalPrmForVersMajor 0;
BA_ "GenSigSendType" SG_ 1007 FrntSideRdrRiVehPrmRdrVehPrmRdrDynCalPrmForVersMinor 0;
BA_ "GenSigSendType" SG_ 1007 FrntSideRdrRiVehPrmRdrVehPrmRdrDynCalPrmForWhlBas 0;
BA_ "GenSigSendType" SG_ 1007 FrntSideRdrRiVehPrmRdrVehPrmVld 0;
BA_ "GenSigDataID" SG_ 288 PinionSteerAgGroupChks "0x40D";
BA_ "GenSigFuncType" SG_ 288 PinionSteerAgGroupChks 15;
BA_ "GenSigSendType" SG_ 288 PinionSteerAgGroupChks 0;
BA_ "GenSigFuncType" SG_ 288 PinionSteerAgGroupCntr 16;
BA_ "GenSigSendType" SG_ 288 PinionSteerAgGroupCntr 0;
BA_ "GenSigSendType" SG_ 288 PinionSteerAgGroupPinionSteerAg1 0;
BA_ "GenSigSendType" SG_ 288 PinionSteerAgGroupPinionSteerAg1Qf 0;
BA_ "GenSigStartValue" SG_ 288 PinionSteerAgGroupPinionSteerAg1Qf 1;
BA_ "GenSigSendType" SG_ 288 PinionSteerAgGroupPinionSteerAgSpd1 0;
BA_ "GenSigSendType" SG_ 288 PinionSteerAgGroupPinionSteerAgSpd1Qf 0;
BA_ "GenSigStartValue" SG_ 288 PinionSteerAgGroupPinionSteerAgSpd1Qf 1;
BA_ "GenSigSendType" SG_ 288 PinionSteerAgGroupSteerWhlTq 0;
BA_ "GenSigSendType" SG_ 288 PinionSteerAgGroupSteerWhlTqQf 0;
BA_ "GenSigStartValue" SG_ 288 PinionSteerAgGroupSteerWhlTqQf 1;
BA_ "GenSigSendType" SG_ 288 RainfallAmnt 0;
BA_ "GenSigStartValue" SG_ 288 RainfallAmnt 14;
BA_ "GenSigSendType" SG_ 288 SteerWhlSnsrAg 0;
BA_ "GenSigSendType" SG_ 288 SteerWhlSnsrAgSpd 0;
BA_ "GenSigDataID" SG_ 288 SteerWhlSnsrChks "0x33";
BA_ "GenSigFuncType" SG_ 288 SteerWhlSnsrChks 15;
BA_ "GenSigSendType" SG_ 288 SteerWhlSnsrChks 0;
BA_ "GenSigFuncType" SG_ 288 SteerWhlSnsrCntr 16;
BA_ "GenSigSendType" SG_ 288 SteerWhlSnsrCntr 0;
BA_ "GenSigSendType" SG_ 288 SteerWhlSnsrQf 0;
BA_ "GenSigStartValue" SG_ 288 SteerWhlSnsrQf 1;
BA_ "GenSigSendType" SG_ 1007 TiAndDateIndcnDataValid 0;
BA_ "GenSigSendType" SG_ 1007 TiAndDateIndcnDay 0;
BA_ "GenSigStartValue" SG_ 1007 TiAndDateIndcnDay 1;
BA_ "GenSigSendType" SG_ 1007 TiAndDateIndcnHr1 0;
BA_ "GenSigSendType" SG_ 1007 TiAndDateIndcnMins1 0;
BA_ "GenSigSendType" SG_ 1007 TiAndDateIndcnMth1 0;
BA_ "GenSigStartValue" SG_ 1007 TiAndDateIndcnMth1 1;
BA_ "GenSigSendType" SG_ 1007 TiAndDateIndcnSec1 0;
BA_ "GenSigSendType" SG_ 1007 TiAndDateIndcnYr1 0;
BA_ "GenSigSendType" SG_ 288 VehBattUSysU 0;
BA_ "GenSigSendType" SG_ 288 VehBattUSysUQf 0;
BA_ "GenSigStartValue" SG_ 288 VehBattUSysUQf 1;
BA_ "GenSigSendType" SG_ 288 VehModMngtGlbSafe1CarModSts1 0;
BA_ "GenSigSendType" SG_ 288 VehModMngtGlbSafe1CarModSubtypWdCarModSubtyp 0;
BA_ "GenSigDataID" SG_ 288 VehModMngtGlbSafe1Chks "0x74";
BA_ "GenSigFuncType" SG_ 288 VehModMngtGlbSafe1Chks 15;
BA_ "GenSigSendType" SG_ 288 VehModMngtGlbSafe1Chks 0;
BA_ "GenSigFuncType" SG_ 288 VehModMngtGlbSafe1Cntr 16;
BA_ "GenSigSendType" SG_ 288 VehModMngtGlbSafe1Cntr 0;
BA_ "GenSigSendType" SG_ 288 VehModMngtGlbSafe1EgyLvlElecMai 0;
BA_ "GenSigSendType" SG_ 288 VehModMngtGlbSafe1EgyLvlElecSubtyp 0;
BA_ "GenSigSendType" SG_ 288 VehModMngtGlbSafe1FltEgyCnsWdSts 0;
BA_ "GenSigSendType" SG_ 288 VehModMngtGlbSafe1PwrLvlElecMai 0;
BA_ "GenSigSendType" SG_ 288 VehModMngtGlbSafe1PwrLvlElecSubtyp 0;
BA_ "GenSigSendType" SG_ 288 VehModMngtGlbSafe1UsgModSts 0;
BA_ "GenSigStartValue" SG_ 288 VehModMngtGlbSafe1UsgModSts 1;
BA_ "GenSigDataID" SG_ 288 VehMtnStChks "0x36";
BA_ "GenSigFuncType" SG_ 288 VehMtnStChks 15;
BA_ "GenSigSendType" SG_ 288 VehMtnStChks 0;
BA_ "GenSigFuncType" SG_ 288 VehMtnStCntr 16;
BA_ "GenSigSendType" SG_ 288 VehMtnStCntr 0;
BA_ "GenSigSendType" SG_ 288 VehMtnStVehMtnSt 0;
BA_ "GenSigSendType" SG_ 288 VehSpdLgtA 0;
BA_ "GenSigDataID" SG_ 288 VehSpdLgtChks "0x37";
BA_ "GenSigFuncType" SG_ 288 VehSpdLgtChks 15;
BA_ "GenSigSendType" SG_ 288 VehSpdLgtChks 0;
BA_ "GenSigFuncType" SG_ 288 VehSpdLgtCntr 16;
BA_ "GenSigSendType" SG_ 288 VehSpdLgtCntr 0;
BA_ "GenSigSendType" SG_ 288 VehSpdLgtQf 0;
BA_ "GenSigStartValue" SG_ 288 VehSpdLgtQf 1;
BA_ "GenSigSendType" SG_ 288 WipgInfoWipgSpdInfo 0;
BA_ "GenSigSendType" SG_ 288 WipgInfoWiprActv 0;
BA_ "GenSigSendType" SG_ 288 WipgInfoWiprInWipgAr 0;

VAL_ 288 ADataRawSafeALat1Qf 0 "Qf1_DevOfDataUndefd" 1 "Qf1_DataTmpUndefdAndEvlnInProgs" 2 "Qf1_DevOfDataNotWithinRngAllwd" 3 "Qf1_DataCalcdWithDevDefd";
VAL_ 288 ADataRawSafeALgt1Qf 0 "Qf1_DevOfDataUndefd" 1 "Qf1_DataTmpUndefdAndEvlnInProgs" 2 "Qf1_DevOfDataNotWithinRngAllwd" 3 "Qf1_DataCalcdWithDevDefd";
VAL_ 288 ADataRawSafeAVertQf 0 "Qf1_DevOfDataUndefd" 1 "Qf1_DataTmpUndefdAndEvlnInProgs" 2 "Qf1_DevOfDataNotWithinRngAllwd" 3 "Qf1_DataCalcdWithDevDefd";
VAL_ 288 ALgtStdFromWhlSpdQf 0 "GenQf1_UndefindDataAccur" 1 "GenQf1_TmpUndefdData" 2 "GenQf1_DataAccurNotWithinSpcn" 3 "GenQf1_AccurData";
VAL_ 288 AmbTRawQly 0 "GenQf1_UndefindDataAccur" 1 "GenQf1_TmpUndefdData" 2 "GenQf1_DataAccurNotWithinSpcn" 3 "GenQf1_AccurData";
VAL_ 288 AsyDataWithCmpSafeALat1Qf 0 "Qf1_DevOfDataUndefd" 1 "Qf1_DataTmpUndefdAndEvlnInProgs" 2 "Qf1_DevOfDataNotWithinRngAllwd" 3 "Qf1_DataCalcdWithDevDefd";
VAL_ 288 AsyDataWithCmpSafeALgt1Qf 0 "Qf1_DevOfDataUndefd" 1 "Qf1_DataTmpUndefdAndEvlnInProgs" 2 "Qf1_DevOfDataNotWithinRngAllwd" 3 "Qf1_DataCalcdWithDevDefd";
VAL_ 288 AsyDataWithCmpSafeYawRateQf 0 "Qf1_DevOfDataUndefd" 1 "Qf1_DataTmpUndefdAndEvlnInProgs" 2 "Qf1_DevOfDataNotWithinRngAllwd" 3 "Qf1_DataCalcdWithDevDefd";
VAL_ 288 DrvModReq 0 "DrvModReqType1_Undefd" 1 "DrvModReqType1_ECO" 2 "DrvModReqType1_Comfort_Normal" 3 "DrvModReqType1_Dynamic_Sport" 4 "DrvModReqType1_Individual" 5 "DrvModReqType1_Offroad_CrossTerrain" 6 "DrvModReqType1_Adaptive" 7 "DrvModReqType1_Race" 8 "DrvModReqType1_Pure_EV" 9 "DrvModReqType1_Hybrid" 10 "DrvModReqType1_Power" 11 "DrvModReqType1_Snow" 12 "DrvModReqType1_Sand" 13 "DrvModReqType1_Mud" 14 "DrvModReqType1_Rock" 15 "DrvModReqType1_Err";
VAL_ 288 PinionSteerAgGroupPinionSteerAg1Qf 0 "GenQf1_UndefindDataAccur" 1 "GenQf1_TmpUndefdData" 2 "GenQf1_DataAccurNotWithinSpcn" 3 "GenQf1_AccurData";
VAL_ 288 PinionSteerAgGroupPinionSteerAgSpd1Qf 0 "GenQf1_UndefindDataAccur" 1 "GenQf1_TmpUndefdData" 2 "GenQf1_DataAccurNotWithinSpcn" 3 "GenQf1_AccurData";
VAL_ 288 PinionSteerAgGroupSteerWhlTqQf 0 "GenQf1_UndefindDataAccur" 1 "GenQf1_TmpUndefdData" 2 "GenQf1_DataAccurNotWithinSpcn" 3 "GenQf1_AccurData";
VAL_ 288 RainfallAmnt 0 "AmntSnsr_Amnt" 14 "AmntSnsr_InitValue" 15 "AmntSnsr_Error";
VAL_ 288 SteerWhlSnsrQf 0 "GenQf1_UndefindDataAccur" 1 "GenQf1_TmpUndefdData" 2 "GenQf1_DataAccurNotWithinSpcn" 3 "GenQf1_AccurData";
VAL_ 288 VehBattUSysUQf 0 "GenQf1_UndefindDataAccur" 1 "GenQf1_TmpUndefdData" 2 "GenQf1_DataAccurNotWithinSpcn" 3 "GenQf1_AccurData";
VAL_ 288 VehModMngtGlbSafe1CarModSts1 0 "CarModSts1_CarModNorm" 1 "CarModSts1_CarModTrnsp" 2 "CarModSts1_CarModFcy" 3 "CarModSts1_CarModCrash" 5 "CarModSts1_CarModDyno";
VAL_ 288 VehModMngtGlbSafe1FltEgyCnsWdSts 0 "FltEgyCns1_NoFlt" 1 "FltEgyCns1_Flt";
VAL_ 288 VehModMngtGlbSafe1UsgModSts 0 "UsgModSts1_UsgModAbdnd" 1 "UsgModSts1_UsgModInActv" 2 "UsgModSts1_UsgModCnvinc" 11 "UsgModSts1_UsgModActv" 13 "UsgModSts1_UsgModDrvg";
VAL_ 288 VehMtnStVehMtnSt 0 "VehMtnSt2_Ukwn" 1 "VehMtnSt2_StandStillVal1" 2 "VehMtnSt2_StandStillVal2" 3 "VehMtnSt2_StandStillVal3" 4 "VehMtnSt2_RollgFwdVal1" 5 "VehMtnSt2_RollgFwdVal2" 6 "VehMtnSt2_RollgBackwVal1" 7 "VehMtnSt2_RollgBackwVal2";
VAL_ 288 VehSpdLgtQf 0 "GenQf1_UndefindDataAccur" 1 "GenQf1_TmpUndefdData" 2 "GenQf1_DataAccurNotWithinSpcn" 3 "GenQf1_AccurData";
VAL_ 288 WipgInfoWipgSpdInfo 0 "WipgSpdInfo_Off" 1 "WipgSpdInfo_IntlLo" 2 "WipgSpdInfo_IntlHi" 3 "WipgSpdInfo_WipgSpd4045" 4 "WipgSpdInfo_WipgSpd4650" 5 "WipgSpdInfo_WipgSpd5155" 6 "WipgSpdInfo_WipgSpd5660" 7 "WipgSpdInfo_WiprErr";
VAL_ 288 WipgInfoWiprActv 0 "OnOff1_Off" 1 "OnOff1_On";
VAL_ 288 WipgInfoWiprInWipgAr 0 "OnOff1_Off" 1 "OnOff1_On";
VAL_ 1007 FrntSideRdrLeVehPrmRdrVehPrmRdrDynCalPrmForSnsrDir 0 "YesNo2_No" 1 "YesNo2_Yes";
VAL_ 1007 FrntSideRdrLeVehPrmRdrVehPrmRdrDynCalPrmForSnsrOrntn 0 "YesNo2_No" 1 "YesNo2_Yes";
VAL_ 1007 FrntSideRdrLeVehPrmRdrVehPrmVld 0 "YesNo2_No" 1 "YesNo2_Yes";
VAL_ 1007 FrntSideRdrRiVehPrmRdrVehPrmRdrDynCalPrmForSnsrDir 0 "YesNo2_No" 1 "YesNo2_Yes";
VAL_ 1007 FrntSideRdrRiVehPrmRdrVehPrmRdrDynCalPrmForSnsrOrntn 0 "YesNo2_No" 1 "YesNo2_Yes";
VAL_ 1007 FrntSideRdrRiVehPrmRdrVehPrmVld 0 "YesNo2_No" 1 "YesNo2_Yes";
VAL_ 1007 TiAndDateIndcnDataValid 0 "NoYes1_No" 1 "NoYes1_Yes";
VAL_ 297 FrntSideRdrLeStsForDim 0 "RsdsMstSt_Cfg" 1 "RsdsMstSt_StrtUp" 2 "RsdsMstSt_Runng" 3 "RsdsMstSt_Blkd" 4 "RsdsMstSt_Faulty" 5 "RsdsMstSt_Shutdown" 6 "RsdsMstSt_Hot" 7 "RsdsMstSt_Cal";
VAL_ 297 FrntSideRdrLeStsRdrStsBlkd0bin 0 "YesNo2_No" 1 "YesNo2_Yes";
VAL_ 297 FrntSideRdrLeStsRdrStsEna 0 "YesNo2_No" 1 "YesNo2_Yes";
VAL_ 297 FrntSideRdrLeStsRdrStsFaulty 0 "YesNo2_No" 1 "YesNo2_Yes";
VAL_ 297 FrntSideRdrLeStsRdrStsMisAlign 0 "MisAlign_CalibrationNotStart" 1 "MisAlign_SuccessfullyCalibratedInFactoryOrAftersales" 2 "MisAlign_SuccessfullyAutoCalibrated" 3 "MisAlign_MisalignmentDegreeIsLargerThanThreshold_StaticCalibrationFail" 4 "MisAlign_CanNotBeCalibratedStaticallyCauseOtherReason" 5 "MisAlign_AutoCalibrateFail_CauseMisalignmentDegreeIsLargerThanThresholdOrOtherReason" 6 "MisAlign_MisalignmentDegreeIsLargerThanThreshold_DynamicCalibrationFailInFactoryOrAftersales" 7 "MisAlign_CanNotBeCalibratedDynamicallyCauseOtherReason";
VAL_ 297 FrntSideRdrLeStsRdrStsMissCom 0 "YesNo2_No" 1 "YesNo2_Yes";
VAL_ 297 FrntSideRdrLeStsRdrStsSftyFlt 0 "SftyFlt_Undefined" 1 "SftyFlt_NoSafetyFault" 2 "SftyFlt_SafetyFault" 3 "SftyFlt_Reserved";
VAL_ 297 FrntSideRdrLeStsRdrStsTiStampStsGlbTiBas 0 "YesNo2_No" 1 "YesNo2_Yes";
VAL_ 297 FrntSideRdrLeStsRdrStsTiStampStsSyncToGatewy 0 "YesNo2_No" 1 "YesNo2_Yes";
VAL_ 297 FrntSideRdrLeStsRdrStsTiStampStsTiLeap 0 "YesNo2_No" 1 "YesNo2_Yes";
VAL_ 297 FrntSideRdrLeStsRdrStsTiStampStsTiOut 0 "YesNo2_No" 1 "YesNo2_Yes";
VAL_ 304 FrntSideRdrLeDetn1RdrDetnSts 0 "RdrDetnSts_Ukwn" 1 "RdrDetnSts_Movg" 2 "RdrDetnSts_Staty" 3 "RdrDetnSts_Invalid";
VAL_ 304 FrntSideRdrLeDetn2RdrDetnSts 0 "RdrDetnSts_Ukwn" 1 "RdrDetnSts_Movg" 2 "RdrDetnSts_Staty" 3 "RdrDetnSts_Invalid";
VAL_ 304 FrntSideRdrLeDetn3RdrDetnSts 0 "RdrDetnSts_Ukwn" 1 "RdrDetnSts_Movg" 2 "RdrDetnSts_Staty" 3 "RdrDetnSts_Invalid";
VAL_ 304 FrntSideRdrLeDetn4RdrDetnSts 0 "RdrDetnSts_Ukwn" 1 "RdrDetnSts_Movg" 2 "RdrDetnSts_Staty" 3 "RdrDetnSts_Invalid";
VAL_ 304 FrntSideRdrLeDetn5RdrDetnSts 0 "RdrDetnSts_Ukwn" 1 "RdrDetnSts_Movg" 2 "RdrDetnSts_Staty" 3 "RdrDetnSts_Invalid";
VAL_ 304 FrntSideRdrLeDetn6RdrDetnSts 0 "RdrDetnSts_Ukwn" 1 "RdrDetnSts_Movg" 2 "RdrDetnSts_Staty" 3 "RdrDetnSts_Invalid";
VAL_ 306 FrntSideRdrLeDetn10RdrDetnSts 0 "RdrDetnSts_Ukwn" 1 "RdrDetnSts_Movg" 2 "RdrDetnSts_Staty" 3 "RdrDetnSts_Invalid";
VAL_ 306 FrntSideRdrLeDetn11RdrDetnSts 0 "RdrDetnSts_Ukwn" 1 "RdrDetnSts_Movg" 2 "RdrDetnSts_Staty" 3 "RdrDetnSts_Invalid";
VAL_ 306 FrntSideRdrLeDetn12RdrDetnSts 0 "RdrDetnSts_Ukwn" 1 "RdrDetnSts_Movg" 2 "RdrDetnSts_Staty" 3 "RdrDetnSts_Invalid";
VAL_ 306 FrntSideRdrLeDetn7RdrDetnSts 0 "RdrDetnSts_Ukwn" 1 "RdrDetnSts_Movg" 2 "RdrDetnSts_Staty" 3 "RdrDetnSts_Invalid";
VAL_ 306 FrntSideRdrLeDetn8RdrDetnSts 0 "RdrDetnSts_Ukwn" 1 "RdrDetnSts_Movg" 2 "RdrDetnSts_Staty" 3 "RdrDetnSts_Invalid";
VAL_ 306 FrntSideRdrLeDetn9RdrDetnSts 0 "RdrDetnSts_Ukwn" 1 "RdrDetnSts_Movg" 2 "RdrDetnSts_Staty" 3 "RdrDetnSts_Invalid";
VAL_ 308 FrntSideRdrLeDetn13RdrDetnSts 0 "RdrDetnSts_Ukwn" 1 "RdrDetnSts_Movg" 2 "RdrDetnSts_Staty" 3 "RdrDetnSts_Invalid";
VAL_ 308 FrntSideRdrLeDetn14RdrDetnSts 0 "RdrDetnSts_Ukwn" 1 "RdrDetnSts_Movg" 2 "RdrDetnSts_Staty" 3 "RdrDetnSts_Invalid";
VAL_ 308 FrntSideRdrLeDetn15RdrDetnSts 0 "RdrDetnSts_Ukwn" 1 "RdrDetnSts_Movg" 2 "RdrDetnSts_Staty" 3 "RdrDetnSts_Invalid";
VAL_ 308 FrntSideRdrLeDetn16RdrDetnSts 0 "RdrDetnSts_Ukwn" 1 "RdrDetnSts_Movg" 2 "RdrDetnSts_Staty" 3 "RdrDetnSts_Invalid";
VAL_ 308 FrntSideRdrLeDetn17RdrDetnSts 0 "RdrDetnSts_Ukwn" 1 "RdrDetnSts_Movg" 2 "RdrDetnSts_Staty" 3 "RdrDetnSts_Invalid";
VAL_ 308 FrntSideRdrLeDetn18RdrDetnSts 0 "RdrDetnSts_Ukwn" 1 "RdrDetnSts_Movg" 2 "RdrDetnSts_Staty" 3 "RdrDetnSts_Invalid";
VAL_ 310 FrntSideRdrLeDetn19RdrDetnSts 0 "RdrDetnSts_Ukwn" 1 "RdrDetnSts_Movg" 2 "RdrDetnSts_Staty" 3 "RdrDetnSts_Invalid";
VAL_ 310 FrntSideRdrLeDetn20RdrDetnSts 0 "RdrDetnSts_Ukwn" 1 "RdrDetnSts_Movg" 2 "RdrDetnSts_Staty" 3 "RdrDetnSts_Invalid";
VAL_ 310 FrntSideRdrLeDetn21RdrDetnSts 0 "RdrDetnSts_Ukwn" 1 "RdrDetnSts_Movg" 2 "RdrDetnSts_Staty" 3 "RdrDetnSts_Invalid";
VAL_ 310 FrntSideRdrLeDetn22RdrDetnSts 0 "RdrDetnSts_Ukwn" 1 "RdrDetnSts_Movg" 2 "RdrDetnSts_Staty" 3 "RdrDetnSts_Invalid";
VAL_ 310 FrntSideRdrLeDetn23RdrDetnSts 0 "RdrDetnSts_Ukwn" 1 "RdrDetnSts_Movg" 2 "RdrDetnSts_Staty" 3 "RdrDetnSts_Invalid";
VAL_ 310 FrntSideRdrLeDetn24RdrDetnSts 0 "RdrDetnSts_Ukwn" 1 "RdrDetnSts_Movg" 2 "RdrDetnSts_Staty" 3 "RdrDetnSts_Invalid";
VAL_ 312 FrntSideRdrLeDetn25RdrDetnSts 0 "RdrDetnSts_Ukwn" 1 "RdrDetnSts_Movg" 2 "RdrDetnSts_Staty" 3 "RdrDetnSts_Invalid";
VAL_ 312 FrntSideRdrLeDetn26RdrDetnSts 0 "RdrDetnSts_Ukwn" 1 "RdrDetnSts_Movg" 2 "RdrDetnSts_Staty" 3 "RdrDetnSts_Invalid";
VAL_ 312 FrntSideRdrLeDetn27RdrDetnSts 0 "RdrDetnSts_Ukwn" 1 "RdrDetnSts_Movg" 2 "RdrDetnSts_Staty" 3 "RdrDetnSts_Invalid";
VAL_ 312 FrntSideRdrLeDetn28RdrDetnSts 0 "RdrDetnSts_Ukwn" 1 "RdrDetnSts_Movg" 2 "RdrDetnSts_Staty" 3 "RdrDetnSts_Invalid";
VAL_ 312 FrntSideRdrLeDetn29RdrDetnSts 0 "RdrDetnSts_Ukwn" 1 "RdrDetnSts_Movg" 2 "RdrDetnSts_Staty" 3 "RdrDetnSts_Invalid";
VAL_ 312 FrntSideRdrLeDetn30RdrDetnSts 0 "RdrDetnSts_Ukwn" 1 "RdrDetnSts_Movg" 2 "RdrDetnSts_Staty" 3 "RdrDetnSts_Invalid";
VAL_ 314 FrntSideRdrLeDetn31RdrDetnSts 0 "RdrDetnSts_Ukwn" 1 "RdrDetnSts_Movg" 2 "RdrDetnSts_Staty" 3 "RdrDetnSts_Invalid";
VAL_ 314 FrntSideRdrLeDetn32RdrDetnSts 0 "RdrDetnSts_Ukwn" 1 "RdrDetnSts_Movg" 2 "RdrDetnSts_Staty" 3 "RdrDetnSts_Invalid";
VAL_ 314 FrntSideRdrLeDetn33RdrDetnSts 0 "RdrDetnSts_Ukwn" 1 "RdrDetnSts_Movg" 2 "RdrDetnSts_Staty" 3 "RdrDetnSts_Invalid";
VAL_ 314 FrntSideRdrLeDetn34RdrDetnSts 0 "RdrDetnSts_Ukwn" 1 "RdrDetnSts_Movg" 2 "RdrDetnSts_Staty" 3 "RdrDetnSts_Invalid";
VAL_ 314 FrntSideRdrLeDetn35RdrDetnSts 0 "RdrDetnSts_Ukwn" 1 "RdrDetnSts_Movg" 2 "RdrDetnSts_Staty" 3 "RdrDetnSts_Invalid";
VAL_ 314 FrntSideRdrLeDetn36RdrDetnSts 0 "RdrDetnSts_Ukwn" 1 "RdrDetnSts_Movg" 2 "RdrDetnSts_Staty" 3 "RdrDetnSts_Invalid";
SIG_GROUP_ 288 ADataRawSafe 1 : ADataRawSafeALat ADataRawSafeALat1Qf ADataRawSafeALgt ADataRawSafeALgt1Qf ADataRawSafeAVert ADataRawSafeAVertQf ADataRawSafeChks ADataRawSafeCntr;
SIG_GROUP_ 288 ALgtStdFromWhlSpd 1 : ALgtStdFromWhlSpdALgtStdFromWhlSpd ALgtStdFromWhlSpdChks ALgtStdFromWhlSpdCntr ALgtStdFromWhlSpdQf;
SIG_GROUP_ 288 AmbTRaw 1 : AmbTRawAmbTVal AmbTRawQly;
SIG_GROUP_ 288 AsyDataWithCmpSafe 1 : AsyDataWithCmpSafeALat1Qf AsyDataWithCmpSafeALatWithCmp AsyDataWithCmpSafeALgt1Qf AsyDataWithCmpSafeChks AsyDataWithCmpSafeCntr AsyDataWithCmpSafeGrdtOfALgt AsyDataWithCmpSafeYawRateQf AsyDataWithCmpSafeYawRateWithCmp;
SIG_GROUP_ 304 FrntSideRdrLeDetn1 1 : FrntSideRdrLeDetn1RdrDetnAzi FrntSideRdrLeDetn1RdrDetnChks FrntSideRdrLeDetn1RdrDetnCntr FrntSideRdrLeDetn1RdrDetnConf FrntSideRdrLeDetn1RdrDetnElevn FrntSideRdrLeDetn1RdrDetnPwr FrntSideRdrLeDetn1RdrDetnRng FrntSideRdrLeDetn1RdrDetnRngV FrntSideRdrLeDetn1RdrDetnSts;
SIG_GROUP_ 306 FrntSideRdrLeDetn10 1 : FrntSideRdrLeDetn10RdrDetnAzi FrntSideRdrLeDetn10RdrDetnChks FrntSideRdrLeDetn10RdrDetnCntr FrntSideRdrLeDetn10RdrDetnConf FrntSideRdrLeDetn10RdrDetnElevn FrntSideRdrLeDetn10RdrDetnPwr FrntSideRdrLeDetn10RdrDetnRng FrntSideRdrLeDetn10RdrDetnRngV FrntSideRdrLeDetn10RdrDetnSts;
SIG_GROUP_ 306 FrntSideRdrLeDetn11 1 : FrntSideRdrLeDetn11RdrDetnAzi FrntSideRdrLeDetn11RdrDetnChks FrntSideRdrLeDetn11RdrDetnCntr FrntSideRdrLeDetn11RdrDetnConf FrntSideRdrLeDetn11RdrDetnElevn FrntSideRdrLeDetn11RdrDetnPwr FrntSideRdrLeDetn11RdrDetnRng FrntSideRdrLeDetn11RdrDetnRngV FrntSideRdrLeDetn11RdrDetnSts;
SIG_GROUP_ 306 FrntSideRdrLeDetn12 1 : FrntSideRdrLeDetn12RdrDetnAzi FrntSideRdrLeDetn12RdrDetnChks FrntSideRdrLeDetn12RdrDetnCntr FrntSideRdrLeDetn12RdrDetnConf FrntSideRdrLeDetn12RdrDetnElevn FrntSideRdrLeDetn12RdrDetnPwr FrntSideRdrLeDetn12RdrDetnRng FrntSideRdrLeDetn12RdrDetnRngV FrntSideRdrLeDetn12RdrDetnSts;
SIG_GROUP_ 308 FrntSideRdrLeDetn13 1 : FrntSideRdrLeDetn13RdrDetnAzi FrntSideRdrLeDetn13RdrDetnChks FrntSideRdrLeDetn13RdrDetnCntr FrntSideRdrLeDetn13RdrDetnConf FrntSideRdrLeDetn13RdrDetnElevn FrntSideRdrLeDetn13RdrDetnPwr FrntSideRdrLeDetn13RdrDetnRng FrntSideRdrLeDetn13RdrDetnRngV FrntSideRdrLeDetn13RdrDetnSts;
SIG_GROUP_ 308 FrntSideRdrLeDetn14 1 : FrntSideRdrLeDetn14RdrDetnAzi FrntSideRdrLeDetn14RdrDetnChks FrntSideRdrLeDetn14RdrDetnCntr FrntSideRdrLeDetn14RdrDetnConf FrntSideRdrLeDetn14RdrDetnElevn FrntSideRdrLeDetn14RdrDetnPwr FrntSideRdrLeDetn14RdrDetnRng FrntSideRdrLeDetn14RdrDetnRngV FrntSideRdrLeDetn14RdrDetnSts;
SIG_GROUP_ 308 FrntSideRdrLeDetn15 1 : FrntSideRdrLeDetn15RdrDetnAzi FrntSideRdrLeDetn15RdrDetnChks FrntSideRdrLeDetn15RdrDetnCntr FrntSideRdrLeDetn15RdrDetnConf FrntSideRdrLeDetn15RdrDetnElevn FrntSideRdrLeDetn15RdrDetnPwr FrntSideRdrLeDetn15RdrDetnRng FrntSideRdrLeDetn15RdrDetnRngV FrntSideRdrLeDetn15RdrDetnSts;
SIG_GROUP_ 308 FrntSideRdrLeDetn16 1 : FrntSideRdrLeDetn16RdrDetnAzi FrntSideRdrLeDetn16RdrDetnChks FrntSideRdrLeDetn16RdrDetnCntr FrntSideRdrLeDetn16RdrDetnConf FrntSideRdrLeDetn16RdrDetnElevn FrntSideRdrLeDetn16RdrDetnPwr FrntSideRdrLeDetn16RdrDetnRng FrntSideRdrLeDetn16RdrDetnRngV FrntSideRdrLeDetn16RdrDetnSts;
SIG_GROUP_ 308 FrntSideRdrLeDetn17 1 : FrntSideRdrLeDetn17RdrDetnAzi FrntSideRdrLeDetn17RdrDetnChks FrntSideRdrLeDetn17RdrDetnCntr FrntSideRdrLeDetn17RdrDetnConf FrntSideRdrLeDetn17RdrDetnElevn FrntSideRdrLeDetn17RdrDetnPwr FrntSideRdrLeDetn17RdrDetnRng FrntSideRdrLeDetn17RdrDetnRngV FrntSideRdrLeDetn17RdrDetnSts;
SIG_GROUP_ 308 FrntSideRdrLeDetn18 1 : FrntSideRdrLeDetn18RdrDetnAzi FrntSideRdrLeDetn18RdrDetnChks FrntSideRdrLeDetn18RdrDetnCntr FrntSideRdrLeDetn18RdrDetnConf FrntSideRdrLeDetn18RdrDetnElevn FrntSideRdrLeDetn18RdrDetnPwr FrntSideRdrLeDetn18RdrDetnRng FrntSideRdrLeDetn18RdrDetnRngV FrntSideRdrLeDetn18RdrDetnSts;
SIG_GROUP_ 310 FrntSideRdrLeDetn19 1 : FrntSideRdrLeDetn19RdrDetnAzi FrntSideRdrLeDetn19RdrDetnChks FrntSideRdrLeDetn19RdrDetnCntr FrntSideRdrLeDetn19RdrDetnConf FrntSideRdrLeDetn19RdrDetnElevn FrntSideRdrLeDetn19RdrDetnPwr FrntSideRdrLeDetn19RdrDetnRng FrntSideRdrLeDetn19RdrDetnRngV FrntSideRdrLeDetn19RdrDetnSts;
SIG_GROUP_ 304 FrntSideRdrLeDetn2 1 : FrntSideRdrLeDetn2RdrDetnAzi FrntSideRdrLeDetn2RdrDetnChks FrntSideRdrLeDetn2RdrDetnCntr FrntSideRdrLeDetn2RdrDetnConf FrntSideRdrLeDetn2RdrDetnElevn FrntSideRdrLeDetn2RdrDetnPwr FrntSideRdrLeDetn2RdrDetnRng FrntSideRdrLeDetn2RdrDetnRngV FrntSideRdrLeDetn2RdrDetnSts;
SIG_GROUP_ 310 FrntSideRdrLeDetn20 1 : FrntSideRdrLeDetn20RdrDetnAzi FrntSideRdrLeDetn20RdrDetnChks FrntSideRdrLeDetn20RdrDetnCntr FrntSideRdrLeDetn20RdrDetnConf FrntSideRdrLeDetn20RdrDetnElevn FrntSideRdrLeDetn20RdrDetnPwr FrntSideRdrLeDetn20RdrDetnRng FrntSideRdrLeDetn20RdrDetnRngV FrntSideRdrLeDetn20RdrDetnSts;
SIG_GROUP_ 310 FrntSideRdrLeDetn21 1 : FrntSideRdrLeDetn21RdrDetnAzi FrntSideRdrLeDetn21RdrDetnChks FrntSideRdrLeDetn21RdrDetnCntr FrntSideRdrLeDetn21RdrDetnConf FrntSideRdrLeDetn21RdrDetnElevn FrntSideRdrLeDetn21RdrDetnPwr FrntSideRdrLeDetn21RdrDetnRng FrntSideRdrLeDetn21RdrDetnRngV FrntSideRdrLeDetn21RdrDetnSts;
SIG_GROUP_ 310 FrntSideRdrLeDetn22 1 : FrntSideRdrLeDetn22RdrDetnAzi FrntSideRdrLeDetn22RdrDetnChks FrntSideRdrLeDetn22RdrDetnCntr FrntSideRdrLeDetn22RdrDetnConf FrntSideRdrLeDetn22RdrDetnElevn FrntSideRdrLeDetn22RdrDetnPwr FrntSideRdrLeDetn22RdrDetnRng FrntSideRdrLeDetn22RdrDetnRngV FrntSideRdrLeDetn22RdrDetnSts;
SIG_GROUP_ 310 FrntSideRdrLeDetn23 1 : FrntSideRdrLeDetn23RdrDetnAzi FrntSideRdrLeDetn23RdrDetnChks FrntSideRdrLeDetn23RdrDetnCntr FrntSideRdrLeDetn23RdrDetnConf FrntSideRdrLeDetn23RdrDetnElevn FrntSideRdrLeDetn23RdrDetnPwr FrntSideRdrLeDetn23RdrDetnRng FrntSideRdrLeDetn23RdrDetnRngV FrntSideRdrLeDetn23RdrDetnSts;
SIG_GROUP_ 310 FrntSideRdrLeDetn24 1 : FrntSideRdrLeDetn24RdrDetnAzi FrntSideRdrLeDetn24RdrDetnChks FrntSideRdrLeDetn24RdrDetnCntr FrntSideRdrLeDetn24RdrDetnConf FrntSideRdrLeDetn24RdrDetnElevn FrntSideRdrLeDetn24RdrDetnPwr FrntSideRdrLeDetn24RdrDetnRng FrntSideRdrLeDetn24RdrDetnRngV FrntSideRdrLeDetn24RdrDetnSts;
SIG_GROUP_ 312 FrntSideRdrLeDetn25 1 : FrntSideRdrLeDetn25RdrDetnAzi FrntSideRdrLeDetn25RdrDetnChks FrntSideRdrLeDetn25RdrDetnCntr FrntSideRdrLeDetn25RdrDetnConf FrntSideRdrLeDetn25RdrDetnElevn FrntSideRdrLeDetn25RdrDetnPwr FrntSideRdrLeDetn25RdrDetnRng FrntSideRdrLeDetn25RdrDetnRngV FrntSideRdrLeDetn25RdrDetnSts;
SIG_GROUP_ 312 FrntSideRdrLeDetn26 1 : FrntSideRdrLeDetn26RdrDetnAzi FrntSideRdrLeDetn26RdrDetnChks FrntSideRdrLeDetn26RdrDetnCntr FrntSideRdrLeDetn26RdrDetnConf FrntSideRdrLeDetn26RdrDetnElevn FrntSideRdrLeDetn26RdrDetnPwr FrntSideRdrLeDetn26RdrDetnRng FrntSideRdrLeDetn26RdrDetnRngV FrntSideRdrLeDetn26RdrDetnSts;
SIG_GROUP_ 312 FrntSideRdrLeDetn27 1 : FrntSideRdrLeDetn27RdrDetnAzi FrntSideRdrLeDetn27RdrDetnChks FrntSideRdrLeDetn27RdrDetnCntr FrntSideRdrLeDetn27RdrDetnConf FrntSideRdrLeDetn27RdrDetnElevn FrntSideRdrLeDetn27RdrDetnPwr FrntSideRdrLeDetn27RdrDetnRng FrntSideRdrLeDetn27RdrDetnRngV FrntSideRdrLeDetn27RdrDetnSts;
SIG_GROUP_ 312 FrntSideRdrLeDetn28 1 : FrntSideRdrLeDetn28RdrDetnAzi FrntSideRdrLeDetn28RdrDetnChks FrntSideRdrLeDetn28RdrDetnCntr FrntSideRdrLeDetn28RdrDetnConf FrntSideRdrLeDetn28RdrDetnElevn FrntSideRdrLeDetn28RdrDetnPwr FrntSideRdrLeDetn28RdrDetnRng FrntSideRdrLeDetn28RdrDetnRngV FrntSideRdrLeDetn28RdrDetnSts;
SIG_GROUP_ 312 FrntSideRdrLeDetn29 1 : FrntSideRdrLeDetn29RdrDetnAzi FrntSideRdrLeDetn29RdrDetnChks FrntSideRdrLeDetn29RdrDetnCntr FrntSideRdrLeDetn29RdrDetnConf FrntSideRdrLeDetn29RdrDetnElevn FrntSideRdrLeDetn29RdrDetnPwr FrntSideRdrLeDetn29RdrDetnRng FrntSideRdrLeDetn29RdrDetnRngV FrntSideRdrLeDetn29RdrDetnSts;
SIG_GROUP_ 304 FrntSideRdrLeDetn3 1 : FrntSideRdrLeDetn3RdrDetnAzi FrntSideRdrLeDetn3RdrDetnChks FrntSideRdrLeDetn3RdrDetnCntr FrntSideRdrLeDetn3RdrDetnConf FrntSideRdrLeDetn3RdrDetnElevn FrntSideRdrLeDetn3RdrDetnPwr FrntSideRdrLeDetn3RdrDetnRng FrntSideRdrLeDetn3RdrDetnRngV FrntSideRdrLeDetn3RdrDetnSts;
SIG_GROUP_ 312 FrntSideRdrLeDetn30 1 : FrntSideRdrLeDetn30RdrDetnAzi FrntSideRdrLeDetn30RdrDetnChks FrntSideRdrLeDetn30RdrDetnCntr FrntSideRdrLeDetn30RdrDetnConf FrntSideRdrLeDetn30RdrDetnElevn FrntSideRdrLeDetn30RdrDetnPwr FrntSideRdrLeDetn30RdrDetnRng FrntSideRdrLeDetn30RdrDetnRngV FrntSideRdrLeDetn30RdrDetnSts;
SIG_GROUP_ 314 FrntSideRdrLeDetn31 1 : FrntSideRdrLeDetn31RdrDetnAzi FrntSideRdrLeDetn31RdrDetnChks FrntSideRdrLeDetn31RdrDetnCntr FrntSideRdrLeDetn31RdrDetnConf FrntSideRdrLeDetn31RdrDetnElevn FrntSideRdrLeDetn31RdrDetnPwr FrntSideRdrLeDetn31RdrDetnRng FrntSideRdrLeDetn31RdrDetnRngV FrntSideRdrLeDetn31RdrDetnSts;
SIG_GROUP_ 314 FrntSideRdrLeDetn32 1 : FrntSideRdrLeDetn32RdrDetnAzi FrntSideRdrLeDetn32RdrDetnChks FrntSideRdrLeDetn32RdrDetnCntr FrntSideRdrLeDetn32RdrDetnConf FrntSideRdrLeDetn32RdrDetnElevn FrntSideRdrLeDetn32RdrDetnPwr FrntSideRdrLeDetn32RdrDetnRng FrntSideRdrLeDetn32RdrDetnRngV FrntSideRdrLeDetn32RdrDetnSts;
SIG_GROUP_ 314 FrntSideRdrLeDetn33 1 : FrntSideRdrLeDetn33RdrDetnAzi FrntSideRdrLeDetn33RdrDetnChks FrntSideRdrLeDetn33RdrDetnCntr FrntSideRdrLeDetn33RdrDetnConf FrntSideRdrLeDetn33RdrDetnElevn FrntSideRdrLeDetn33RdrDetnPwr FrntSideRdrLeDetn33RdrDetnRng FrntSideRdrLeDetn33RdrDetnRngV FrntSideRdrLeDetn33RdrDetnSts;
SIG_GROUP_ 314 FrntSideRdrLeDetn34 1 : FrntSideRdrLeDetn34RdrDetnAzi FrntSideRdrLeDetn34RdrDetnChks FrntSideRdrLeDetn34RdrDetnCntr FrntSideRdrLeDetn34RdrDetnConf FrntSideRdrLeDetn34RdrDetnElevn FrntSideRdrLeDetn34RdrDetnPwr FrntSideRdrLeDetn34RdrDetnRng FrntSideRdrLeDetn34RdrDetnRngV FrntSideRdrLeDetn34RdrDetnSts;
SIG_GROUP_ 314 FrntSideRdrLeDetn35 1 : FrntSideRdrLeDetn35RdrDetnAzi FrntSideRdrLeDetn35RdrDetnChks FrntSideRdrLeDetn35RdrDetnCntr FrntSideRdrLeDetn35RdrDetnConf FrntSideRdrLeDetn35RdrDetnElevn FrntSideRdrLeDetn35RdrDetnPwr FrntSideRdrLeDetn35RdrDetnRng FrntSideRdrLeDetn35RdrDetnRngV FrntSideRdrLeDetn35RdrDetnSts;
SIG_GROUP_ 314 FrntSideRdrLeDetn36 1 : FrntSideRdrLeDetn36RdrDetnAzi FrntSideRdrLeDetn36RdrDetnChks FrntSideRdrLeDetn36RdrDetnCntr FrntSideRdrLeDetn36RdrDetnConf FrntSideRdrLeDetn36RdrDetnElevn FrntSideRdrLeDetn36RdrDetnPwr FrntSideRdrLeDetn36RdrDetnRng FrntSideRdrLeDetn36RdrDetnRngV FrntSideRdrLeDetn36RdrDetnSts;
SIG_GROUP_ 304 FrntSideRdrLeDetn4 1 : FrntSideRdrLeDetn4RdrDetnAzi FrntSideRdrLeDetn4RdrDetnChks FrntSideRdrLeDetn4RdrDetnCntr FrntSideRdrLeDetn4RdrDetnConf FrntSideRdrLeDetn4RdrDetnElevn FrntSideRdrLeDetn4RdrDetnPwr FrntSideRdrLeDetn4RdrDetnRng FrntSideRdrLeDetn4RdrDetnRngV FrntSideRdrLeDetn4RdrDetnSts;
SIG_GROUP_ 304 FrntSideRdrLeDetn5 1 : FrntSideRdrLeDetn5RdrDetnAzi FrntSideRdrLeDetn5RdrDetnChks FrntSideRdrLeDetn5RdrDetnCntr FrntSideRdrLeDetn5RdrDetnConf FrntSideRdrLeDetn5RdrDetnElevn FrntSideRdrLeDetn5RdrDetnPwr FrntSideRdrLeDetn5RdrDetnRng FrntSideRdrLeDetn5RdrDetnRngV FrntSideRdrLeDetn5RdrDetnSts;
SIG_GROUP_ 304 FrntSideRdrLeDetn6 1 : FrntSideRdrLeDetn6RdrDetnAzi FrntSideRdrLeDetn6RdrDetnChks FrntSideRdrLeDetn6RdrDetnCntr FrntSideRdrLeDetn6RdrDetnConf FrntSideRdrLeDetn6RdrDetnElevn FrntSideRdrLeDetn6RdrDetnPwr FrntSideRdrLeDetn6RdrDetnRng FrntSideRdrLeDetn6RdrDetnRngV FrntSideRdrLeDetn6RdrDetnSts;
SIG_GROUP_ 306 FrntSideRdrLeDetn7 1 : FrntSideRdrLeDetn7RdrDetnAzi FrntSideRdrLeDetn7RdrDetnChks FrntSideRdrLeDetn7RdrDetnCntr FrntSideRdrLeDetn7RdrDetnConf FrntSideRdrLeDetn7RdrDetnElevn FrntSideRdrLeDetn7RdrDetnPwr FrntSideRdrLeDetn7RdrDetnRng FrntSideRdrLeDetn7RdrDetnRngV FrntSideRdrLeDetn7RdrDetnSts;
SIG_GROUP_ 306 FrntSideRdrLeDetn8 1 : FrntSideRdrLeDetn8RdrDetnAzi FrntSideRdrLeDetn8RdrDetnChks FrntSideRdrLeDetn8RdrDetnCntr FrntSideRdrLeDetn8RdrDetnConf FrntSideRdrLeDetn8RdrDetnElevn FrntSideRdrLeDetn8RdrDetnPwr FrntSideRdrLeDetn8RdrDetnRng FrntSideRdrLeDetn8RdrDetnRngV FrntSideRdrLeDetn8RdrDetnSts;
SIG_GROUP_ 306 FrntSideRdrLeDetn9 1 : FrntSideRdrLeDetn9RdrDetnAzi FrntSideRdrLeDetn9RdrDetnChks FrntSideRdrLeDetn9RdrDetnCntr FrntSideRdrLeDetn9RdrDetnConf FrntSideRdrLeDetn9RdrDetnElevn FrntSideRdrLeDetn9RdrDetnPwr FrntSideRdrLeDetn9RdrDetnRng FrntSideRdrLeDetn9RdrDetnRngV FrntSideRdrLeDetn9RdrDetnSts;
SIG_GROUP_ 297 FrntSideRdrLeSts 1 : FrntSideRdrLeStsRdrNrDetn FrntSideRdrLeStsRdrNrObj FrntSideRdrLeStsRdrStsBlkd0bin FrntSideRdrLeStsRdrStsBlkdConf FrntSideRdrLeStsRdrStsChks FrntSideRdrLeStsRdrStsCntr FrntSideRdrLeStsRdrStsDstbc FrntSideRdrLeStsRdrStsEna FrntSideRdrLeStsRdrStsFaulty FrntSideRdrLeStsRdrStsIfVersMajor FrntSideRdrLeStsRdrStsIfVersMinor FrntSideRdrLeStsRdrStsLatency FrntSideRdrLeStsRdrStsMisAlign FrntSideRdrLeStsRdrStsMissCom FrntSideRdrLeStsRdrStsSftyFlt FrntSideRdrLeStsRdrStsTiStamp FrntSideRdrLeStsRdrStsTiStampStsGlbTiBas FrntSideRdrLeStsRdrStsTiStampStsSyncToGatewy FrntSideRdrLeStsRdrStsTiStampStsTiLeap FrntSideRdrLeStsRdrStsTiStampStsTiOut FrntSideRdrLeStsRdrStsWhlSpdCmpFac;
SIG_GROUP_ 1007 FrntSideRdrLeVehPrm 1 : FrntSideRdrLeVehPrmRdrVehPrmChks FrntSideRdrLeVehPrmRdrVehPrmCntr FrntSideRdrLeVehPrmRdrVehPrmRdrDynCalPrmForAgOffs FrntSideRdrLeVehPrmRdrVehPrmRdrDynCalPrmForAxleDstReToVehFrnt FrntSideRdrLeVehPrmRdrVehPrmRdrDynCalPrmForPinoinAgRat FrntSideRdrLeVehPrmRdrVehPrmRdrDynCalPrmForRollAgGain FrntSideRdrLeVehPrmRdrVehPrmRdrDynCalPrmForSnsrDir FrntSideRdrLeVehPrmRdrVehPrmRdrDynCalPrmForSnsrOrntn FrntSideRdrLeVehPrmRdrVehPrmRdrDynCalPrmForSnsrPosnLat FrntSideRdrLeVehPrmRdrVehPrmRdrDynCalPrmForSnsrPosnLgt FrntSideRdrLeVehPrmRdrVehPrmRdrDynCalPrmForSnsrPosnVert FrntSideRdrLeVehPrmRdrVehPrmRdrDynCalPrmForSnsrRot1 FrntSideRdrLeVehPrmRdrVehPrmRdrDynCalPrmForVehLen FrntSideRdrLeVehPrmRdrVehPrmRdrDynCalPrmForVehTyp FrntSideRdrLeVehPrmRdrVehPrmRdrDynCalPrmForVehWidth FrntSideRdrLeVehPrmRdrVehPrmRdrDynCalPrmForVersMajor FrntSideRdrLeVehPrmRdrVehPrmRdrDynCalPrmForVersMinor FrntSideRdrLeVehPrmRdrVehPrmRdrDynCalPrmForWhlBas FrntSideRdrLeVehPrmRdrVehPrmVld;
SIG_GROUP_ 1007 FrntSideRdrRiVehPrm 1 : FrntSideRdrRiVehPrmRdrVehPrmChks FrntSideRdrRiVehPrmRdrVehPrmCntr FrntSideRdrRiVehPrmRdrVehPrmRdrDynCalPrmForAgOffs FrntSideRdrRiVehPrmRdrVehPrmRdrDynCalPrmForAxleDstReToVehFrnt FrntSideRdrRiVehPrmRdrVehPrmRdrDynCalPrmForPinoinAgRat FrntSideRdrRiVehPrmRdrVehPrmRdrDynCalPrmForRollAgGain FrntSideRdrRiVehPrmRdrVehPrmRdrDynCalPrmForSnsrDir FrntSideRdrRiVehPrmRdrVehPrmRdrDynCalPrmForSnsrOrntn FrntSideRdrRiVehPrmRdrVehPrmRdrDynCalPrmForSnsrPosnLat FrntSideRdrRiVehPrmRdrVehPrmRdrDynCalPrmForSnsrPosnLgt FrntSideRdrRiVehPrmRdrVehPrmRdrDynCalPrmForSnsrPosnVert FrntSideRdrRiVehPrmRdrVehPrmRdrDynCalPrmForSnsrRot1 FrntSideRdrRiVehPrmRdrVehPrmRdrDynCalPrmForVehLen FrntSideRdrRiVehPrmRdrVehPrmRdrDynCalPrmForVehTyp FrntSideRdrRiVehPrmRdrVehPrmRdrDynCalPrmForVehWidth FrntSideRdrRiVehPrmRdrVehPrmRdrDynCalPrmForVersMajor FrntSideRdrRiVehPrmRdrVehPrmRdrDynCalPrmForVersMinor FrntSideRdrRiVehPrmRdrVehPrmRdrDynCalPrmForWhlBas FrntSideRdrRiVehPrmRdrVehPrmVld;
SIG_GROUP_ 288 PinionSteerAgGroup 1 : PinionSteerAgGroupChks PinionSteerAgGroupCntr PinionSteerAgGroupPinionSteerAg1 PinionSteerAgGroupPinionSteerAg1Qf PinionSteerAgGroupPinionSteerAgSpd1 PinionSteerAgGroupPinionSteerAgSpd1Qf PinionSteerAgGroupSteerWhlTq PinionSteerAgGroupSteerWhlTqQf;
SIG_GROUP_ 288 SteerWhlSnsr 1 : SteerWhlSnsrAg SteerWhlSnsrAgSpd SteerWhlSnsrChks SteerWhlSnsrCntr SteerWhlSnsrQf;
SIG_GROUP_ 1007 TiAndDateIndcn 1 : TiAndDateIndcnDataValid TiAndDateIndcnDay TiAndDateIndcnHr1 TiAndDateIndcnMins1 TiAndDateIndcnMth1 TiAndDateIndcnSec1 TiAndDateIndcnYr1;
SIG_GROUP_ 288 VehBattU 1 : VehBattUSysU VehBattUSysUQf;
SIG_GROUP_ 288 VehModMngtGlbSafe1 1 : VehModMngtGlbSafe1CarModSts1 VehModMngtGlbSafe1CarModSubtypWdCarModSubtyp VehModMngtGlbSafe1Chks VehModMngtGlbSafe1Cntr VehModMngtGlbSafe1EgyLvlElecMai VehModMngtGlbSafe1EgyLvlElecSubtyp VehModMngtGlbSafe1FltEgyCnsWdSts VehModMngtGlbSafe1PwrLvlElecMai VehModMngtGlbSafe1PwrLvlElecSubtyp VehModMngtGlbSafe1UsgModSts;
SIG_GROUP_ 288 VehMtnSt 1 : VehMtnStChks VehMtnStCntr VehMtnStVehMtnSt;
SIG_GROUP_ 288 VehSpdLgt 1 : VehSpdLgtA VehSpdLgtChks VehSpdLgtCntr VehSpdLgtQf;
SIG_GROUP_ 288 WipgInfo 1 : WipgInfoWipgSpdInfo WipgInfoWiprActv WipgInfoWiprInWipgAr;
